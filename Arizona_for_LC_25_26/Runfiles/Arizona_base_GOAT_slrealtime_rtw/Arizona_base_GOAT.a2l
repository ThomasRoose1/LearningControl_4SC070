/******************************************************************************
* ASAP2 file: Arizona_base_GOAT.a2l
* Academic License - for use in teaching, academic research, and meeting
* course requirements at degree granting institutions only. Not for
* government, commercial, or other organizational use.
* Code generation for model "Arizona_base_GOAT".
* Model version : 12.234
* Simulink Coder version : 10.5 R2022a
* C source code generated on : Fri May 22 15:33:45 2026
* Target selection: slrealtime.tlc
* Embedded hardware selection: Intel->x86-64 (Linux 64)
* Code generation objectives: Unspecified
* Validation result: Not run
* (add additional file header information here)
******************************************************************************/ ASAP2_VERSION 1 71
/begin PROJECT ProjectName "Project Comment Goes Here"
/begin HEADER "Header Comments go here" /end HEADER
/begin MODULE ModuleName "Module Comment Goes Here"
/begin IF_DATA XCP
 /begin PROTOCOL_LAYER 0x0100 0x03E8 0x00C8 0x0000 0x0000 0x0000 0x0000 0x0000 0xFC 0x0578 BYTE_ORDER_MSB_LAST ADDRESS_GRANULARITY_BYTE OPTIONAL_CMD ALLOC_ODT_ENTRY OPTIONAL_CMD ALLOC_ODT OPTIONAL_CMD ALLOC_DAQ OPTIONAL_CMD FREE_DAQ OPTIONAL_CMD GET_DAQ_CLOCK OPTIONAL_CMD GET_DAQ_RESOLUTION_INFO OPTIONAL_CMD GET_DAQ_PROCESSOR_INFO OPTIONAL_CMD START_STOP_SYNCH OPTIONAL_CMD START_STOP_DAQ_LIST OPTIONAL_CMD SET_DAQ_LIST_MODE OPTIONAL_CMD WRITE_DAQ OPTIONAL_CMD SET_DAQ_PTR OPTIONAL_CMD GET_CAL_PAGE OPTIONAL_CMD SET_CAL_PAGE OPTIONAL_CMD COPY_CAL_PAGE OPTIONAL_CMD SHORT_DOWNLOAD OPTIONAL_CMD DOWNLOAD_MAX OPTIONAL_CMD DOWNLOAD OPTIONAL_CMD SHORT_UPLOAD OPTIONAL_CMD UPLOAD OPTIONAL_CMD SET_MTA OPTIONAL_CMD GET_SEGMENT_INFO OPTIONAL_CMD GET_PAGE_INFO OPTIONAL_CMD SET_SEGMENT_MODE OPTIONAL_CMD GET_SEGMENT_MODE OPTIONAL_CMD GET_PAG_PROCESSOR_INFO OPTIONAL_CMD MODIFY_BITS /end PROTOCOL_LAYER
 /begin DAQ DYNAMIC 0x0000 0x0080 0x00 OPTIMISATION_TYPE_DEFAULT ADDRESS_EXTENSION_FREE IDENTIFICATION_FIELD_TYPE_RELATIVE_WORD_ALIGNED GRANULARITY_ODT_ENTRY_SIZE_DAQ_BYTE 0xFF OVERLOAD_INDICATION_PID PRESCALER_SUPPORTED /begin STIM GRANULARITY_ODT_ENTRY_SIZE_STIM_BYTE 0xFF /end STIM /begin TIMESTAMP_SUPPORTED 0x0001 SIZE_DWORD UNIT_1US TIMESTAMP_FIXED /end TIMESTAMP_SUPPORTED /begin EVENT "1 ms" "1 ms" 0x0000 DAQ 0xFF 0x01 0x06 0x00 /end EVENT /end DAQ
 /begin XCP_ON_UDP_IP 0x0100 0x15B3 ADDRESS "192.168.7.5" /end XCP_ON_UDP_IP
/end IF_DATA
/begin MOD_PAR "MOD PAR Comment Goes Here"
 /begin MEMORY_SEGMENT RTE_Param_Service "RTE_Param_Service" DATA FLASH INTERN 0x00268AA0 0x13BD0 -1 -1 -1 -1 -1
  /begin IF_DATA XCP
   /begin SEGMENT 0x00 0x02 0x00 0x00 0x00
    /begin PAGE 0x00 ECU_ACCESS_DONT_CARE XCP_READ_ACCESS_DONT_CARE XCP_WRITE_ACCESS_NOT_ALLOWED /end PAGE
    /begin PAGE 0x01 ECU_ACCESS_DONT_CARE XCP_READ_ACCESS_DONT_CARE XCP_WRITE_ACCESS_DONT_CARE /end PAGE
   /end SEGMENT
  /end IF_DATA
 /end MEMORY_SEGMENT
 /begin MEMORY_SEGMENT Arizona_base_GOAT_cal_impl "Arizona_base_GOAT_cal_impl" DATA FLASH INTERN 0x00222060 0x46A00 -1 -1 -1 -1 -1
  /begin IF_DATA XCP
   /begin SEGMENT 0x01 0x02 0x00 0x00 0x00
    /begin PAGE 0x00 ECU_ACCESS_DONT_CARE XCP_READ_ACCESS_DONT_CARE XCP_WRITE_ACCESS_NOT_ALLOWED /end PAGE
    /begin PAGE 0x01 ECU_ACCESS_DONT_CARE XCP_READ_ACCESS_DONT_CARE XCP_WRITE_ACCESS_DONT_CARE /end PAGE
   /end SEGMENT
  /end IF_DATA
 /end MEMORY_SEGMENT
/end MOD_PAR
/begin MOD_COMMON "Mod Common Comment Here" BYTE_ORDER MSB_LAST ALIGNMENT_BYTE 1 ALIGNMENT_WORD 2 ALIGNMENT_LONG 4 ALIGNMENT_FLOAT32_IEEE 4 ALIGNMENT_FLOAT64_IEEE 8 ALIGNMENT_INT64 8 /end MOD_COMMON
/begin CHARACTERISTIC Arizona_base_GOAT_cal_impl.Analoginput1_P1 "" VALUE 0x00266CB8 Scalar_FLOAT64_IEEE 0 Arizona_base_GOAT_CM_double -1.7E+308 1.7E+308 /end CHARACTERISTIC
/begin CHARACTERISTIC Arizona_base_GOAT_cal_impl.Analoginput1_P10 "" VALUE 0x00266E20 Scalar_FLOAT64_IEEE 0 Arizona_base_GOAT_CM_double -1.7E+308 1.7E+308 /end CHARACTERISTIC
/begin CHARACTERISTIC Arizona_base_GOAT_cal_impl.Analoginput1_P11 "" VAL_BLK 0x00266E38 Scalar_FLOAT64_IEEE 0 Arizona_base_GOAT_CM_double -1.7E+308 1.7E+308 MATRIX_DIM 4 1 /end CHARACTERISTIC
/begin CHARACTERISTIC Arizona_base_GOAT_cal_impl.Analoginput1_P12 "" VALUE 0x00266E68 Scalar_FLOAT64_IEEE 0 Arizona_base_GOAT_CM_double -1.7E+308 1.7E+308 /end CHARACTERISTIC
/begin CHARACTERISTIC Arizona_base_GOAT_cal_impl.Analoginput1_P2 "" VALUE 0x00266CD0 Scalar_FLOAT64_IEEE 0 Arizona_base_GOAT_CM_double -1.7E+308 1.7E+308 /end CHARACTERISTIC
/begin CHARACTERISTIC Arizona_base_GOAT_cal_impl.Analoginput1_P3 "" VALUE 0x00266CE8 Scalar_FLOAT64_IEEE 0 Arizona_base_GOAT_CM_double -1.7E+308 1.7E+308 /end CHARACTERISTIC
/begin CHARACTERISTIC Arizona_base_GOAT_cal_impl.Analoginput1_P4 "" VALUE 0x00266D00 Scalar_FLOAT64_IEEE 0 Arizona_base_GOAT_CM_double -1.7E+308 1.7E+308 /end CHARACTERISTIC
/begin CHARACTERISTIC Arizona_base_GOAT_cal_impl.Analoginput1_P5 "" VAL_BLK 0x00266D18 Scalar_FLOAT64_IEEE 0 Arizona_base_GOAT_CM_double -1.7E+308 1.7E+308 MATRIX_DIM 2 1 /end CHARACTERISTIC
/begin CHARACTERISTIC Arizona_base_GOAT_cal_impl.Analoginput1_P6 "" VAL_BLK 0x00266D38 Scalar_FLOAT64_IEEE 0 Arizona_base_GOAT_CM_double -1.7E+308 1.7E+308 MATRIX_DIM 2 1 /end CHARACTERISTIC
/begin CHARACTERISTIC Arizona_base_GOAT_cal_impl.Analoginput1_P7 "" VAL_BLK 0x00266D58 Scalar_FLOAT64_IEEE 0 Arizona_base_GOAT_CM_double -1.7E+308 1.7E+308 MATRIX_DIM 16 1 /end CHARACTERISTIC
/begin CHARACTERISTIC Arizona_base_GOAT_cal_impl.Analoginput1_P8 "" VAL_BLK 0x00266DE8 Scalar_FLOAT64_IEEE 0 Arizona_base_GOAT_CM_double -1.7E+308 1.7E+308 MATRIX_DIM 2 1 /end CHARACTERISTIC
/begin CHARACTERISTIC Arizona_base_GOAT_cal_impl.Analoginput1_P9 "" VALUE 0x00266E08 Scalar_FLOAT64_IEEE 0 Arizona_base_GOAT_CM_double -1.7E+308 1.7E+308 /end CHARACTERISTIC
/begin CHARACTERISTIC Arizona_base_GOAT_cal_impl.Analogoutput2_P1 "" VALUE 0x00267CD8 Scalar_FLOAT64_IEEE 0 Arizona_base_GOAT_CM_double -1.7E+308 1.7E+308 /end CHARACTERISTIC
/begin CHARACTERISTIC Arizona_base_GOAT_cal_impl.Analogoutput2_P10 "" VALUE 0x00267E10 Scalar_FLOAT64_IEEE 0 Arizona_base_GOAT_CM_double -1.7E+308 1.7E+308 /end CHARACTERISTIC
/begin CHARACTERISTIC Arizona_base_GOAT_cal_impl.Analogoutput2_P11 "" VALUE 0x00267E28 Scalar_FLOAT64_IEEE 0 Arizona_base_GOAT_CM_double -1.7E+308 1.7E+308 /end CHARACTERISTIC
/begin CHARACTERISTIC Arizona_base_GOAT_cal_impl.Analogoutput2_P12 "" VAL_BLK 0x00267E40 Scalar_FLOAT64_IEEE 0 Arizona_base_GOAT_CM_double -1.7E+308 1.7E+308 MATRIX_DIM 4 1 /end CHARACTERISTIC
/begin CHARACTERISTIC Arizona_base_GOAT_cal_impl.Analogoutput2_P13 "" VALUE 0x00267E70 Scalar_FLOAT64_IEEE 0 Arizona_base_GOAT_CM_double -1.7E+308 1.7E+308 /end CHARACTERISTIC
/begin CHARACTERISTIC Arizona_base_GOAT_cal_impl.Analogoutput2_P14 "" VALUE 0x00267E88 Scalar_FLOAT64_IEEE 0 Arizona_base_GOAT_CM_double -1.7E+308 1.7E+308 /end CHARACTERISTIC
/begin CHARACTERISTIC Arizona_base_GOAT_cal_impl.Analogoutput2_P2 "" VALUE 0x00267CF0 Scalar_FLOAT64_IEEE 0 Arizona_base_GOAT_CM_double -1.7E+308 1.7E+308 /end CHARACTERISTIC
/begin CHARACTERISTIC Arizona_base_GOAT_cal_impl.Analogoutput2_P3 "" VALUE 0x00267D08 Scalar_FLOAT64_IEEE 0 Arizona_base_GOAT_CM_double -1.7E+308 1.7E+308 /end CHARACTERISTIC
/begin CHARACTERISTIC Arizona_base_GOAT_cal_impl.Analogoutput2_P4 "" VALUE 0x00267D20 Scalar_FLOAT64_IEEE 0 Arizona_base_GOAT_CM_double -1.7E+308 1.7E+308 /end CHARACTERISTIC
/begin CHARACTERISTIC Arizona_base_GOAT_cal_impl.Analogoutput2_P5 "" VAL_BLK 0x00267D38 Scalar_FLOAT64_IEEE 0 Arizona_base_GOAT_CM_double -1.7E+308 1.7E+308 MATRIX_DIM 3 1 /end CHARACTERISTIC
/begin CHARACTERISTIC Arizona_base_GOAT_cal_impl.Analogoutput2_P6 "" VAL_BLK 0x00267D60 Scalar_FLOAT64_IEEE 0 Arizona_base_GOAT_CM_double -1.7E+308 1.7E+308 MATRIX_DIM 4 1 /end CHARACTERISTIC
/begin CHARACTERISTIC Arizona_base_GOAT_cal_impl.Analogoutput2_P7 "" VAL_BLK 0x00267D90 Scalar_FLOAT64_IEEE 0 Arizona_base_GOAT_CM_double -1.7E+308 1.7E+308 MATRIX_DIM 4 1 /end CHARACTERISTIC
/begin CHARACTERISTIC Arizona_base_GOAT_cal_impl.Analogoutput2_P8 "" VAL_BLK 0x00267DC0 Scalar_FLOAT64_IEEE 0 Arizona_base_GOAT_CM_double -1.7E+308 1.7E+308 MATRIX_DIM 3 1 /end CHARACTERISTIC
/begin CHARACTERISTIC Arizona_base_GOAT_cal_impl.Analogoutput2_P9 "" VAL_BLK 0x00267DE8 Scalar_FLOAT64_IEEE 0 Arizona_base_GOAT_CM_double -1.7E+308 1.7E+308 MATRIX_DIM 3 1 /end CHARACTERISTIC
/begin CHARACTERISTIC Arizona_base_GOAT_cal_impl.Calibration1_Gain "" VALUE 0x00267538 Scalar_FLOAT64_IEEE 0 Arizona_base_GOAT_CM_double -1.7E+308 1.7E+308 /end CHARACTERISTIC
/begin CHARACTERISTIC Arizona_base_GOAT_cal_impl.Calibration2_Gain "" VALUE 0x00267788 Scalar_FLOAT64_IEEE 0 Arizona_base_GOAT_CM_double -1.7E+308 1.7E+308 /end CHARACTERISTIC
/begin CHARACTERISTIC Arizona_base_GOAT_cal_impl.Calibration3_Gain "" VALUE 0x002679D8 Scalar_FLOAT64_IEEE 0 Arizona_base_GOAT_CM_double -1.7E+308 1.7E+308 /end CHARACTERISTIC
/begin CHARACTERISTIC Arizona_base_GOAT_cal_impl.Calibration4_Gain "" VALUE 0x00268328 Scalar_FLOAT64_IEEE 0 Arizona_base_GOAT_CM_double -1.7E+308 1.7E+308 /end CHARACTERISTIC
/begin CHARACTERISTIC Arizona_base_GOAT_cal_impl.Calibration5_Gain "" VALUE 0x00268578 Scalar_FLOAT64_IEEE 0 Arizona_base_GOAT_CM_double -1.7E+308 1.7E+308 /end CHARACTERISTIC
/begin CHARACTERISTIC Arizona_base_GOAT_cal_impl.Calibration6_Gain "" VALUE 0x002687C8 Scalar_FLOAT64_IEEE 0 Arizona_base_GOAT_CM_double -1.7E+308 1.7E+308 /end CHARACTERISTIC
/begin CHARACTERISTIC Arizona_base_GOAT_cal_impl.Cariagesecundair_P1 "" VALUE 0x002680F8 Scalar_FLOAT64_IEEE 0 Arizona_base_GOAT_CM_double -1.7E+308 1.7E+308 /end CHARACTERISTIC
/begin CHARACTERISTIC Arizona_base_GOAT_cal_impl.Cariagesecundair_P10 "" VALUE 0x002681D0 Scalar_FLOAT64_IEEE 0 Arizona_base_GOAT_CM_double -1.7E+308 1.7E+308 /end CHARACTERISTIC
/begin CHARACTERISTIC Arizona_base_GOAT_cal_impl.Cariagesecundair_P11 "" VALUE 0x002681E8 Scalar_FLOAT64_IEEE 0 Arizona_base_GOAT_CM_double -1.7E+308 1.7E+308 /end CHARACTERISTIC
/begin CHARACTERISTIC Arizona_base_GOAT_cal_impl.Cariagesecundair_P12 "" VALUE 0x00268200 Scalar_FLOAT64_IEEE 0 Arizona_base_GOAT_CM_double -1.7E+308 1.7E+308 /end CHARACTERISTIC
/begin CHARACTERISTIC Arizona_base_GOAT_cal_impl.Cariagesecundair_P13 "" VALUE 0x00268218 Scalar_FLOAT64_IEEE 0 Arizona_base_GOAT_CM_double -1.7E+308 1.7E+308 /end CHARACTERISTIC
/begin CHARACTERISTIC Arizona_base_GOAT_cal_impl.Cariagesecundair_P14 "" VALUE 0x00268230 Scalar_FLOAT64_IEEE 0 Arizona_base_GOAT_CM_double -1.7E+308 1.7E+308 /end CHARACTERISTIC
/begin CHARACTERISTIC Arizona_base_GOAT_cal_impl.Cariagesecundair_P15 "" VALUE 0x00268248 Scalar_FLOAT64_IEEE 0 Arizona_base_GOAT_CM_double -1.7E+308 1.7E+308 /end CHARACTERISTIC
/begin CHARACTERISTIC Arizona_base_GOAT_cal_impl.Cariagesecundair_P16 "" VALUE 0x00268260 Scalar_FLOAT64_IEEE 0 Arizona_base_GOAT_CM_double -1.7E+308 1.7E+308 /end CHARACTERISTIC
/begin CHARACTERISTIC Arizona_base_GOAT_cal_impl.Cariagesecundair_P17 "" VALUE 0x00268278 Scalar_FLOAT64_IEEE 0 Arizona_base_GOAT_CM_double -1.7E+308 1.7E+308 /end CHARACTERISTIC
/begin CHARACTERISTIC Arizona_base_GOAT_cal_impl.Cariagesecundair_P18 "" VALUE 0x00268290 Scalar_FLOAT64_IEEE 0 Arizona_base_GOAT_CM_double -1.7E+308 1.7E+308 /end CHARACTERISTIC
/begin CHARACTERISTIC Arizona_base_GOAT_cal_impl.Cariagesecundair_P19 "" VALUE 0x002682A8 Scalar_FLOAT64_IEEE 0 Arizona_base_GOAT_CM_double -1.7E+308 1.7E+308 /end CHARACTERISTIC
/begin CHARACTERISTIC Arizona_base_GOAT_cal_impl.Cariagesecundair_P2 "" VALUE 0x00268110 Scalar_FLOAT64_IEEE 0 Arizona_base_GOAT_CM_double -1.7E+308 1.7E+308 /end CHARACTERISTIC
/begin CHARACTERISTIC Arizona_base_GOAT_cal_impl.Cariagesecundair_P20 "" VALUE 0x002682C0 Scalar_FLOAT64_IEEE 0 Arizona_base_GOAT_CM_double -1.7E+308 1.7E+308 /end CHARACTERISTIC
/begin CHARACTERISTIC Arizona_base_GOAT_cal_impl.Cariagesecundair_P21 "" VALUE 0x002682D8 Scalar_FLOAT64_IEEE 0 Arizona_base_GOAT_CM_double -1.7E+308 1.7E+308 /end CHARACTERISTIC
/begin CHARACTERISTIC Arizona_base_GOAT_cal_impl.Cariagesecundair_P22 "" VALUE 0x002682F0 Scalar_FLOAT64_IEEE 0 Arizona_base_GOAT_CM_double -1.7E+308 1.7E+308 /end CHARACTERISTIC
/begin CHARACTERISTIC Arizona_base_GOAT_cal_impl.Cariagesecundair_P23 "" VALUE 0x00268308 Scalar_FLOAT64_IEEE 0 Arizona_base_GOAT_CM_double -1.7E+308 1.7E+308 /end CHARACTERISTIC
/begin CHARACTERISTIC Arizona_base_GOAT_cal_impl.Cariagesecundair_P24 "" VALUE 0x00268320 Scalar_FLOAT64_IEEE 0 Arizona_base_GOAT_CM_double -1.7E+308 1.7E+308 /end CHARACTERISTIC
/begin CHARACTERISTIC Arizona_base_GOAT_cal_impl.Cariagesecundair_P3 "" VALUE 0x00268128 Scalar_FLOAT64_IEEE 0 Arizona_base_GOAT_CM_double -1.7E+308 1.7E+308 /end CHARACTERISTIC
/begin CHARACTERISTIC Arizona_base_GOAT_cal_impl.Cariagesecundair_P4 "" VALUE 0x00268140 Scalar_FLOAT64_IEEE 0 Arizona_base_GOAT_CM_double -1.7E+308 1.7E+308 /end CHARACTERISTIC
/begin CHARACTERISTIC Arizona_base_GOAT_cal_impl.Cariagesecundair_P5 "" VALUE 0x00268158 Scalar_FLOAT64_IEEE 0 Arizona_base_GOAT_CM_double -1.7E+308 1.7E+308 /end CHARACTERISTIC
/begin CHARACTERISTIC Arizona_base_GOAT_cal_impl.Cariagesecundair_P6 "" VALUE 0x00268170 Scalar_FLOAT64_IEEE 0 Arizona_base_GOAT_CM_double -1.7E+308 1.7E+308 /end CHARACTERISTIC
/begin CHARACTERISTIC Arizona_base_GOAT_cal_impl.Cariagesecundair_P7 "" VALUE 0x00268188 Scalar_FLOAT64_IEEE 0 Arizona_base_GOAT_CM_double -1.7E+308 1.7E+308 /end CHARACTERISTIC
/begin CHARACTERISTIC Arizona_base_GOAT_cal_impl.Cariagesecundair_P8 "" VALUE 0x002681A0 Scalar_FLOAT64_IEEE 0 Arizona_base_GOAT_CM_double -1.7E+308 1.7E+308 /end CHARACTERISTIC
/begin CHARACTERISTIC Arizona_base_GOAT_cal_impl.Cariagesecundair_P9 "" VALUE 0x002681B8 Scalar_FLOAT64_IEEE 0 Arizona_base_GOAT_CM_double -1.7E+308 1.7E+308 /end CHARACTERISTIC
/begin CHARACTERISTIC Arizona_base_GOAT_cal_impl.Carriageencoder_P1 "" VALUE 0x00267308 Scalar_FLOAT64_IEEE 0 Arizona_base_GOAT_CM_double -1.7E+308 1.7E+308 /end CHARACTERISTIC
/begin CHARACTERISTIC Arizona_base_GOAT_cal_impl.Carriageencoder_P10 "" VALUE 0x002673E0 Scalar_FLOAT64_IEEE 0 Arizona_base_GOAT_CM_double -1.7E+308 1.7E+308 /end CHARACTERISTIC
/begin CHARACTERISTIC Arizona_base_GOAT_cal_impl.Carriageencoder_P11 "" VALUE 0x002673F8 Scalar_FLOAT64_IEEE 0 Arizona_base_GOAT_CM_double -1.7E+308 1.7E+308 /end CHARACTERISTIC
/begin CHARACTERISTIC Arizona_base_GOAT_cal_impl.Carriageencoder_P12 "" VALUE 0x00267410 Scalar_FLOAT64_IEEE 0 Arizona_base_GOAT_CM_double -1.7E+308 1.7E+308 /end CHARACTERISTIC
/begin CHARACTERISTIC Arizona_base_GOAT_cal_impl.Carriageencoder_P13 "" VALUE 0x00267428 Scalar_FLOAT64_IEEE 0 Arizona_base_GOAT_CM_double -1.7E+308 1.7E+308 /end CHARACTERISTIC
/begin CHARACTERISTIC Arizona_base_GOAT_cal_impl.Carriageencoder_P14 "" VALUE 0x00267440 Scalar_FLOAT64_IEEE 0 Arizona_base_GOAT_CM_double -1.7E+308 1.7E+308 /end CHARACTERISTIC
/begin CHARACTERISTIC Arizona_base_GOAT_cal_impl.Carriageencoder_P15 "" VALUE 0x00267458 Scalar_FLOAT64_IEEE 0 Arizona_base_GOAT_CM_double -1.7E+308 1.7E+308 /end CHARACTERISTIC
/begin CHARACTERISTIC Arizona_base_GOAT_cal_impl.Carriageencoder_P16 "" VALUE 0x00267470 Scalar_FLOAT64_IEEE 0 Arizona_base_GOAT_CM_double -1.7E+308 1.7E+308 /end CHARACTERISTIC
/begin CHARACTERISTIC Arizona_base_GOAT_cal_impl.Carriageencoder_P17 "" VALUE 0x00267488 Scalar_FLOAT64_IEEE 0 Arizona_base_GOAT_CM_double -1.7E+308 1.7E+308 /end CHARACTERISTIC
/begin CHARACTERISTIC Arizona_base_GOAT_cal_impl.Carriageencoder_P18 "" VALUE 0x002674A0 Scalar_FLOAT64_IEEE 0 Arizona_base_GOAT_CM_double -1.7E+308 1.7E+308 /end CHARACTERISTIC
/begin CHARACTERISTIC Arizona_base_GOAT_cal_impl.Carriageencoder_P19 "" VALUE 0x002674B8 Scalar_FLOAT64_IEEE 0 Arizona_base_GOAT_CM_double -1.7E+308 1.7E+308 /end CHARACTERISTIC
/begin CHARACTERISTIC Arizona_base_GOAT_cal_impl.Carriageencoder_P2 "" VALUE 0x00267320 Scalar_FLOAT64_IEEE 0 Arizona_base_GOAT_CM_double -1.7E+308 1.7E+308 /end CHARACTERISTIC
/begin CHARACTERISTIC Arizona_base_GOAT_cal_impl.Carriageencoder_P20 "" VALUE 0x002674D0 Scalar_FLOAT64_IEEE 0 Arizona_base_GOAT_CM_double -1.7E+308 1.7E+308 /end CHARACTERISTIC
/begin CHARACTERISTIC Arizona_base_GOAT_cal_impl.Carriageencoder_P21 "" VALUE 0x002674E8 Scalar_FLOAT64_IEEE 0 Arizona_base_GOAT_CM_double -1.7E+308 1.7E+308 /end CHARACTERISTIC
/begin CHARACTERISTIC Arizona_base_GOAT_cal_impl.Carriageencoder_P22 "" VALUE 0x00267500 Scalar_FLOAT64_IEEE 0 Arizona_base_GOAT_CM_double -1.7E+308 1.7E+308 /end CHARACTERISTIC
/begin CHARACTERISTIC Arizona_base_GOAT_cal_impl.Carriageencoder_P23 "" VALUE 0x00267518 Scalar_FLOAT64_IEEE 0 Arizona_base_GOAT_CM_double -1.7E+308 1.7E+308 /end CHARACTERISTIC
/begin CHARACTERISTIC Arizona_base_GOAT_cal_impl.Carriageencoder_P24 "" VALUE 0x00267530 Scalar_FLOAT64_IEEE 0 Arizona_base_GOAT_CM_double -1.7E+308 1.7E+308 /end CHARACTERISTIC
/begin CHARACTERISTIC Arizona_base_GOAT_cal_impl.Carriageencoder_P3 "" VALUE 0x00267338 Scalar_FLOAT64_IEEE 0 Arizona_base_GOAT_CM_double -1.7E+308 1.7E+308 /end CHARACTERISTIC
/begin CHARACTERISTIC Arizona_base_GOAT_cal_impl.Carriageencoder_P4 "" VALUE 0x00267350 Scalar_FLOAT64_IEEE 0 Arizona_base_GOAT_CM_double -1.7E+308 1.7E+308 /end CHARACTERISTIC
/begin CHARACTERISTIC Arizona_base_GOAT_cal_impl.Carriageencoder_P5 "" VALUE 0x00267368 Scalar_FLOAT64_IEEE 0 Arizona_base_GOAT_CM_double -1.7E+308 1.7E+308 /end CHARACTERISTIC
/begin CHARACTERISTIC Arizona_base_GOAT_cal_impl.Carriageencoder_P6 "" VALUE 0x00267380 Scalar_FLOAT64_IEEE 0 Arizona_base_GOAT_CM_double -1.7E+308 1.7E+308 /end CHARACTERISTIC
/begin CHARACTERISTIC Arizona_base_GOAT_cal_impl.Carriageencoder_P7 "" VALUE 0x00267398 Scalar_FLOAT64_IEEE 0 Arizona_base_GOAT_CM_double -1.7E+308 1.7E+308 /end CHARACTERISTIC
/begin CHARACTERISTIC Arizona_base_GOAT_cal_impl.Carriageencoder_P8 "" VALUE 0x002673B0 Scalar_FLOAT64_IEEE 0 Arizona_base_GOAT_CM_double -1.7E+308 1.7E+308 /end CHARACTERISTIC
/begin CHARACTERISTIC Arizona_base_GOAT_cal_impl.Carriageencoder_P9 "" VALUE 0x002673C8 Scalar_FLOAT64_IEEE 0 Arizona_base_GOAT_CM_double -1.7E+308 1.7E+308 /end CHARACTERISTIC
/begin CHARACTERISTIC Arizona_base_GOAT_cal_impl.CompareToConstant_const "" VALUE 0x00222070 Scalar_FLOAT64_IEEE 0 Arizona_base_GOAT_CM_double -1.7E+308 1.7E+308 /end CHARACTERISTIC
/begin CHARACTERISTIC Arizona_base_GOAT_cal_impl.CompareToConstant_const_n "" VALUE 0x00222078 Scalar_FLOAT64_IEEE 0 Arizona_base_GOAT_CM_double -1.7E+308 1.7E+308 /end CHARACTERISTIC
/begin CHARACTERISTIC Arizona_base_GOAT_cal_impl.Constant1_Value "" VALUE 0x0023F558 Scalar_FLOAT64_IEEE 0 Arizona_base_GOAT_CM_double -1.7E+308 1.7E+308 /end CHARACTERISTIC
/begin CHARACTERISTIC Arizona_base_GOAT_cal_impl.Constant_Value "" VALUE 0x0023F560 Scalar_FLOAT64_IEEE 0 Arizona_base_GOAT_CM_double -1.7E+308 1.7E+308 /end CHARACTERISTIC
/begin CHARACTERISTIC Arizona_base_GOAT_cal_impl.Constant_Value_a "" VALUE 0x002667F8 Scalar_FLOAT64_IEEE 0 Arizona_base_GOAT_CM_double -1.7E+308 1.7E+308 /end CHARACTERISTIC
/begin CHARACTERISTIC Arizona_base_GOAT_cal_impl.Constant_Value_e "" VALUE 0x0023F6F0 Scalar_FLOAT64_IEEE 0 Arizona_base_GOAT_CM_double -1.7E+308 1.7E+308 /end CHARACTERISTIC
/begin CHARACTERISTIC Arizona_base_GOAT_cal_impl.Constant_Value_l "" VALUE 0x00266800 Scalar_FLOAT64_IEEE 0 Arizona_base_GOAT_CM_double -1.7E+308 1.7E+308 /end CHARACTERISTIC
/begin CHARACTERISTIC Arizona_base_GOAT_cal_impl.DILimitCarriage_P1 "" VALUE 0x00266E80 Scalar_FLOAT64_IEEE 0 Arizona_base_GOAT_CM_double -1.7E+308 1.7E+308 /end CHARACTERISTIC
/begin CHARACTERISTIC Arizona_base_GOAT_cal_impl.DILimitCarriage_P2 "" VALUE 0x00266E98 Scalar_FLOAT64_IEEE 0 Arizona_base_GOAT_CM_double -1.7E+308 1.7E+308 /end CHARACTERISTIC
/begin CHARACTERISTIC Arizona_base_GOAT_cal_impl.DILimitCarriage_P3 "" VALUE 0x00266EB0 Scalar_FLOAT64_IEEE 0 Arizona_base_GOAT_CM_double -1.7E+308 1.7E+308 /end CHARACTERISTIC
/begin CHARACTERISTIC Arizona_base_GOAT_cal_impl.DILimitCarriage_P4 "" VALUE 0x00266EC8 Scalar_FLOAT64_IEEE 0 Arizona_base_GOAT_CM_double -1.7E+308 1.7E+308 /end CHARACTERISTIC
/begin CHARACTERISTIC Arizona_base_GOAT_cal_impl.DILimitCarriage_P5 "" VALUE 0x00266EE0 Scalar_FLOAT64_IEEE 0 Arizona_base_GOAT_CM_double -1.7E+308 1.7E+308 /end CHARACTERISTIC
/begin CHARACTERISTIC Arizona_base_GOAT_cal_impl.DILimitCarriage_P6 "" VALUE 0x00266EF8 Scalar_FLOAT64_IEEE 0 Arizona_base_GOAT_CM_double -1.7E+308 1.7E+308 /end CHARACTERISTIC
/begin CHARACTERISTIC Arizona_base_GOAT_cal_impl.DILimitCarriagesecundairwerk_ix "" VALUE 0x00268818 Scalar_FLOAT64_IEEE 0 Arizona_base_GOAT_CM_double -1.7E+308 1.7E+308 /end CHARACTERISTIC
/begin CHARACTERISTIC Arizona_base_GOAT_cal_impl.DILimitCarriagesecundairwerk_nn "" VALUE 0x00268830 Scalar_FLOAT64_IEEE 0 Arizona_base_GOAT_CM_double -1.7E+308 1.7E+308 /end CHARACTERISTIC
/begin CHARACTERISTIC Arizona_base_GOAT_cal_impl.DILimitCarriagesecundairwerkt_a "" VALUE 0x002687E8 Scalar_FLOAT64_IEEE 0 Arizona_base_GOAT_CM_double -1.7E+308 1.7E+308 /end CHARACTERISTIC
/begin CHARACTERISTIC Arizona_base_GOAT_cal_impl.DILimitCarriagesecundairwerkt_g "" VALUE 0x00268848 Scalar_FLOAT64_IEEE 0 Arizona_base_GOAT_CM_double -1.7E+308 1.7E+308 /end CHARACTERISTIC
/begin CHARACTERISTIC Arizona_base_GOAT_cal_impl.DILimitCarriagesecundairwerkt_l "" VALUE 0x00268860 Scalar_FLOAT64_IEEE 0 Arizona_base_GOAT_CM_double -1.7E+308 1.7E+308 /end CHARACTERISTIC
/begin CHARACTERISTIC Arizona_base_GOAT_cal_impl.DILimitCarriagesecundairwerkt_n "" VALUE 0x00268800 Scalar_FLOAT64_IEEE 0 Arizona_base_GOAT_CM_double -1.7E+308 1.7E+308 /end CHARACTERISTIC
/begin CHARACTERISTIC Arizona_base_GOAT_cal_impl.DILimitGantryx1GantryxR_P1 "" VALUE 0x00266F10 Scalar_FLOAT64_IEEE 0 Arizona_base_GOAT_CM_double -1.7E+308 1.7E+308 /end CHARACTERISTIC
/begin CHARACTERISTIC Arizona_base_GOAT_cal_impl.DILimitGantryx1GantryxR_P2 "" VALUE 0x00266F28 Scalar_FLOAT64_IEEE 0 Arizona_base_GOAT_CM_double -1.7E+308 1.7E+308 /end CHARACTERISTIC
/begin CHARACTERISTIC Arizona_base_GOAT_cal_impl.DILimitGantryx1GantryxR_P3 "" VALUE 0x00266F40 Scalar_FLOAT64_IEEE 0 Arizona_base_GOAT_CM_double -1.7E+308 1.7E+308 /end CHARACTERISTIC
/begin CHARACTERISTIC Arizona_base_GOAT_cal_impl.DILimitGantryx1GantryxR_P4 "" VALUE 0x00266F58 Scalar_FLOAT64_IEEE 0 Arizona_base_GOAT_CM_double -1.7E+308 1.7E+308 /end CHARACTERISTIC
/begin CHARACTERISTIC Arizona_base_GOAT_cal_impl.DILimitGantryx1GantryxR_P5 "" VALUE 0x00266F70 Scalar_FLOAT64_IEEE 0 Arizona_base_GOAT_CM_double -1.7E+308 1.7E+308 /end CHARACTERISTIC
/begin CHARACTERISTIC Arizona_base_GOAT_cal_impl.DILimitGantryx1GantryxR_P6 "" VALUE 0x00266F88 Scalar_FLOAT64_IEEE 0 Arizona_base_GOAT_CM_double -1.7E+308 1.7E+308 /end CHARACTERISTIC
/begin CHARACTERISTIC Arizona_base_GOAT_cal_impl.DILimitGantryx1secundairGant_du "" VALUE 0x002688D8 Scalar_FLOAT64_IEEE 0 Arizona_base_GOAT_CM_double -1.7E+308 1.7E+308 /end CHARACTERISTIC
/begin CHARACTERISTIC Arizona_base_GOAT_cal_impl.DILimitGantryx1secundairGant_ir "" VALUE 0x002688F0 Scalar_FLOAT64_IEEE 0 Arizona_base_GOAT_CM_double -1.7E+308 1.7E+308 /end CHARACTERISTIC
/begin CHARACTERISTIC Arizona_base_GOAT_cal_impl.DILimitGantryx1secundairGant_ns "" VALUE 0x002688C0 Scalar_FLOAT64_IEEE 0 Arizona_base_GOAT_CM_double -1.7E+308 1.7E+308 /end CHARACTERISTIC
/begin CHARACTERISTIC Arizona_base_GOAT_cal_impl.DILimitGantryx1secundairGantr_b "" VALUE 0x002688A8 Scalar_FLOAT64_IEEE 0 Arizona_base_GOAT_CM_double -1.7E+308 1.7E+308 /end CHARACTERISTIC
/begin CHARACTERISTIC Arizona_base_GOAT_cal_impl.DILimitGantryx1secundairGantr_d "" VALUE 0x00268878 Scalar_FLOAT64_IEEE 0 Arizona_base_GOAT_CM_double -1.7E+308 1.7E+308 /end CHARACTERISTIC
/begin CHARACTERISTIC Arizona_base_GOAT_cal_impl.DILimitGantryx1secundairGantr_n "" VALUE 0x00268890 Scalar_FLOAT64_IEEE 0 Arizona_base_GOAT_CM_double -1.7E+308 1.7E+308 /end CHARACTERISTIC
/begin CHARACTERISTIC Arizona_base_GOAT_cal_impl.DILimitGantryx2GantryxL_P1 "" VALUE 0x00266FA0 Scalar_FLOAT64_IEEE 0 Arizona_base_GOAT_CM_double -1.7E+308 1.7E+308 /end CHARACTERISTIC
/begin CHARACTERISTIC Arizona_base_GOAT_cal_impl.DILimitGantryx2GantryxL_P2 "" VALUE 0x00266FB8 Scalar_FLOAT64_IEEE 0 Arizona_base_GOAT_CM_double -1.7E+308 1.7E+308 /end CHARACTERISTIC
/begin CHARACTERISTIC Arizona_base_GOAT_cal_impl.DILimitGantryx2GantryxL_P3 "" VALUE 0x00266FD0 Scalar_FLOAT64_IEEE 0 Arizona_base_GOAT_CM_double -1.7E+308 1.7E+308 /end CHARACTERISTIC
/begin CHARACTERISTIC Arizona_base_GOAT_cal_impl.DILimitGantryx2GantryxL_P4 "" VALUE 0x00266FE8 Scalar_FLOAT64_IEEE 0 Arizona_base_GOAT_CM_double -1.7E+308 1.7E+308 /end CHARACTERISTIC
/begin CHARACTERISTIC Arizona_base_GOAT_cal_impl.DILimitGantryx2GantryxL_P5 "" VALUE 0x00267000 Scalar_FLOAT64_IEEE 0 Arizona_base_GOAT_CM_double -1.7E+308 1.7E+308 /end CHARACTERISTIC
/begin CHARACTERISTIC Arizona_base_GOAT_cal_impl.DILimitGantryx2GantryxL_P6 "" VALUE 0x00267018 Scalar_FLOAT64_IEEE 0 Arizona_base_GOAT_CM_double -1.7E+308 1.7E+308 /end CHARACTERISTIC
/begin CHARACTERISTIC Arizona_base_GOAT_cal_impl.DILimitGantryx2secundairGant_dj "" VALUE 0x00268980 Scalar_FLOAT64_IEEE 0 Arizona_base_GOAT_CM_double -1.7E+308 1.7E+308 /end CHARACTERISTIC
/begin CHARACTERISTIC Arizona_base_GOAT_cal_impl.DILimitGantryx2secundairGantr_a "" VALUE 0x00268950 Scalar_FLOAT64_IEEE 0 Arizona_base_GOAT_CM_double -1.7E+308 1.7E+308 /end CHARACTERISTIC
/begin CHARACTERISTIC Arizona_base_GOAT_cal_impl.DILimitGantryx2secundairGantr_d "" VALUE 0x00268908 Scalar_FLOAT64_IEEE 0 Arizona_base_GOAT_CM_double -1.7E+308 1.7E+308 /end CHARACTERISTIC
/begin CHARACTERISTIC Arizona_base_GOAT_cal_impl.DILimitGantryx2secundairGantr_f "" VALUE 0x00268920 Scalar_FLOAT64_IEEE 0 Arizona_base_GOAT_CM_double -1.7E+308 1.7E+308 /end CHARACTERISTIC
/begin CHARACTERISTIC Arizona_base_GOAT_cal_impl.DILimitGantryx2secundairGantr_l "" VALUE 0x00268968 Scalar_FLOAT64_IEEE 0 Arizona_base_GOAT_CM_double -1.7E+308 1.7E+308 /end CHARACTERISTIC
/begin CHARACTERISTIC Arizona_base_GOAT_cal_impl.DILimitGantryx2secundairGantr_o "" VALUE 0x00268938 Scalar_FLOAT64_IEEE 0 Arizona_base_GOAT_CM_double -1.7E+308 1.7E+308 /end CHARACTERISTIC
/begin CHARACTERISTIC Arizona_base_GOAT_cal_impl.DIblacksoftwarebutton_P1 "" VALUE 0x00267030 Scalar_FLOAT64_IEEE 0 Arizona_base_GOAT_CM_double -1.7E+308 1.7E+308 /end CHARACTERISTIC
/begin CHARACTERISTIC Arizona_base_GOAT_cal_impl.DIblacksoftwarebutton_P2 "" VALUE 0x00267048 Scalar_FLOAT64_IEEE 0 Arizona_base_GOAT_CM_double -1.7E+308 1.7E+308 /end CHARACTERISTIC
/begin CHARACTERISTIC Arizona_base_GOAT_cal_impl.DIblacksoftwarebutton_P3 "" VALUE 0x00267060 Scalar_FLOAT64_IEEE 0 Arizona_base_GOAT_CM_double -1.7E+308 1.7E+308 /end CHARACTERISTIC
/begin CHARACTERISTIC Arizona_base_GOAT_cal_impl.DIblacksoftwarebutton_P4 "" VALUE 0x00267078 Scalar_FLOAT64_IEEE 0 Arizona_base_GOAT_CM_double -1.7E+308 1.7E+308 /end CHARACTERISTIC
/begin CHARACTERISTIC Arizona_base_GOAT_cal_impl.DIblacksoftwarebutton_P5 "" VALUE 0x00267090 Scalar_FLOAT64_IEEE 0 Arizona_base_GOAT_CM_double -1.7E+308 1.7E+308 /end CHARACTERISTIC
/begin CHARACTERISTIC Arizona_base_GOAT_cal_impl.DIblacksoftwarebutton_P6 "" VALUE 0x002670A8 Scalar_FLOAT64_IEEE 0 Arizona_base_GOAT_CM_double -1.7E+308 1.7E+308 /end CHARACTERISTIC
/begin CHARACTERISTIC Arizona_base_GOAT_cal_impl.DIcarriageampfaultstatus_P1 "" VALUE 0x002670C0 Scalar_FLOAT64_IEEE 0 Arizona_base_GOAT_CM_double -1.7E+308 1.7E+308 /end CHARACTERISTIC
/begin CHARACTERISTIC Arizona_base_GOAT_cal_impl.DIcarriageampfaultstatus_P2 "" VALUE 0x002670D8 Scalar_FLOAT64_IEEE 0 Arizona_base_GOAT_CM_double -1.7E+308 1.7E+308 /end CHARACTERISTIC
/begin CHARACTERISTIC Arizona_base_GOAT_cal_impl.DIcarriageampfaultstatus_P3 "" VALUE 0x002670F0 Scalar_FLOAT64_IEEE 0 Arizona_base_GOAT_CM_double -1.7E+308 1.7E+308 /end CHARACTERISTIC
/begin CHARACTERISTIC Arizona_base_GOAT_cal_impl.DIcarriageampfaultstatus_P4 "" VALUE 0x00267108 Scalar_FLOAT64_IEEE 0 Arizona_base_GOAT_CM_double -1.7E+308 1.7E+308 /end CHARACTERISTIC
/begin CHARACTERISTIC Arizona_base_GOAT_cal_impl.DIcarriageampfaultstatus_P5 "" VALUE 0x00267120 Scalar_FLOAT64_IEEE 0 Arizona_base_GOAT_CM_double -1.7E+308 1.7E+308 /end CHARACTERISTIC
/begin CHARACTERISTIC Arizona_base_GOAT_cal_impl.DIcarriageampfaultstatus_P6 "" VALUE 0x00267138 Scalar_FLOAT64_IEEE 0 Arizona_base_GOAT_CM_double -1.7E+308 1.7E+308 /end CHARACTERISTIC
/begin CHARACTERISTIC Arizona_base_GOAT_cal_impl.DIgantryx1faultstatus_P1 "" VALUE 0x00267150 Scalar_FLOAT64_IEEE 0 Arizona_base_GOAT_CM_double -1.7E+308 1.7E+308 /end CHARACTERISTIC
/begin CHARACTERISTIC Arizona_base_GOAT_cal_impl.DIgantryx1faultstatus_P2 "" VALUE 0x00267168 Scalar_FLOAT64_IEEE 0 Arizona_base_GOAT_CM_double -1.7E+308 1.7E+308 /end CHARACTERISTIC
/begin CHARACTERISTIC Arizona_base_GOAT_cal_impl.DIgantryx1faultstatus_P3 "" VALUE 0x00267180 Scalar_FLOAT64_IEEE 0 Arizona_base_GOAT_CM_double -1.7E+308 1.7E+308 /end CHARACTERISTIC
/begin CHARACTERISTIC Arizona_base_GOAT_cal_impl.DIgantryx1faultstatus_P4 "" VALUE 0x00267198 Scalar_FLOAT64_IEEE 0 Arizona_base_GOAT_CM_double -1.7E+308 1.7E+308 /end CHARACTERISTIC
/begin CHARACTERISTIC Arizona_base_GOAT_cal_impl.DIgantryx1faultstatus_P5 "" VALUE 0x002671B0 Scalar_FLOAT64_IEEE 0 Arizona_base_GOAT_CM_double -1.7E+308 1.7E+308 /end CHARACTERISTIC
/begin CHARACTERISTIC Arizona_base_GOAT_cal_impl.DIgantryx1faultstatus_P6 "" VALUE 0x002671C8 Scalar_FLOAT64_IEEE 0 Arizona_base_GOAT_CM_double -1.7E+308 1.7E+308 /end CHARACTERISTIC
/begin CHARACTERISTIC Arizona_base_GOAT_cal_impl.DIgantryx2faultstatus_P1 "" VALUE 0x002671E0 Scalar_FLOAT64_IEEE 0 Arizona_base_GOAT_CM_double -1.7E+308 1.7E+308 /end CHARACTERISTIC
/begin CHARACTERISTIC Arizona_base_GOAT_cal_impl.DIgantryx2faultstatus_P2 "" VALUE 0x002671F8 Scalar_FLOAT64_IEEE 0 Arizona_base_GOAT_CM_double -1.7E+308 1.7E+308 /end CHARACTERISTIC
/begin CHARACTERISTIC Arizona_base_GOAT_cal_impl.DIgantryx2faultstatus_P3 "" VALUE 0x00267210 Scalar_FLOAT64_IEEE 0 Arizona_base_GOAT_CM_double -1.7E+308 1.7E+308 /end CHARACTERISTIC
/begin CHARACTERISTIC Arizona_base_GOAT_cal_impl.DIgantryx2faultstatus_P4 "" VALUE 0x00267228 Scalar_FLOAT64_IEEE 0 Arizona_base_GOAT_CM_double -1.7E+308 1.7E+308 /end CHARACTERISTIC
/begin CHARACTERISTIC Arizona_base_GOAT_cal_impl.DIgantryx2faultstatus_P5 "" VALUE 0x00267240 Scalar_FLOAT64_IEEE 0 Arizona_base_GOAT_CM_double -1.7E+308 1.7E+308 /end CHARACTERISTIC
/begin CHARACTERISTIC Arizona_base_GOAT_cal_impl.DIgantryx2faultstatus_P6 "" VALUE 0x00267258 Scalar_FLOAT64_IEEE 0 Arizona_base_GOAT_CM_double -1.7E+308 1.7E+308 /end CHARACTERISTIC
/begin CHARACTERISTIC Arizona_base_GOAT_cal_impl.DIredsoftwarebutton_P1 "" VALUE 0x00267270 Scalar_FLOAT64_IEEE 0 Arizona_base_GOAT_CM_double -1.7E+308 1.7E+308 /end CHARACTERISTIC
/begin CHARACTERISTIC Arizona_base_GOAT_cal_impl.DIredsoftwarebutton_P2 "" VALUE 0x00267288 Scalar_FLOAT64_IEEE 0 Arizona_base_GOAT_CM_double -1.7E+308 1.7E+308 /end CHARACTERISTIC
/begin CHARACTERISTIC Arizona_base_GOAT_cal_impl.DIredsoftwarebutton_P3 "" VALUE 0x002672A0 Scalar_FLOAT64_IEEE 0 Arizona_base_GOAT_CM_double -1.7E+308 1.7E+308 /end CHARACTERISTIC
/begin CHARACTERISTIC Arizona_base_GOAT_cal_impl.DIredsoftwarebutton_P4 "" VALUE 0x002672B8 Scalar_FLOAT64_IEEE 0 Arizona_base_GOAT_CM_double -1.7E+308 1.7E+308 /end CHARACTERISTIC
/begin CHARACTERISTIC Arizona_base_GOAT_cal_impl.DIredsoftwarebutton_P5 "" VALUE 0x002672D0 Scalar_FLOAT64_IEEE 0 Arizona_base_GOAT_CM_double -1.7E+308 1.7E+308 /end CHARACTERISTIC
/begin CHARACTERISTIC Arizona_base_GOAT_cal_impl.DIredsoftwarebutton_P6 "" VALUE 0x002672E8 Scalar_FLOAT64_IEEE 0 Arizona_base_GOAT_CM_double -1.7E+308 1.7E+308 /end CHARACTERISTIC
/begin CHARACTERISTIC Arizona_base_GOAT_cal_impl.DOInhibitCarriage_P1 "" VALUE 0x00267EA8 Scalar_FLOAT64_IEEE 0 Arizona_base_GOAT_CM_double -1.7E+308 1.7E+308 /end CHARACTERISTIC
/begin CHARACTERISTIC Arizona_base_GOAT_cal_impl.DOInhibitCarriage_P2 "" VALUE 0x00267EC0 Scalar_FLOAT64_IEEE 0 Arizona_base_GOAT_CM_double -1.7E+308 1.7E+308 /end CHARACTERISTIC
/begin CHARACTERISTIC Arizona_base_GOAT_cal_impl.DOInhibitCarriage_P3 "" VALUE 0x00267ED8 Scalar_FLOAT64_IEEE 0 Arizona_base_GOAT_CM_double -1.7E+308 1.7E+308 /end CHARACTERISTIC
/begin CHARACTERISTIC Arizona_base_GOAT_cal_impl.DOInhibitCarriage_P4 "" VALUE 0x00267EF0 Scalar_FLOAT64_IEEE 0 Arizona_base_GOAT_CM_double -1.7E+308 1.7E+308 /end CHARACTERISTIC
/begin CHARACTERISTIC Arizona_base_GOAT_cal_impl.DOInhibitCarriage_P5 "" VALUE 0x00267F08 Scalar_FLOAT64_IEEE 0 Arizona_base_GOAT_CM_double -1.7E+308 1.7E+308 /end CHARACTERISTIC
/begin CHARACTERISTIC Arizona_base_GOAT_cal_impl.DOInhibitCarriage_P6 "" VALUE 0x00267F20 Scalar_FLOAT64_IEEE 0 Arizona_base_GOAT_CM_double -1.7E+308 1.7E+308 /end CHARACTERISTIC
/begin CHARACTERISTIC Arizona_base_GOAT_cal_impl.DOInhibitCarriage_P7 "" VALUE 0x00267F38 Scalar_FLOAT64_IEEE 0 Arizona_base_GOAT_CM_double -1.7E+308 1.7E+308 /end CHARACTERISTIC
/begin CHARACTERISTIC Arizona_base_GOAT_cal_impl.DOInhibitCarriage_P8 "" VALUE 0x00267F50 Scalar_FLOAT64_IEEE 0 Arizona_base_GOAT_CM_double -1.7E+308 1.7E+308 /end CHARACTERISTIC
/begin CHARACTERISTIC Arizona_base_GOAT_cal_impl.DOInhibitGantryx1GantryxR_P1 "" VALUE 0x00267F70 Scalar_FLOAT64_IEEE 0 Arizona_base_GOAT_CM_double -1.7E+308 1.7E+308 /end CHARACTERISTIC
/begin CHARACTERISTIC Arizona_base_GOAT_cal_impl.DOInhibitGantryx1GantryxR_P2 "" VALUE 0x00267F88 Scalar_FLOAT64_IEEE 0 Arizona_base_GOAT_CM_double -1.7E+308 1.7E+308 /end CHARACTERISTIC
/begin CHARACTERISTIC Arizona_base_GOAT_cal_impl.DOInhibitGantryx1GantryxR_P3 "" VALUE 0x00267FA0 Scalar_FLOAT64_IEEE 0 Arizona_base_GOAT_CM_double -1.7E+308 1.7E+308 /end CHARACTERISTIC
/begin CHARACTERISTIC Arizona_base_GOAT_cal_impl.DOInhibitGantryx1GantryxR_P4 "" VALUE 0x00267FB8 Scalar_FLOAT64_IEEE 0 Arizona_base_GOAT_CM_double -1.7E+308 1.7E+308 /end CHARACTERISTIC
/begin CHARACTERISTIC Arizona_base_GOAT_cal_impl.DOInhibitGantryx1GantryxR_P5 "" VALUE 0x00267FD0 Scalar_FLOAT64_IEEE 0 Arizona_base_GOAT_CM_double -1.7E+308 1.7E+308 /end CHARACTERISTIC
/begin CHARACTERISTIC Arizona_base_GOAT_cal_impl.DOInhibitGantryx1GantryxR_P6 "" VALUE 0x00267FE8 Scalar_FLOAT64_IEEE 0 Arizona_base_GOAT_CM_double -1.7E+308 1.7E+308 /end CHARACTERISTIC
/begin CHARACTERISTIC Arizona_base_GOAT_cal_impl.DOInhibitGantryx1GantryxR_P7 "" VALUE 0x00268000 Scalar_FLOAT64_IEEE 0 Arizona_base_GOAT_CM_double -1.7E+308 1.7E+308 /end CHARACTERISTIC
/begin CHARACTERISTIC Arizona_base_GOAT_cal_impl.DOInhibitGantryx1GantryxR_P8 "" VALUE 0x00268018 Scalar_FLOAT64_IEEE 0 Arizona_base_GOAT_CM_double -1.7E+308 1.7E+308 /end CHARACTERISTIC
/begin CHARACTERISTIC Arizona_base_GOAT_cal_impl.DOInhibitGantryx2DOGantryxL_P1 "" VALUE 0x00268038 Scalar_FLOAT64_IEEE 0 Arizona_base_GOAT_CM_double -1.7E+308 1.7E+308 /end CHARACTERISTIC
/begin CHARACTERISTIC Arizona_base_GOAT_cal_impl.DOInhibitGantryx2DOGantryxL_P2 "" VALUE 0x00268050 Scalar_FLOAT64_IEEE 0 Arizona_base_GOAT_CM_double -1.7E+308 1.7E+308 /end CHARACTERISTIC
/begin CHARACTERISTIC Arizona_base_GOAT_cal_impl.DOInhibitGantryx2DOGantryxL_P3 "" VALUE 0x00268068 Scalar_FLOAT64_IEEE 0 Arizona_base_GOAT_CM_double -1.7E+308 1.7E+308 /end CHARACTERISTIC
/begin CHARACTERISTIC Arizona_base_GOAT_cal_impl.DOInhibitGantryx2DOGantryxL_P4 "" VALUE 0x00268080 Scalar_FLOAT64_IEEE 0 Arizona_base_GOAT_CM_double -1.7E+308 1.7E+308 /end CHARACTERISTIC
/begin CHARACTERISTIC Arizona_base_GOAT_cal_impl.DOInhibitGantryx2DOGantryxL_P5 "" VALUE 0x00268098 Scalar_FLOAT64_IEEE 0 Arizona_base_GOAT_CM_double -1.7E+308 1.7E+308 /end CHARACTERISTIC
/begin CHARACTERISTIC Arizona_base_GOAT_cal_impl.DOInhibitGantryx2DOGantryxL_P6 "" VALUE 0x002680B0 Scalar_FLOAT64_IEEE 0 Arizona_base_GOAT_CM_double -1.7E+308 1.7E+308 /end CHARACTERISTIC
/begin CHARACTERISTIC Arizona_base_GOAT_cal_impl.DOInhibitGantryx2DOGantryxL_P7 "" VALUE 0x002680C8 Scalar_FLOAT64_IEEE 0 Arizona_base_GOAT_CM_double -1.7E+308 1.7E+308 /end CHARACTERISTIC
/begin CHARACTERISTIC Arizona_base_GOAT_cal_impl.DOInhibitGantryx2DOGantryxL_P8 "" VALUE 0x002680E0 Scalar_FLOAT64_IEEE 0 Arizona_base_GOAT_CM_double -1.7E+308 1.7E+308 /end CHARACTERISTIC
/begin CHARACTERISTIC Arizona_base_GOAT_cal_impl.Dct2lowpasscurrent_carriageAi_c "" VALUE 0x00267C40 Scalar_FLOAT64_IEEE 0 Arizona_base_GOAT_CM_double -1.7E+308 1.7E+308 /end CHARACTERISTIC
/begin CHARACTERISTIC Arizona_base_GOAT_cal_impl.Dct2lowpasscurrent_carriageAi_l "" VALUE 0x00267C58 Scalar_FLOAT64_IEEE 0 Arizona_base_GOAT_CM_double -1.7E+308 1.7E+308 /end CHARACTERISTIC
/begin CHARACTERISTIC Arizona_base_GOAT_cal_impl.Dct2lowpasscurrent_carriageAi_n "" VALUE 0x00267C70 Scalar_FLOAT64_IEEE 0 Arizona_base_GOAT_CM_double -1.7E+308 1.7E+308 /end CHARACTERISTIC
/begin CHARACTERISTIC Arizona_base_GOAT_cal_impl.Dct2lowpasscurrent_gantryAirb_a "" VALUE 0x00267B58 Scalar_FLOAT64_IEEE 0 Arizona_base_GOAT_CM_double -1.7E+308 1.7E+308 /end CHARACTERISTIC
/begin CHARACTERISTIC Arizona_base_GOAT_cal_impl.Dct2lowpasscurrent_gantryAirb_e "" VALUE 0x00267B28 Scalar_FLOAT64_IEEE 0 Arizona_base_GOAT_CM_double -1.7E+308 1.7E+308 /end CHARACTERISTIC
/begin CHARACTERISTIC Arizona_base_GOAT_cal_impl.Dct2lowpasscurrent_gantryAirb_m "" VALUE 0x00267B40 Scalar_FLOAT64_IEEE 0 Arizona_base_GOAT_CM_double -1.7E+308 1.7E+308 /end CHARACTERISTIC
/begin CHARACTERISTIC Arizona_base_GOAT_cal_impl.Dct2lowpassoutput_x_P1 "" VALUE 0x00267AB0 Scalar_FLOAT64_IEEE 0 Arizona_base_GOAT_CM_double -1.7E+308 1.7E+308 /end CHARACTERISTIC
/begin CHARACTERISTIC Arizona_base_GOAT_cal_impl.Dct2lowpassoutput_x_P2 "" VALUE 0x00267AC8 Scalar_FLOAT64_IEEE 0 Arizona_base_GOAT_CM_double -1.7E+308 1.7E+308 /end CHARACTERISTIC
/begin CHARACTERISTIC Arizona_base_GOAT_cal_impl.Dct2lowpassoutput_x_P3 "" VALUE 0x00267AE0 Scalar_FLOAT64_IEEE 0 Arizona_base_GOAT_CM_double -1.7E+308 1.7E+308 /end CHARACTERISTIC
/begin CHARACTERISTIC Arizona_base_GOAT_cal_impl.Dct2lowpassoutput_y_P1 "" VALUE 0x00267A38 Scalar_FLOAT64_IEEE 0 Arizona_base_GOAT_CM_double -1.7E+308 1.7E+308 /end CHARACTERISTIC
/begin CHARACTERISTIC Arizona_base_GOAT_cal_impl.Dct2lowpassoutput_y_P2 "" VALUE 0x00267A50 Scalar_FLOAT64_IEEE 0 Arizona_base_GOAT_CM_double -1.7E+308 1.7E+308 /end CHARACTERISTIC
/begin CHARACTERISTIC Arizona_base_GOAT_cal_impl.Dct2lowpassoutput_y_P3 "" VALUE 0x00267A68 Scalar_FLOAT64_IEEE 0 Arizona_base_GOAT_CM_double -1.7E+308 1.7E+308 /end CHARACTERISTIC
/begin CHARACTERISTIC Arizona_base_GOAT_cal_impl.Dct2lowpassx1JogSpeed_P1 "" VALUE 0x0023F5E8 Scalar_FLOAT64_IEEE 0 Arizona_base_GOAT_CM_double -1.7E+308 1.7E+308 /end CHARACTERISTIC
/begin CHARACTERISTIC Arizona_base_GOAT_cal_impl.Dct2lowpassx1JogSpeed_P2 "" VALUE 0x0023F600 Scalar_FLOAT64_IEEE 0 Arizona_base_GOAT_CM_double -1.7E+308 1.7E+308 /end CHARACTERISTIC
/begin CHARACTERISTIC Arizona_base_GOAT_cal_impl.Dct2lowpassx1JogSpeed_P3 "" VALUE 0x0023F618 Scalar_FLOAT64_IEEE 0 Arizona_base_GOAT_CM_double -1.7E+308 1.7E+308 /end CHARACTERISTIC
/begin CHARACTERISTIC Arizona_base_GOAT_cal_impl.Dct2lowpassx2JogSpeed_P1 "" VALUE 0x0023F630 Scalar_FLOAT64_IEEE 0 Arizona_base_GOAT_CM_double -1.7E+308 1.7E+308 /end CHARACTERISTIC
/begin CHARACTERISTIC Arizona_base_GOAT_cal_impl.Dct2lowpassx2JogSpeed_P2 "" VALUE 0x0023F648 Scalar_FLOAT64_IEEE 0 Arizona_base_GOAT_CM_double -1.7E+308 1.7E+308 /end CHARACTERISTIC
/begin CHARACTERISTIC Arizona_base_GOAT_cal_impl.Dct2lowpassx2JogSpeed_P3 "" VALUE 0x0023F660 Scalar_FLOAT64_IEEE 0 Arizona_base_GOAT_CM_double -1.7E+308 1.7E+308 /end CHARACTERISTIC
/begin CHARACTERISTIC Arizona_base_GOAT_cal_impl.Dct2lowpassyJogSpeed_P1 "" VALUE 0x0023F678 Scalar_FLOAT64_IEEE 0 Arizona_base_GOAT_CM_double -1.7E+308 1.7E+308 /end CHARACTERISTIC
/begin CHARACTERISTIC Arizona_base_GOAT_cal_impl.Dct2lowpassyJogSpeed_P2 "" VALUE 0x0023F690 Scalar_FLOAT64_IEEE 0 Arizona_base_GOAT_CM_double -1.7E+308 1.7E+308 /end CHARACTERISTIC
/begin CHARACTERISTIC Arizona_base_GOAT_cal_impl.Dct2lowpassyJogSpeed_P3 "" VALUE 0x0023F6A8 Scalar_FLOAT64_IEEE 0 Arizona_base_GOAT_CM_double -1.7E+308 1.7E+308 /end CHARACTERISTIC
/begin CHARACTERISTIC Arizona_base_GOAT_cal_impl.Delay1_InitialCondition "" VALUE 0x00267A00 Scalar_FLOAT64_IEEE 0 Arizona_base_GOAT_CM_double -1.7E+308 1.7E+308 /end CHARACTERISTIC
/begin CHARACTERISTIC Arizona_base_GOAT_cal_impl.Delay1_InitialCondition_l "" VALUE 0x00267AF0 Scalar_FLOAT64_IEEE 0 Arizona_base_GOAT_CM_double -1.7E+308 1.7E+308 /end CHARACTERISTIC
/begin CHARACTERISTIC Arizona_base_GOAT_cal_impl.Delay1_InitialCondition_m "" VALUE 0x00267A18 Scalar_FLOAT64_IEEE 0 Arizona_base_GOAT_CM_double -1.7E+308 1.7E+308 /end CHARACTERISTIC
/begin CHARACTERISTIC Arizona_base_GOAT_cal_impl.Delay1_InitialCondition_mu "" VALUE 0x00267A78 Scalar_FLOAT64_IEEE 0 Arizona_base_GOAT_CM_double -1.7E+308 1.7E+308 /end CHARACTERISTIC
/begin CHARACTERISTIC Arizona_base_GOAT_cal_impl.Delay2_InitialCondition "" VALUE 0x002679F8 Scalar_FLOAT64_IEEE 0 Arizona_base_GOAT_CM_double -1.7E+308 1.7E+308 /end CHARACTERISTIC
/begin CHARACTERISTIC Arizona_base_GOAT_cal_impl.Delay_InitialCondition "" VALUE 0x0023F588 Scalar_FLOAT64_IEEE 0 Arizona_base_GOAT_CM_double -1.7E+308 1.7E+308 /end CHARACTERISTIC
/begin CHARACTERISTIC Arizona_base_GOAT_cal_impl.Delay_InitialCondition_a "" VALUE 0x00267AF8 Scalar_FLOAT64_IEEE 0 Arizona_base_GOAT_CM_double -1.7E+308 1.7E+308 /end CHARACTERISTIC
/begin CHARACTERISTIC Arizona_base_GOAT_cal_impl.Delay_InitialCondition_d "" VALUE 0x00267A80 Scalar_FLOAT64_IEEE 0 Arizona_base_GOAT_CM_double -1.7E+308 1.7E+308 /end CHARACTERISTIC
/begin CHARACTERISTIC Arizona_base_GOAT_cal_impl.Delay_InitialCondition_g "" VALUE 0x00268A59 Scalar_BOOLEAN 0 Arizona_base_GOAT_CM_logical 0 1 /end CHARACTERISTIC
/begin CHARACTERISTIC Arizona_base_GOAT_cal_impl.Delay_InitialCondition_o "" VALUE 0x00267A08 Scalar_FLOAT64_IEEE 0 Arizona_base_GOAT_CM_double -1.7E+308 1.7E+308 /end CHARACTERISTIC
/begin CHARACTERISTIC Arizona_base_GOAT_cal_impl.DiscreteDerivativeoutput_x_ICPr "" VALUE 0x00222068 Scalar_FLOAT64_IEEE 0 Arizona_base_GOAT_CM_double -1.7E+308 1.7E+308 /end CHARACTERISTIC
/begin CHARACTERISTIC Arizona_base_GOAT_cal_impl.DiscreteDerivativeoutput_y_ICPr "" VALUE 0x00222060 Scalar_FLOAT64_IEEE 0 Arizona_base_GOAT_CM_double -1.7E+308 1.7E+308 /end CHARACTERISTIC
/begin CHARACTERISTIC Arizona_base_GOAT_cal_impl.DiscreteTimeIntegratorx1JogSp_k "" VALUE 0x0023F5C0 Scalar_FLOAT64_IEEE 0 Arizona_base_GOAT_CM_double -1.7E+308 1.7E+308 /end CHARACTERISTIC
/begin CHARACTERISTIC Arizona_base_GOAT_cal_impl.DiscreteTimeIntegratorx1JogSpee "" VALUE 0x0023F5B8 Scalar_FLOAT64_IEEE 0 Arizona_base_GOAT_CM_double -1.7E+308 1.7E+308 /end CHARACTERISTIC
/begin CHARACTERISTIC Arizona_base_GOAT_cal_impl.DiscreteTimeIntegratorx2JogSp_e "" VALUE 0x0023F5B0 Scalar_FLOAT64_IEEE 0 Arizona_base_GOAT_CM_double -1.7E+308 1.7E+308 /end CHARACTERISTIC
/begin CHARACTERISTIC Arizona_base_GOAT_cal_impl.DiscreteTimeIntegratorx2JogSp_m "" VALUE 0x0023F5A0 Scalar_FLOAT64_IEEE 0 Arizona_base_GOAT_CM_double -1.7E+308 1.7E+308 /end CHARACTERISTIC
/begin CHARACTERISTIC Arizona_base_GOAT_cal_impl.DiscreteTimeIntegratorx2JogSp_n "" VALUE 0x0023F5A8 Scalar_FLOAT64_IEEE 0 Arizona_base_GOAT_CM_double -1.7E+308 1.7E+308 /end CHARACTERISTIC
/begin CHARACTERISTIC Arizona_base_GOAT_cal_impl.DiscreteTimeIntegratorx2JogSpee "" VALUE 0x0023F598 Scalar_FLOAT64_IEEE 0 Arizona_base_GOAT_CM_double -1.7E+308 1.7E+308 /end CHARACTERISTIC
/begin CHARACTERISTIC Arizona_base_GOAT_cal_impl.Enable_amplifier_xL_Value "" VALUE 0x00268020 Scalar_FLOAT64_IEEE 0 Arizona_base_GOAT_CM_double -1.7E+308 1.7E+308 /end CHARACTERISTIC
/begin CHARACTERISTIC Arizona_base_GOAT_cal_impl.Enable_amplifier_xR_Value "" VALUE 0x00267F58 Scalar_FLOAT64_IEEE 0 Arizona_base_GOAT_CM_double -1.7E+308 1.7E+308 /end CHARACTERISTIC
/begin CHARACTERISTIC Arizona_base_GOAT_cal_impl.Enable_amplifier_y_Value "" VALUE 0x00267E90 Scalar_FLOAT64_IEEE 0 Arizona_base_GOAT_CM_double -1.7E+308 1.7E+308 /end CHARACTERISTIC
/begin CHARACTERISTIC Arizona_base_GOAT_cal_impl.Gain10_Gain "" VALUE 0x00267B10 Scalar_FLOAT64_IEEE 0 Arizona_base_GOAT_CM_double -1.7E+308 1.7E+308 /end CHARACTERISTIC
/begin CHARACTERISTIC Arizona_base_GOAT_cal_impl.Gain10_Gain_n "" VALUE 0x002687D0 Scalar_FLOAT64_IEEE 0 Arizona_base_GOAT_CM_double -1.7E+308 1.7E+308 /end CHARACTERISTIC
/begin CHARACTERISTIC Arizona_base_GOAT_cal_impl.Gain1_Gain "" VALUE 0x002672F0 Scalar_FLOAT64_IEEE 0 Arizona_base_GOAT_CM_double -1.7E+308 1.7E+308 /end CHARACTERISTIC
/begin CHARACTERISTIC Arizona_base_GOAT_cal_impl.Gain1_Gain_i "" VALUE 0x00268A20 Scalar_FLOAT64_IEEE 0 Arizona_base_GOAT_CM_double -1.7E+308 1.7E+308 /end CHARACTERISTIC
/begin CHARACTERISTIC Arizona_base_GOAT_cal_impl.Gain1_Gain_o "" VALUE 0x002689D8 Scalar_FLOAT64_IEEE 0 Arizona_base_GOAT_CM_double -1.7E+308 1.7E+308 /end CHARACTERISTIC
/begin CHARACTERISTIC Arizona_base_GOAT_cal_impl.Gain5_Gain "" VALUE 0x00267540 Scalar_FLOAT64_IEEE 0 Arizona_base_GOAT_CM_double -1.7E+308 1.7E+308 /end CHARACTERISTIC
/begin CHARACTERISTIC Arizona_base_GOAT_cal_impl.Gain6_Gain "" VALUE 0x00267790 Scalar_FLOAT64_IEEE 0 Arizona_base_GOAT_CM_double -1.7E+308 1.7E+308 /end CHARACTERISTIC
/begin CHARACTERISTIC Arizona_base_GOAT_cal_impl.Gain7_Gain "" VALUE 0x002679E0 Scalar_FLOAT64_IEEE 0 Arizona_base_GOAT_CM_double -1.7E+308 1.7E+308 /end CHARACTERISTIC
/begin CHARACTERISTIC Arizona_base_GOAT_cal_impl.Gain8_Gain "" VALUE 0x00267A20 Scalar_FLOAT64_IEEE 0 Arizona_base_GOAT_CM_double -1.7E+308 1.7E+308 /end CHARACTERISTIC
/begin CHARACTERISTIC Arizona_base_GOAT_cal_impl.Gain8_Gain_c "" VALUE 0x00268A40 Scalar_FLOAT64_IEEE 0 Arizona_base_GOAT_CM_double -1.7E+308 1.7E+308 /end CHARACTERISTIC
/begin CHARACTERISTIC Arizona_base_GOAT_cal_impl.Gain8_Gain_e "" VALUE 0x002689F8 Scalar_FLOAT64_IEEE 0 Arizona_base_GOAT_CM_double -1.7E+308 1.7E+308 /end CHARACTERISTIC
/begin CHARACTERISTIC Arizona_base_GOAT_cal_impl.Gain8_Gain_l "" VALUE 0x00268330 Scalar_FLOAT64_IEEE 0 Arizona_base_GOAT_CM_double -1.7E+308 1.7E+308 /end CHARACTERISTIC
/begin CHARACTERISTIC Arizona_base_GOAT_cal_impl.Gain9_Gain "" VALUE 0x00267A98 Scalar_FLOAT64_IEEE 0 Arizona_base_GOAT_CM_double -1.7E+308 1.7E+308 /end CHARACTERISTIC
/begin CHARACTERISTIC Arizona_base_GOAT_cal_impl.Gain9_Gain_j "" VALUE 0x00268580 Scalar_FLOAT64_IEEE 0 Arizona_base_GOAT_CM_double -1.7E+308 1.7E+308 /end CHARACTERISTIC
/begin CHARACTERISTIC Arizona_base_GOAT_cal_impl.Gain_Gain "" VALUE 0x002679E8 Scalar_FLOAT64_IEEE 0 Arizona_base_GOAT_CM_double -1.7E+308 1.7E+308 /end CHARACTERISTIC
/begin CHARACTERISTIC Arizona_base_GOAT_cal_impl.Gain_Gain_c "" VALUE 0x002689E8 Scalar_FLOAT64_IEEE 0 Arizona_base_GOAT_CM_double -1.7E+308 1.7E+308 /end CHARACTERISTIC
/begin CHARACTERISTIC Arizona_base_GOAT_cal_impl.Gain_Gain_f "" VALUE 0x00268A30 Scalar_FLOAT64_IEEE 0 Arizona_base_GOAT_CM_double -1.7E+308 1.7E+308 /end CHARACTERISTIC
/begin CHARACTERISTIC Arizona_base_GOAT_cal_impl.Gaincarriagemotorcurrent_Gain "" VALUE 0x00267CC0 Scalar_FLOAT64_IEEE 0 Arizona_base_GOAT_CM_double -1.7E+308 1.7E+308 /end CHARACTERISTIC
/begin CHARACTERISTIC Arizona_base_GOAT_cal_impl.Gaingantryx2motorcurrent1_Gain "" VALUE 0x00267C20 Scalar_FLOAT64_IEEE 0 Arizona_base_GOAT_CM_double -1.7E+308 1.7E+308 /end CHARACTERISTIC
/begin CHARACTERISTIC Arizona_base_GOAT_cal_impl.Gaingantryx2motorcurrent_Gain "" VALUE 0x00267C28 Scalar_FLOAT64_IEEE 0 Arizona_base_GOAT_CM_double -1.7E+308 1.7E+308 /end CHARACTERISTIC
/begin CHARACTERISTIC Arizona_base_GOAT_cal_impl.Gainonphi2_Gain "" VALUE 0x002689C8 Scalar_FLOAT64_IEEE 0 Arizona_base_GOAT_CM_double -1.7E+308 1.7E+308 /end CHARACTERISTIC
/begin CHARACTERISTIC Arizona_base_GOAT_cal_impl.Gainonphi3_Gain "" VALUE 0x00268A10 Scalar_FLOAT64_IEEE 0 Arizona_base_GOAT_CM_double -1.7E+308 1.7E+308 /end CHARACTERISTIC
/begin CHARACTERISTIC Arizona_base_GOAT_cal_impl.Gainonu_phi_Gain "" VALUE 0x00267C18 Scalar_FLOAT64_IEEE 0 Arizona_base_GOAT_CM_double -1.7E+308 1.7E+308 /end CHARACTERISTIC
/begin CHARACTERISTIC Arizona_base_GOAT_cal_impl.Gainonu_x_Gain "" VALUE 0x00267BA8 Scalar_FLOAT64_IEEE 0 Arizona_base_GOAT_CM_double -1.7E+308 1.7E+308 /end CHARACTERISTIC
/begin CHARACTERISTIC Arizona_base_GOAT_cal_impl.Gainphi_Gain "" VALUE 0x00267B08 Scalar_FLOAT64_IEEE 0 Arizona_base_GOAT_CM_double -1.7E+308 1.7E+308 /end CHARACTERISTIC
/begin CHARACTERISTIC Arizona_base_GOAT_cal_impl.Gainx2_Gain "" VALUE 0x0023F5C8 Scalar_FLOAT64_IEEE 0 Arizona_base_GOAT_CM_double -1.7E+308 1.7E+308 /end CHARACTERISTIC
/begin CHARACTERISTIC Arizona_base_GOAT_cal_impl.Gainx3_Gain "" VALUE 0x0023F5D0 Scalar_FLOAT64_IEEE 0 Arizona_base_GOAT_CM_double -1.7E+308 1.7E+308 /end CHARACTERISTIC
/begin CHARACTERISTIC Arizona_base_GOAT_cal_impl.Gainx_Gain "" VALUE 0x00267A90 Scalar_FLOAT64_IEEE 0 Arizona_base_GOAT_CM_double -1.7E+308 1.7E+308 /end CHARACTERISTIC
/begin CHARACTERISTIC Arizona_base_GOAT_cal_impl.GantryX1secundair_P1 "" VALUE 0x00268348 Scalar_FLOAT64_IEEE 0 Arizona_base_GOAT_CM_double -1.7E+308 1.7E+308 /end CHARACTERISTIC
/begin CHARACTERISTIC Arizona_base_GOAT_cal_impl.GantryX1secundair_P10 "" VALUE 0x00268420 Scalar_FLOAT64_IEEE 0 Arizona_base_GOAT_CM_double -1.7E+308 1.7E+308 /end CHARACTERISTIC
/begin CHARACTERISTIC Arizona_base_GOAT_cal_impl.GantryX1secundair_P11 "" VALUE 0x00268438 Scalar_FLOAT64_IEEE 0 Arizona_base_GOAT_CM_double -1.7E+308 1.7E+308 /end CHARACTERISTIC
/begin CHARACTERISTIC Arizona_base_GOAT_cal_impl.GantryX1secundair_P12 "" VALUE 0x00268450 Scalar_FLOAT64_IEEE 0 Arizona_base_GOAT_CM_double -1.7E+308 1.7E+308 /end CHARACTERISTIC
/begin CHARACTERISTIC Arizona_base_GOAT_cal_impl.GantryX1secundair_P13 "" VALUE 0x00268468 Scalar_FLOAT64_IEEE 0 Arizona_base_GOAT_CM_double -1.7E+308 1.7E+308 /end CHARACTERISTIC
/begin CHARACTERISTIC Arizona_base_GOAT_cal_impl.GantryX1secundair_P14 "" VALUE 0x00268480 Scalar_FLOAT64_IEEE 0 Arizona_base_GOAT_CM_double -1.7E+308 1.7E+308 /end CHARACTERISTIC
/begin CHARACTERISTIC Arizona_base_GOAT_cal_impl.GantryX1secundair_P15 "" VALUE 0x00268498 Scalar_FLOAT64_IEEE 0 Arizona_base_GOAT_CM_double -1.7E+308 1.7E+308 /end CHARACTERISTIC
/begin CHARACTERISTIC Arizona_base_GOAT_cal_impl.GantryX1secundair_P16 "" VALUE 0x002684B0 Scalar_FLOAT64_IEEE 0 Arizona_base_GOAT_CM_double -1.7E+308 1.7E+308 /end CHARACTERISTIC
/begin CHARACTERISTIC Arizona_base_GOAT_cal_impl.GantryX1secundair_P17 "" VALUE 0x002684C8 Scalar_FLOAT64_IEEE 0 Arizona_base_GOAT_CM_double -1.7E+308 1.7E+308 /end CHARACTERISTIC
/begin CHARACTERISTIC Arizona_base_GOAT_cal_impl.GantryX1secundair_P18 "" VALUE 0x002684E0 Scalar_FLOAT64_IEEE 0 Arizona_base_GOAT_CM_double -1.7E+308 1.7E+308 /end CHARACTERISTIC
/begin CHARACTERISTIC Arizona_base_GOAT_cal_impl.GantryX1secundair_P19 "" VALUE 0x002684F8 Scalar_FLOAT64_IEEE 0 Arizona_base_GOAT_CM_double -1.7E+308 1.7E+308 /end CHARACTERISTIC
/begin CHARACTERISTIC Arizona_base_GOAT_cal_impl.GantryX1secundair_P2 "" VALUE 0x00268360 Scalar_FLOAT64_IEEE 0 Arizona_base_GOAT_CM_double -1.7E+308 1.7E+308 /end CHARACTERISTIC
/begin CHARACTERISTIC Arizona_base_GOAT_cal_impl.GantryX1secundair_P20 "" VALUE 0x00268510 Scalar_FLOAT64_IEEE 0 Arizona_base_GOAT_CM_double -1.7E+308 1.7E+308 /end CHARACTERISTIC
/begin CHARACTERISTIC Arizona_base_GOAT_cal_impl.GantryX1secundair_P21 "" VALUE 0x00268528 Scalar_FLOAT64_IEEE 0 Arizona_base_GOAT_CM_double -1.7E+308 1.7E+308 /end CHARACTERISTIC
/begin CHARACTERISTIC Arizona_base_GOAT_cal_impl.GantryX1secundair_P22 "" VALUE 0x00268540 Scalar_FLOAT64_IEEE 0 Arizona_base_GOAT_CM_double -1.7E+308 1.7E+308 /end CHARACTERISTIC
/begin CHARACTERISTIC Arizona_base_GOAT_cal_impl.GantryX1secundair_P23 "" VALUE 0x00268558 Scalar_FLOAT64_IEEE 0 Arizona_base_GOAT_CM_double -1.7E+308 1.7E+308 /end CHARACTERISTIC
/begin CHARACTERISTIC Arizona_base_GOAT_cal_impl.GantryX1secundair_P24 "" VALUE 0x00268570 Scalar_FLOAT64_IEEE 0 Arizona_base_GOAT_CM_double -1.7E+308 1.7E+308 /end CHARACTERISTIC
/begin CHARACTERISTIC Arizona_base_GOAT_cal_impl.GantryX1secundair_P3 "" VALUE 0x00268378 Scalar_FLOAT64_IEEE 0 Arizona_base_GOAT_CM_double -1.7E+308 1.7E+308 /end CHARACTERISTIC
/begin CHARACTERISTIC Arizona_base_GOAT_cal_impl.GantryX1secundair_P4 "" VALUE 0x00268390 Scalar_FLOAT64_IEEE 0 Arizona_base_GOAT_CM_double -1.7E+308 1.7E+308 /end CHARACTERISTIC
/begin CHARACTERISTIC Arizona_base_GOAT_cal_impl.GantryX1secundair_P5 "" VALUE 0x002683A8 Scalar_FLOAT64_IEEE 0 Arizona_base_GOAT_CM_double -1.7E+308 1.7E+308 /end CHARACTERISTIC
/begin CHARACTERISTIC Arizona_base_GOAT_cal_impl.GantryX1secundair_P6 "" VALUE 0x002683C0 Scalar_FLOAT64_IEEE 0 Arizona_base_GOAT_CM_double -1.7E+308 1.7E+308 /end CHARACTERISTIC
/begin CHARACTERISTIC Arizona_base_GOAT_cal_impl.GantryX1secundair_P7 "" VALUE 0x002683D8 Scalar_FLOAT64_IEEE 0 Arizona_base_GOAT_CM_double -1.7E+308 1.7E+308 /end CHARACTERISTIC
/begin CHARACTERISTIC Arizona_base_GOAT_cal_impl.GantryX1secundair_P8 "" VALUE 0x002683F0 Scalar_FLOAT64_IEEE 0 Arizona_base_GOAT_CM_double -1.7E+308 1.7E+308 /end CHARACTERISTIC
/begin CHARACTERISTIC Arizona_base_GOAT_cal_impl.GantryX1secundair_P9 "" VALUE 0x00268408 Scalar_FLOAT64_IEEE 0 Arizona_base_GOAT_CM_double -1.7E+308 1.7E+308 /end CHARACTERISTIC
/begin CHARACTERISTIC Arizona_base_GOAT_cal_impl.Gantryx1GantryxR_P1 "" VALUE 0x00267558 Scalar_FLOAT64_IEEE 0 Arizona_base_GOAT_CM_double -1.7E+308 1.7E+308 /end CHARACTERISTIC
/begin CHARACTERISTIC Arizona_base_GOAT_cal_impl.Gantryx1GantryxR_P10 "" VALUE 0x00267630 Scalar_FLOAT64_IEEE 0 Arizona_base_GOAT_CM_double -1.7E+308 1.7E+308 /end CHARACTERISTIC
/begin CHARACTERISTIC Arizona_base_GOAT_cal_impl.Gantryx1GantryxR_P11 "" VALUE 0x00267648 Scalar_FLOAT64_IEEE 0 Arizona_base_GOAT_CM_double -1.7E+308 1.7E+308 /end CHARACTERISTIC
/begin CHARACTERISTIC Arizona_base_GOAT_cal_impl.Gantryx1GantryxR_P12 "" VALUE 0x00267660 Scalar_FLOAT64_IEEE 0 Arizona_base_GOAT_CM_double -1.7E+308 1.7E+308 /end CHARACTERISTIC
/begin CHARACTERISTIC Arizona_base_GOAT_cal_impl.Gantryx1GantryxR_P13 "" VALUE 0x00267678 Scalar_FLOAT64_IEEE 0 Arizona_base_GOAT_CM_double -1.7E+308 1.7E+308 /end CHARACTERISTIC
/begin CHARACTERISTIC Arizona_base_GOAT_cal_impl.Gantryx1GantryxR_P14 "" VALUE 0x00267690 Scalar_FLOAT64_IEEE 0 Arizona_base_GOAT_CM_double -1.7E+308 1.7E+308 /end CHARACTERISTIC
/begin CHARACTERISTIC Arizona_base_GOAT_cal_impl.Gantryx1GantryxR_P15 "" VALUE 0x002676A8 Scalar_FLOAT64_IEEE 0 Arizona_base_GOAT_CM_double -1.7E+308 1.7E+308 /end CHARACTERISTIC
/begin CHARACTERISTIC Arizona_base_GOAT_cal_impl.Gantryx1GantryxR_P16 "" VALUE 0x002676C0 Scalar_FLOAT64_IEEE 0 Arizona_base_GOAT_CM_double -1.7E+308 1.7E+308 /end CHARACTERISTIC
/begin CHARACTERISTIC Arizona_base_GOAT_cal_impl.Gantryx1GantryxR_P17 "" VALUE 0x002676D8 Scalar_FLOAT64_IEEE 0 Arizona_base_GOAT_CM_double -1.7E+308 1.7E+308 /end CHARACTERISTIC
/begin CHARACTERISTIC Arizona_base_GOAT_cal_impl.Gantryx1GantryxR_P18 "" VALUE 0x002676F0 Scalar_FLOAT64_IEEE 0 Arizona_base_GOAT_CM_double -1.7E+308 1.7E+308 /end CHARACTERISTIC
/begin CHARACTERISTIC Arizona_base_GOAT_cal_impl.Gantryx1GantryxR_P19 "" VALUE 0x00267708 Scalar_FLOAT64_IEEE 0 Arizona_base_GOAT_CM_double -1.7E+308 1.7E+308 /end CHARACTERISTIC
/begin CHARACTERISTIC Arizona_base_GOAT_cal_impl.Gantryx1GantryxR_P2 "" VALUE 0x00267570 Scalar_FLOAT64_IEEE 0 Arizona_base_GOAT_CM_double -1.7E+308 1.7E+308 /end CHARACTERISTIC
/begin CHARACTERISTIC Arizona_base_GOAT_cal_impl.Gantryx1GantryxR_P20 "" VALUE 0x00267720 Scalar_FLOAT64_IEEE 0 Arizona_base_GOAT_CM_double -1.7E+308 1.7E+308 /end CHARACTERISTIC
/begin CHARACTERISTIC Arizona_base_GOAT_cal_impl.Gantryx1GantryxR_P21 "" VALUE 0x00267738 Scalar_FLOAT64_IEEE 0 Arizona_base_GOAT_CM_double -1.7E+308 1.7E+308 /end CHARACTERISTIC
/begin CHARACTERISTIC Arizona_base_GOAT_cal_impl.Gantryx1GantryxR_P22 "" VALUE 0x00267750 Scalar_FLOAT64_IEEE 0 Arizona_base_GOAT_CM_double -1.7E+308 1.7E+308 /end CHARACTERISTIC
/begin CHARACTERISTIC Arizona_base_GOAT_cal_impl.Gantryx1GantryxR_P23 "" VALUE 0x00267768 Scalar_FLOAT64_IEEE 0 Arizona_base_GOAT_CM_double -1.7E+308 1.7E+308 /end CHARACTERISTIC
/begin CHARACTERISTIC Arizona_base_GOAT_cal_impl.Gantryx1GantryxR_P24 "" VALUE 0x00267780 Scalar_FLOAT64_IEEE 0 Arizona_base_GOAT_CM_double -1.7E+308 1.7E+308 /end CHARACTERISTIC
/begin CHARACTERISTIC Arizona_base_GOAT_cal_impl.Gantryx1GantryxR_P3 "" VALUE 0x00267588 Scalar_FLOAT64_IEEE 0 Arizona_base_GOAT_CM_double -1.7E+308 1.7E+308 /end CHARACTERISTIC
/begin CHARACTERISTIC Arizona_base_GOAT_cal_impl.Gantryx1GantryxR_P4 "" VALUE 0x002675A0 Scalar_FLOAT64_IEEE 0 Arizona_base_GOAT_CM_double -1.7E+308 1.7E+308 /end CHARACTERISTIC
/begin CHARACTERISTIC Arizona_base_GOAT_cal_impl.Gantryx1GantryxR_P5 "" VALUE 0x002675B8 Scalar_FLOAT64_IEEE 0 Arizona_base_GOAT_CM_double -1.7E+308 1.7E+308 /end CHARACTERISTIC
/begin CHARACTERISTIC Arizona_base_GOAT_cal_impl.Gantryx1GantryxR_P6 "" VALUE 0x002675D0 Scalar_FLOAT64_IEEE 0 Arizona_base_GOAT_CM_double -1.7E+308 1.7E+308 /end CHARACTERISTIC
/begin CHARACTERISTIC Arizona_base_GOAT_cal_impl.Gantryx1GantryxR_P7 "" VALUE 0x002675E8 Scalar_FLOAT64_IEEE 0 Arizona_base_GOAT_CM_double -1.7E+308 1.7E+308 /end CHARACTERISTIC
/begin CHARACTERISTIC Arizona_base_GOAT_cal_impl.Gantryx1GantryxR_P8 "" VALUE 0x00267600 Scalar_FLOAT64_IEEE 0 Arizona_base_GOAT_CM_double -1.7E+308 1.7E+308 /end CHARACTERISTIC
/begin CHARACTERISTIC Arizona_base_GOAT_cal_impl.Gantryx1GantryxR_P9 "" VALUE 0x00267618 Scalar_FLOAT64_IEEE 0 Arizona_base_GOAT_CM_double -1.7E+308 1.7E+308 /end CHARACTERISTIC
/begin CHARACTERISTIC Arizona_base_GOAT_cal_impl.Gantryx2GantryxL_P1 "" VALUE 0x002677A8 Scalar_FLOAT64_IEEE 0 Arizona_base_GOAT_CM_double -1.7E+308 1.7E+308 /end CHARACTERISTIC
/begin CHARACTERISTIC Arizona_base_GOAT_cal_impl.Gantryx2GantryxL_P10 "" VALUE 0x00267880 Scalar_FLOAT64_IEEE 0 Arizona_base_GOAT_CM_double -1.7E+308 1.7E+308 /end CHARACTERISTIC
/begin CHARACTERISTIC Arizona_base_GOAT_cal_impl.Gantryx2GantryxL_P11 "" VALUE 0x00267898 Scalar_FLOAT64_IEEE 0 Arizona_base_GOAT_CM_double -1.7E+308 1.7E+308 /end CHARACTERISTIC
/begin CHARACTERISTIC Arizona_base_GOAT_cal_impl.Gantryx2GantryxL_P12 "" VALUE 0x002678B0 Scalar_FLOAT64_IEEE 0 Arizona_base_GOAT_CM_double -1.7E+308 1.7E+308 /end CHARACTERISTIC
/begin CHARACTERISTIC Arizona_base_GOAT_cal_impl.Gantryx2GantryxL_P13 "" VALUE 0x002678C8 Scalar_FLOAT64_IEEE 0 Arizona_base_GOAT_CM_double -1.7E+308 1.7E+308 /end CHARACTERISTIC
/begin CHARACTERISTIC Arizona_base_GOAT_cal_impl.Gantryx2GantryxL_P14 "" VALUE 0x002678E0 Scalar_FLOAT64_IEEE 0 Arizona_base_GOAT_CM_double -1.7E+308 1.7E+308 /end CHARACTERISTIC
/begin CHARACTERISTIC Arizona_base_GOAT_cal_impl.Gantryx2GantryxL_P15 "" VALUE 0x002678F8 Scalar_FLOAT64_IEEE 0 Arizona_base_GOAT_CM_double -1.7E+308 1.7E+308 /end CHARACTERISTIC
/begin CHARACTERISTIC Arizona_base_GOAT_cal_impl.Gantryx2GantryxL_P16 "" VALUE 0x00267910 Scalar_FLOAT64_IEEE 0 Arizona_base_GOAT_CM_double -1.7E+308 1.7E+308 /end CHARACTERISTIC
/begin CHARACTERISTIC Arizona_base_GOAT_cal_impl.Gantryx2GantryxL_P17 "" VALUE 0x00267928 Scalar_FLOAT64_IEEE 0 Arizona_base_GOAT_CM_double -1.7E+308 1.7E+308 /end CHARACTERISTIC
/begin CHARACTERISTIC Arizona_base_GOAT_cal_impl.Gantryx2GantryxL_P18 "" VALUE 0x00267940 Scalar_FLOAT64_IEEE 0 Arizona_base_GOAT_CM_double -1.7E+308 1.7E+308 /end CHARACTERISTIC
/begin CHARACTERISTIC Arizona_base_GOAT_cal_impl.Gantryx2GantryxL_P19 "" VALUE 0x00267958 Scalar_FLOAT64_IEEE 0 Arizona_base_GOAT_CM_double -1.7E+308 1.7E+308 /end CHARACTERISTIC
/begin CHARACTERISTIC Arizona_base_GOAT_cal_impl.Gantryx2GantryxL_P2 "" VALUE 0x002677C0 Scalar_FLOAT64_IEEE 0 Arizona_base_GOAT_CM_double -1.7E+308 1.7E+308 /end CHARACTERISTIC
/begin CHARACTERISTIC Arizona_base_GOAT_cal_impl.Gantryx2GantryxL_P20 "" VALUE 0x00267970 Scalar_FLOAT64_IEEE 0 Arizona_base_GOAT_CM_double -1.7E+308 1.7E+308 /end CHARACTERISTIC
/begin CHARACTERISTIC Arizona_base_GOAT_cal_impl.Gantryx2GantryxL_P21 "" VALUE 0x00267988 Scalar_FLOAT64_IEEE 0 Arizona_base_GOAT_CM_double -1.7E+308 1.7E+308 /end CHARACTERISTIC
/begin CHARACTERISTIC Arizona_base_GOAT_cal_impl.Gantryx2GantryxL_P22 "" VALUE 0x002679A0 Scalar_FLOAT64_IEEE 0 Arizona_base_GOAT_CM_double -1.7E+308 1.7E+308 /end CHARACTERISTIC
/begin CHARACTERISTIC Arizona_base_GOAT_cal_impl.Gantryx2GantryxL_P23 "" VALUE 0x002679B8 Scalar_FLOAT64_IEEE 0 Arizona_base_GOAT_CM_double -1.7E+308 1.7E+308 /end CHARACTERISTIC
/begin CHARACTERISTIC Arizona_base_GOAT_cal_impl.Gantryx2GantryxL_P24 "" VALUE 0x002679D0 Scalar_FLOAT64_IEEE 0 Arizona_base_GOAT_CM_double -1.7E+308 1.7E+308 /end CHARACTERISTIC
/begin CHARACTERISTIC Arizona_base_GOAT_cal_impl.Gantryx2GantryxL_P3 "" VALUE 0x002677D8 Scalar_FLOAT64_IEEE 0 Arizona_base_GOAT_CM_double -1.7E+308 1.7E+308 /end CHARACTERISTIC
/begin CHARACTERISTIC Arizona_base_GOAT_cal_impl.Gantryx2GantryxL_P4 "" VALUE 0x002677F0 Scalar_FLOAT64_IEEE 0 Arizona_base_GOAT_CM_double -1.7E+308 1.7E+308 /end CHARACTERISTIC
/begin CHARACTERISTIC Arizona_base_GOAT_cal_impl.Gantryx2GantryxL_P5 "" VALUE 0x00267808 Scalar_FLOAT64_IEEE 0 Arizona_base_GOAT_CM_double -1.7E+308 1.7E+308 /end CHARACTERISTIC
/begin CHARACTERISTIC Arizona_base_GOAT_cal_impl.Gantryx2GantryxL_P6 "" VALUE 0x00267820 Scalar_FLOAT64_IEEE 0 Arizona_base_GOAT_CM_double -1.7E+308 1.7E+308 /end CHARACTERISTIC
/begin CHARACTERISTIC Arizona_base_GOAT_cal_impl.Gantryx2GantryxL_P7 "" VALUE 0x00267838 Scalar_FLOAT64_IEEE 0 Arizona_base_GOAT_CM_double -1.7E+308 1.7E+308 /end CHARACTERISTIC
/begin CHARACTERISTIC Arizona_base_GOAT_cal_impl.Gantryx2GantryxL_P8 "" VALUE 0x00267850 Scalar_FLOAT64_IEEE 0 Arizona_base_GOAT_CM_double -1.7E+308 1.7E+308 /end CHARACTERISTIC
/begin CHARACTERISTIC Arizona_base_GOAT_cal_impl.Gantryx2GantryxL_P9 "" VALUE 0x00267868 Scalar_FLOAT64_IEEE 0 Arizona_base_GOAT_CM_double -1.7E+308 1.7E+308 /end CHARACTERISTIC
/begin CHARACTERISTIC Arizona_base_GOAT_cal_impl.GentryX2secundair_P1 "" VALUE 0x00268598 Scalar_FLOAT64_IEEE 0 Arizona_base_GOAT_CM_double -1.7E+308 1.7E+308 /end CHARACTERISTIC
/begin CHARACTERISTIC Arizona_base_GOAT_cal_impl.GentryX2secundair_P10 "" VALUE 0x00268670 Scalar_FLOAT64_IEEE 0 Arizona_base_GOAT_CM_double -1.7E+308 1.7E+308 /end CHARACTERISTIC
/begin CHARACTERISTIC Arizona_base_GOAT_cal_impl.GentryX2secundair_P11 "" VALUE 0x00268688 Scalar_FLOAT64_IEEE 0 Arizona_base_GOAT_CM_double -1.7E+308 1.7E+308 /end CHARACTERISTIC
/begin CHARACTERISTIC Arizona_base_GOAT_cal_impl.GentryX2secundair_P12 "" VALUE 0x002686A0 Scalar_FLOAT64_IEEE 0 Arizona_base_GOAT_CM_double -1.7E+308 1.7E+308 /end CHARACTERISTIC
/begin CHARACTERISTIC Arizona_base_GOAT_cal_impl.GentryX2secundair_P13 "" VALUE 0x002686B8 Scalar_FLOAT64_IEEE 0 Arizona_base_GOAT_CM_double -1.7E+308 1.7E+308 /end CHARACTERISTIC
/begin CHARACTERISTIC Arizona_base_GOAT_cal_impl.GentryX2secundair_P14 "" VALUE 0x002686D0 Scalar_FLOAT64_IEEE 0 Arizona_base_GOAT_CM_double -1.7E+308 1.7E+308 /end CHARACTERISTIC
/begin CHARACTERISTIC Arizona_base_GOAT_cal_impl.GentryX2secundair_P15 "" VALUE 0x002686E8 Scalar_FLOAT64_IEEE 0 Arizona_base_GOAT_CM_double -1.7E+308 1.7E+308 /end CHARACTERISTIC
/begin CHARACTERISTIC Arizona_base_GOAT_cal_impl.GentryX2secundair_P16 "" VALUE 0x00268700 Scalar_FLOAT64_IEEE 0 Arizona_base_GOAT_CM_double -1.7E+308 1.7E+308 /end CHARACTERISTIC
/begin CHARACTERISTIC Arizona_base_GOAT_cal_impl.GentryX2secundair_P17 "" VALUE 0x00268718 Scalar_FLOAT64_IEEE 0 Arizona_base_GOAT_CM_double -1.7E+308 1.7E+308 /end CHARACTERISTIC
/begin CHARACTERISTIC Arizona_base_GOAT_cal_impl.GentryX2secundair_P18 "" VALUE 0x00268730 Scalar_FLOAT64_IEEE 0 Arizona_base_GOAT_CM_double -1.7E+308 1.7E+308 /end CHARACTERISTIC
/begin CHARACTERISTIC Arizona_base_GOAT_cal_impl.GentryX2secundair_P19 "" VALUE 0x00268748 Scalar_FLOAT64_IEEE 0 Arizona_base_GOAT_CM_double -1.7E+308 1.7E+308 /end CHARACTERISTIC
/begin CHARACTERISTIC Arizona_base_GOAT_cal_impl.GentryX2secundair_P2 "" VALUE 0x002685B0 Scalar_FLOAT64_IEEE 0 Arizona_base_GOAT_CM_double -1.7E+308 1.7E+308 /end CHARACTERISTIC
/begin CHARACTERISTIC Arizona_base_GOAT_cal_impl.GentryX2secundair_P20 "" VALUE 0x00268760 Scalar_FLOAT64_IEEE 0 Arizona_base_GOAT_CM_double -1.7E+308 1.7E+308 /end CHARACTERISTIC
/begin CHARACTERISTIC Arizona_base_GOAT_cal_impl.GentryX2secundair_P21 "" VALUE 0x00268778 Scalar_FLOAT64_IEEE 0 Arizona_base_GOAT_CM_double -1.7E+308 1.7E+308 /end CHARACTERISTIC
/begin CHARACTERISTIC Arizona_base_GOAT_cal_impl.GentryX2secundair_P22 "" VALUE 0x00268790 Scalar_FLOAT64_IEEE 0 Arizona_base_GOAT_CM_double -1.7E+308 1.7E+308 /end CHARACTERISTIC
/begin CHARACTERISTIC Arizona_base_GOAT_cal_impl.GentryX2secundair_P23 "" VALUE 0x002687A8 Scalar_FLOAT64_IEEE 0 Arizona_base_GOAT_CM_double -1.7E+308 1.7E+308 /end CHARACTERISTIC
/begin CHARACTERISTIC Arizona_base_GOAT_cal_impl.GentryX2secundair_P24 "" VALUE 0x002687C0 Scalar_FLOAT64_IEEE 0 Arizona_base_GOAT_CM_double -1.7E+308 1.7E+308 /end CHARACTERISTIC
/begin CHARACTERISTIC Arizona_base_GOAT_cal_impl.GentryX2secundair_P3 "" VALUE 0x002685C8 Scalar_FLOAT64_IEEE 0 Arizona_base_GOAT_CM_double -1.7E+308 1.7E+308 /end CHARACTERISTIC
/begin CHARACTERISTIC Arizona_base_GOAT_cal_impl.GentryX2secundair_P4 "" VALUE 0x002685E0 Scalar_FLOAT64_IEEE 0 Arizona_base_GOAT_CM_double -1.7E+308 1.7E+308 /end CHARACTERISTIC
/begin CHARACTERISTIC Arizona_base_GOAT_cal_impl.GentryX2secundair_P5 "" VALUE 0x002685F8 Scalar_FLOAT64_IEEE 0 Arizona_base_GOAT_CM_double -1.7E+308 1.7E+308 /end CHARACTERISTIC
/begin CHARACTERISTIC Arizona_base_GOAT_cal_impl.GentryX2secundair_P6 "" VALUE 0x00268610 Scalar_FLOAT64_IEEE 0 Arizona_base_GOAT_CM_double -1.7E+308 1.7E+308 /end CHARACTERISTIC
/begin CHARACTERISTIC Arizona_base_GOAT_cal_impl.GentryX2secundair_P7 "" VALUE 0x00268628 Scalar_FLOAT64_IEEE 0 Arizona_base_GOAT_CM_double -1.7E+308 1.7E+308 /end CHARACTERISTIC
/begin CHARACTERISTIC Arizona_base_GOAT_cal_impl.GentryX2secundair_P8 "" VALUE 0x00268640 Scalar_FLOAT64_IEEE 0 Arizona_base_GOAT_CM_double -1.7E+308 1.7E+308 /end CHARACTERISTIC
/begin CHARACTERISTIC Arizona_base_GOAT_cal_impl.GentryX2secundair_P9 "" VALUE 0x00268658 Scalar_FLOAT64_IEEE 0 Arizona_base_GOAT_CM_double -1.7E+308 1.7E+308 /end CHARACTERISTIC
/begin CHARACTERISTIC Arizona_base_GOAT_cal_impl.Internal_A "" VAL_BLK 0x00267B60 Scalar_FLOAT64_IEEE 0 Arizona_base_GOAT_CM_double -1.7E+308 1.7E+308 MATRIX_DIM 1 3 /end CHARACTERISTIC
/begin CHARACTERISTIC Arizona_base_GOAT_cal_impl.Internal_A_g "" VAL_BLK 0x00267C78 Scalar_FLOAT64_IEEE 0 Arizona_base_GOAT_CM_double -1.7E+308 1.7E+308 MATRIX_DIM 1 3 /end CHARACTERISTIC
/begin CHARACTERISTIC Arizona_base_GOAT_cal_impl.Internal_A_p "" VAL_BLK 0x00267BB0 Scalar_FLOAT64_IEEE 0 Arizona_base_GOAT_CM_double -1.7E+308 1.7E+308 MATRIX_DIM 1 6 /end CHARACTERISTIC
/begin CHARACTERISTIC Arizona_base_GOAT_cal_impl.Internal_B "" VAL_BLK 0x00267B78 Scalar_FLOAT64_IEEE 0 Arizona_base_GOAT_CM_double -1.7E+308 1.7E+308 MATRIX_DIM 1 2 /end CHARACTERISTIC
/begin CHARACTERISTIC Arizona_base_GOAT_cal_impl.Internal_B_g "" VAL_BLK 0x00267BE0 Scalar_FLOAT64_IEEE 0 Arizona_base_GOAT_CM_double -1.7E+308 1.7E+308 MATRIX_DIM 1 2 /end CHARACTERISTIC
/begin CHARACTERISTIC Arizona_base_GOAT_cal_impl.Internal_B_j "" VAL_BLK 0x00267C90 Scalar_FLOAT64_IEEE 0 Arizona_base_GOAT_CM_double -1.7E+308 1.7E+308 MATRIX_DIM 1 2 /end CHARACTERISTIC
/begin CHARACTERISTIC Arizona_base_GOAT_cal_impl.Internal_C "" VAL_BLK 0x00267B88 Scalar_FLOAT64_IEEE 0 Arizona_base_GOAT_CM_double -1.7E+308 1.7E+308 MATRIX_DIM 1 2 /end CHARACTERISTIC
/begin CHARACTERISTIC Arizona_base_GOAT_cal_impl.Internal_C_i "" VAL_BLK 0x00267BF0 Scalar_FLOAT64_IEEE 0 Arizona_base_GOAT_CM_double -1.7E+308 1.7E+308 MATRIX_DIM 1 3 /end CHARACTERISTIC
/begin CHARACTERISTIC Arizona_base_GOAT_cal_impl.Internal_C_l "" VAL_BLK 0x00267CA0 Scalar_FLOAT64_IEEE 0 Arizona_base_GOAT_CM_double -1.7E+308 1.7E+308 MATRIX_DIM 1 2 /end CHARACTERISTIC
/begin CHARACTERISTIC Arizona_base_GOAT_cal_impl.Internal_D "" VALUE 0x00267B98 Scalar_FLOAT64_IEEE 0 Arizona_base_GOAT_CM_double -1.7E+308 1.7E+308 /end CHARACTERISTIC
/begin CHARACTERISTIC Arizona_base_GOAT_cal_impl.Internal_D_f "" VALUE 0x00267CB0 Scalar_FLOAT64_IEEE 0 Arizona_base_GOAT_CM_double -1.7E+308 1.7E+308 /end CHARACTERISTIC
/begin CHARACTERISTIC Arizona_base_GOAT_cal_impl.Internal_D_g "" VALUE 0x00267C08 Scalar_FLOAT64_IEEE 0 Arizona_base_GOAT_CM_double -1.7E+308 1.7E+308 /end CHARACTERISTIC
/begin CHARACTERISTIC Arizona_base_GOAT_cal_impl.Internal_InitialCondition "" VALUE 0x00267BA0 Scalar_FLOAT64_IEEE 0 Arizona_base_GOAT_CM_double -1.7E+308 1.7E+308 /end CHARACTERISTIC
/begin CHARACTERISTIC Arizona_base_GOAT_cal_impl.Internal_InitialCondition_e "" VALUE 0x00267C10 Scalar_FLOAT64_IEEE 0 Arizona_base_GOAT_CM_double -1.7E+308 1.7E+308 /end CHARACTERISTIC
/begin CHARACTERISTIC Arizona_base_GOAT_cal_impl.Internal_InitialCondition_o "" VALUE 0x00267CB8 Scalar_FLOAT64_IEEE 0 Arizona_base_GOAT_CM_double -1.7E+308 1.7E+308 /end CHARACTERISTIC
/begin CHARACTERISTIC Arizona_base_GOAT_cal_impl.Memory_InitialCondition "" VALUE 0x0023F6C0 Scalar_FLOAT64_IEEE 0 Arizona_base_GOAT_CM_double -1.7E+308 1.7E+308 /end CHARACTERISTIC
/begin CHARACTERISTIC Arizona_base_GOAT_cal_impl.PWM1_Value "" VALUE 0x002689F0 Scalar_FLOAT64_IEEE 0 Arizona_base_GOAT_CM_double -1.7E+308 1.7E+308 /end CHARACTERISTIC
/begin CHARACTERISTIC Arizona_base_GOAT_cal_impl.PWM1_Value_l "" VALUE 0x00268A38 Scalar_FLOAT64_IEEE 0 Arizona_base_GOAT_CM_double -1.7E+308 1.7E+308 /end CHARACTERISTIC
/begin CHARACTERISTIC Arizona_base_GOAT_cal_impl.PenColor_Value "" VALUE 0x002689A0 Scalar_FLOAT64_IEEE 0 Arizona_base_GOAT_CM_double -1.7E+308 1.7E+308 /end CHARACTERISTIC
/begin CHARACTERISTIC Arizona_base_GOAT_cal_impl.Saturation2_LowerSat "" VALUE 0x00268A08 Scalar_FLOAT64_IEEE 0 Arizona_base_GOAT_CM_double -1.7E+308 1.7E+308 /end CHARACTERISTIC
/begin CHARACTERISTIC Arizona_base_GOAT_cal_impl.Saturation2_LowerSat_e "" VALUE 0x00268A50 Scalar_FLOAT64_IEEE 0 Arizona_base_GOAT_CM_double -1.7E+308 1.7E+308 /end CHARACTERISTIC
/begin CHARACTERISTIC Arizona_base_GOAT_cal_impl.Saturation2_UpperSat "" VALUE 0x00268A00 Scalar_FLOAT64_IEEE 0 Arizona_base_GOAT_CM_double -1.7E+308 1.7E+308 /end CHARACTERISTIC
/begin CHARACTERISTIC Arizona_base_GOAT_cal_impl.Saturation2_UpperSat_m "" VALUE 0x00268A48 Scalar_FLOAT64_IEEE 0 Arizona_base_GOAT_CM_double -1.7E+308 1.7E+308 /end CHARACTERISTIC
/begin CHARACTERISTIC Arizona_base_GOAT_cal_impl.Setup1_P1 "" VALUE 0x00266818 Scalar_FLOAT64_IEEE 0 Arizona_base_GOAT_CM_double -1.7E+308 1.7E+308 /end CHARACTERISTIC
/begin CHARACTERISTIC Arizona_base_GOAT_cal_impl.Setup1_P10 "" VALUE 0x00266980 Scalar_FLOAT64_IEEE 0 Arizona_base_GOAT_CM_double -1.7E+308 1.7E+308 /end CHARACTERISTIC
/begin CHARACTERISTIC Arizona_base_GOAT_cal_impl.Setup1_P11 "" VALUE 0x00266998 Scalar_FLOAT64_IEEE 0 Arizona_base_GOAT_CM_double -1.7E+308 1.7E+308 /end CHARACTERISTIC
/begin CHARACTERISTIC Arizona_base_GOAT_cal_impl.Setup1_P12 "" VAL_BLK 0x002669B0 Scalar_FLOAT64_IEEE 0 Arizona_base_GOAT_CM_double -1.7E+308 1.7E+308 MATRIX_DIM 4 1 /end CHARACTERISTIC
/begin CHARACTERISTIC Arizona_base_GOAT_cal_impl.Setup1_P13 "" VALUE 0x002669E0 Scalar_FLOAT64_IEEE 0 Arizona_base_GOAT_CM_double -1.7E+308 1.7E+308 /end CHARACTERISTIC
/begin CHARACTERISTIC Arizona_base_GOAT_cal_impl.Setup1_P14 "" VALUE 0x002669F8 Scalar_FLOAT64_IEEE 0 Arizona_base_GOAT_CM_double -1.7E+308 1.7E+308 /end CHARACTERISTIC
/begin CHARACTERISTIC Arizona_base_GOAT_cal_impl.Setup1_P15 "" VALUE 0x00266A10 Scalar_FLOAT64_IEEE 0 Arizona_base_GOAT_CM_double -1.7E+308 1.7E+308 /end CHARACTERISTIC
/begin CHARACTERISTIC Arizona_base_GOAT_cal_impl.Setup1_P16 "" VAL_BLK 0x00266A28 Scalar_FLOAT64_IEEE 0 Arizona_base_GOAT_CM_double -1.7E+308 1.7E+308 MATRIX_DIM 2 1 /end CHARACTERISTIC
/begin CHARACTERISTIC Arizona_base_GOAT_cal_impl.Setup1_P17 "" VAL_BLK 0x00266A48 Scalar_FLOAT64_IEEE 0 Arizona_base_GOAT_CM_double -1.7E+308 1.7E+308 MATRIX_DIM 4 1 /end CHARACTERISTIC
/begin CHARACTERISTIC Arizona_base_GOAT_cal_impl.Setup1_P18 "" VAL_BLK 0x00266A78 Scalar_FLOAT64_IEEE 0 Arizona_base_GOAT_CM_double -1.7E+308 1.7E+308 MATRIX_DIM 4 1 /end CHARACTERISTIC
/begin CHARACTERISTIC Arizona_base_GOAT_cal_impl.Setup1_P19 "" VALUE 0x00266AA8 Scalar_FLOAT64_IEEE 0 Arizona_base_GOAT_CM_double -1.7E+308 1.7E+308 /end CHARACTERISTIC
/begin CHARACTERISTIC Arizona_base_GOAT_cal_impl.Setup1_P2 "" VALUE 0x00266830 Scalar_FLOAT64_IEEE 0 Arizona_base_GOAT_CM_double -1.7E+308 1.7E+308 /end CHARACTERISTIC
/begin CHARACTERISTIC Arizona_base_GOAT_cal_impl.Setup1_P20 "" VALUE 0x00266AC0 Scalar_FLOAT64_IEEE 0 Arizona_base_GOAT_CM_double -1.7E+308 1.7E+308 /end CHARACTERISTIC
/begin CHARACTERISTIC Arizona_base_GOAT_cal_impl.Setup1_P21 "" VALUE 0x00266AD8 Scalar_FLOAT64_IEEE 0 Arizona_base_GOAT_CM_double -1.7E+308 1.7E+308 /end CHARACTERISTIC
/begin CHARACTERISTIC Arizona_base_GOAT_cal_impl.Setup1_P22 "" VAL_BLK 0x00266AF0 Scalar_FLOAT64_IEEE 0 Arizona_base_GOAT_CM_double -1.7E+308 1.7E+308 MATRIX_DIM 4 1 /end CHARACTERISTIC
/begin CHARACTERISTIC Arizona_base_GOAT_cal_impl.Setup1_P23 "" VALUE 0x00266B20 Scalar_FLOAT64_IEEE 0 Arizona_base_GOAT_CM_double -1.7E+308 1.7E+308 /end CHARACTERISTIC
/begin CHARACTERISTIC Arizona_base_GOAT_cal_impl.Setup1_P24 "" VALUE 0x00266B38 Scalar_FLOAT64_IEEE 0 Arizona_base_GOAT_CM_double -1.7E+308 1.7E+308 /end CHARACTERISTIC
/begin CHARACTERISTIC Arizona_base_GOAT_cal_impl.Setup1_P25 "" VALUE 0x00266B50 Scalar_FLOAT64_IEEE 0 Arizona_base_GOAT_CM_double -1.7E+308 1.7E+308 /end CHARACTERISTIC
/begin CHARACTERISTIC Arizona_base_GOAT_cal_impl.Setup1_P26 "" VALUE 0x00266B68 Scalar_FLOAT64_IEEE 0 Arizona_base_GOAT_CM_double -1.7E+308 1.7E+308 /end CHARACTERISTIC
/begin CHARACTERISTIC Arizona_base_GOAT_cal_impl.Setup1_P27 "" VALUE 0x00266B80 Scalar_FLOAT64_IEEE 0 Arizona_base_GOAT_CM_double -1.7E+308 1.7E+308 /end CHARACTERISTIC
/begin CHARACTERISTIC Arizona_base_GOAT_cal_impl.Setup1_P28 "" VALUE 0x00266B98 Scalar_FLOAT64_IEEE 0 Arizona_base_GOAT_CM_double -1.7E+308 1.7E+308 /end CHARACTERISTIC
/begin CHARACTERISTIC Arizona_base_GOAT_cal_impl.Setup1_P29 "" VALUE 0x00266BB0 Scalar_FLOAT64_IEEE 0 Arizona_base_GOAT_CM_double -1.7E+308 1.7E+308 /end CHARACTERISTIC
/begin CHARACTERISTIC Arizona_base_GOAT_cal_impl.Setup1_P3 "" VALUE 0x00266848 Scalar_FLOAT64_IEEE 0 Arizona_base_GOAT_CM_double -1.7E+308 1.7E+308 /end CHARACTERISTIC
/begin CHARACTERISTIC Arizona_base_GOAT_cal_impl.Setup1_P30 "" VALUE 0x00266BC8 Scalar_FLOAT64_IEEE 0 Arizona_base_GOAT_CM_double -1.7E+308 1.7E+308 /end CHARACTERISTIC
/begin CHARACTERISTIC Arizona_base_GOAT_cal_impl.Setup1_P31 "" VALUE 0x00266BE0 Scalar_FLOAT64_IEEE 0 Arizona_base_GOAT_CM_double -1.7E+308 1.7E+308 /end CHARACTERISTIC
/begin CHARACTERISTIC Arizona_base_GOAT_cal_impl.Setup1_P32 "" VALUE 0x00266BF8 Scalar_FLOAT64_IEEE 0 Arizona_base_GOAT_CM_double -1.7E+308 1.7E+308 /end CHARACTERISTIC
/begin CHARACTERISTIC Arizona_base_GOAT_cal_impl.Setup1_P33 "" VAL_BLK 0x00266C10 Scalar_FLOAT64_IEEE 0 Arizona_base_GOAT_CM_double -1.7E+308 1.7E+308 MATRIX_DIM 3 1 /end CHARACTERISTIC
/begin CHARACTERISTIC Arizona_base_GOAT_cal_impl.Setup1_P34 "" VAL_BLK 0x00266C38 Scalar_FLOAT64_IEEE 0 Arizona_base_GOAT_CM_double -1.7E+308 1.7E+308 MATRIX_DIM 5 1 /end CHARACTERISTIC
/begin CHARACTERISTIC Arizona_base_GOAT_cal_impl.Setup1_P35 "" VALUE 0x00266C70 Scalar_FLOAT64_IEEE 0 Arizona_base_GOAT_CM_double -1.7E+308 1.7E+308 /end CHARACTERISTIC
/begin CHARACTERISTIC Arizona_base_GOAT_cal_impl.Setup1_P36 "" VALUE 0x00266C88 Scalar_FLOAT64_IEEE 0 Arizona_base_GOAT_CM_double -1.7E+308 1.7E+308 /end CHARACTERISTIC
/begin CHARACTERISTIC Arizona_base_GOAT_cal_impl.Setup1_P37 "" VALUE 0x00266CA0 Scalar_FLOAT64_IEEE 0 Arizona_base_GOAT_CM_double -1.7E+308 1.7E+308 /end CHARACTERISTIC
/begin CHARACTERISTIC Arizona_base_GOAT_cal_impl.Setup1_P4 "" VALUE 0x00266860 Scalar_FLOAT64_IEEE 0 Arizona_base_GOAT_CM_double -1.7E+308 1.7E+308 /end CHARACTERISTIC
/begin CHARACTERISTIC Arizona_base_GOAT_cal_impl.Setup1_P5 "" VAL_BLK 0x00266878 Scalar_FLOAT64_IEEE 0 Arizona_base_GOAT_CM_double -1.7E+308 1.7E+308 MATRIX_DIM 2 1 /end CHARACTERISTIC
/begin CHARACTERISTIC Arizona_base_GOAT_cal_impl.Setup1_P6 "" VAL_BLK 0x00266898 Scalar_FLOAT64_IEEE 0 Arizona_base_GOAT_CM_double -1.7E+308 1.7E+308 MATRIX_DIM 2 1 /end CHARACTERISTIC
/begin CHARACTERISTIC Arizona_base_GOAT_cal_impl.Setup1_P7 "" VAL_BLK 0x002668B8 Scalar_FLOAT64_IEEE 0 Arizona_base_GOAT_CM_double -1.7E+308 1.7E+308 MATRIX_DIM 16 1 /end CHARACTERISTIC
/begin CHARACTERISTIC Arizona_base_GOAT_cal_impl.Setup1_P8 "" VAL_BLK 0x00266948 Scalar_FLOAT64_IEEE 0 Arizona_base_GOAT_CM_double -1.7E+308 1.7E+308 MATRIX_DIM 2 1 /end CHARACTERISTIC
/begin CHARACTERISTIC Arizona_base_GOAT_cal_impl.Setup1_P9 "" VALUE 0x00266968 Scalar_FLOAT64_IEEE 0 Arizona_base_GOAT_CM_double -1.7E+308 1.7E+308 /end CHARACTERISTIC
/begin CHARACTERISTIC Arizona_base_GOAT_cal_impl.Switch1_Threshold "" VALUE 0x00267A10 Scalar_FLOAT64_IEEE 0 Arizona_base_GOAT_CM_double -1.7E+308 1.7E+308 /end CHARACTERISTIC
/begin CHARACTERISTIC Arizona_base_GOAT_cal_impl.Switch1_Threshold_e "" VALUE 0x00267B00 Scalar_FLOAT64_IEEE 0 Arizona_base_GOAT_CM_double -1.7E+308 1.7E+308 /end CHARACTERISTIC
/begin CHARACTERISTIC Arizona_base_GOAT_cal_impl.Switch1_Threshold_m "" VALUE 0x00267A88 Scalar_FLOAT64_IEEE 0 Arizona_base_GOAT_CM_double -1.7E+308 1.7E+308 /end CHARACTERISTIC
/begin CHARACTERISTIC Arizona_base_GOAT_cal_impl.Switch_Threshold "" VALUE 0x0023F590 Scalar_FLOAT64_IEEE 0 Arizona_base_GOAT_CM_double -1.7E+308 1.7E+308 /end CHARACTERISTIC
/begin CHARACTERISTIC Arizona_base_GOAT_cal_impl.Switch_Threshold_b "" VALUE 0x002689B0 Scalar_FLOAT64_IEEE 0 Arizona_base_GOAT_CM_double -1.7E+308 1.7E+308 /end CHARACTERISTIC
/begin CHARACTERISTIC Arizona_base_GOAT_cal_impl.Switch_Threshold_l "" VALUE 0x002689A8 Scalar_FLOAT64_IEEE 0 Arizona_base_GOAT_CM_double -1.7E+308 1.7E+308 /end CHARACTERISTIC
/begin CHARACTERISTIC Arizona_base_GOAT_cal_impl.Switch_Threshold_o "" VALUE 0x002689B8 Scalar_FLOAT64_IEEE 0 Arizona_base_GOAT_CM_double -1.7E+308 1.7E+308 /end CHARACTERISTIC
/begin CHARACTERISTIC Arizona_base_GOAT_cal_impl.TSamp_WtEt "" VALUE 0x00267A70 Scalar_FLOAT64_IEEE 0 Arizona_base_GOAT_CM_double -1.7E+308 1.7E+308 /end CHARACTERISTIC
/begin CHARACTERISTIC Arizona_base_GOAT_cal_impl.TSamp_WtEt_p "" VALUE 0x00267AE8 Scalar_FLOAT64_IEEE 0 Arizona_base_GOAT_CM_double -1.7E+308 1.7E+308 /end CHARACTERISTIC
/begin CHARACTERISTIC Arizona_base_GOAT_cal_impl.basefreq_Value "" VALUE 0x002689E0 Scalar_FLOAT64_IEEE 0 Arizona_base_GOAT_CM_double -1.7E+308 1.7E+308 /end CHARACTERISTIC
/begin CHARACTERISTIC Arizona_base_GOAT_cal_impl.basefreq_Value_i "" VALUE 0x00268A28 Scalar_FLOAT64_IEEE 0 Arizona_base_GOAT_CM_double -1.7E+308 1.7E+308 /end CHARACTERISTIC
/begin CHARACTERISTIC Arizona_base_GOAT_cal_impl.change_color_Y0 "" VALUE 0x0023F6E8 Scalar_FLOAT64_IEEE 0 Arizona_base_GOAT_CM_double -1.7E+308 1.7E+308 /end CHARACTERISTIC
/begin CHARACTERISTIC Arizona_base_GOAT_cal_impl.dutycycleblockwave1_Value "" VALUE 0x0023F6B0 Scalar_FLOAT64_IEEE 0 Arizona_base_GOAT_CM_double -1.7E+308 1.7E+308 /end CHARACTERISTIC
/begin CHARACTERISTIC Arizona_base_GOAT_cal_impl.dutycycleblockwave1_Value_k "" VALUE 0x0023F6B8 Scalar_FLOAT64_IEEE 0 Arizona_base_GOAT_CM_double -1.7E+308 1.7E+308 /end CHARACTERISTIC
/begin CHARACTERISTIC Arizona_base_GOAT_cal_impl.dutycycleblockwave_Value "" VALUE 0x002689D0 Scalar_FLOAT64_IEEE 0 Arizona_base_GOAT_CM_double -1.7E+308 1.7E+308 /end CHARACTERISTIC
/begin CHARACTERISTIC Arizona_base_GOAT_cal_impl.dutycycleblockwave_Value_h "" VALUE 0x00268A18 Scalar_FLOAT64_IEEE 0 Arizona_base_GOAT_CM_double -1.7E+308 1.7E+308 /end CHARACTERISTIC
/begin CHARACTERISTIC Arizona_base_GOAT_cal_impl.homingDone_Y0 "" VALUE 0x0023F580 Scalar_FLOAT64_IEEE 0 Arizona_base_GOAT_CM_double -1.7E+308 1.7E+308 /end CHARACTERISTIC
/begin CHARACTERISTIC Arizona_base_GOAT_cal_impl.log_jogspeed_Gain "" VALUE 0x002689C0 Scalar_FLOAT64_IEEE 0 Arizona_base_GOAT_CM_double -1.7E+308 1.7E+308 /end CHARACTERISTIC
/begin CHARACTERISTIC Arizona_base_GOAT_cal_impl.log_penholder_active_InitialCon "" VALUE 0x002679F0 Scalar_FLOAT64_IEEE 0 Arizona_base_GOAT_CM_double -1.7E+308 1.7E+308 /end CHARACTERISTIC
/begin CHARACTERISTIC Arizona_base_GOAT_cal_impl.phiFF_Y0 "" VALUE 0x00222090 Scalar_FLOAT64_IEEE 0 Arizona_base_GOAT_CM_double -1.7E+308 1.7E+308 /end CHARACTERISTIC
/begin CHARACTERISTIC Arizona_base_GOAT_cal_impl.phiHome_Y0 "" VALUE 0x0023F578 Scalar_FLOAT64_IEEE 0 Arizona_base_GOAT_CM_double -1.7E+308 1.7E+308 /end CHARACTERISTIC
/begin CHARACTERISTIC Arizona_base_GOAT_cal_impl.phiRef_Y0 "" VALUE 0x0023F6E0 Scalar_FLOAT64_IEEE 0 Arizona_base_GOAT_CM_double -1.7E+308 1.7E+308 /end CHARACTERISTIC
/begin CHARACTERISTIC Arizona_base_GOAT_cal_impl.set_cRef_Value "" CURVE 0x00249338 FixLookup_FLOAT64_IEEE 0 Arizona_base_GOAT_CM_double -1.7E+308 1.7E+308
 /begin AXIS_DESCR FIX_AXIS NO_INPUT_QUANTITY Arizona_base_GOAT_CM_double 5000 0.000000 4999.000000 FIX_AXIS_PAR_DIST 0 1 5000 /end AXIS_DESCR
/end CHARACTERISTIC
/begin CHARACTERISTIC Arizona_base_GOAT_cal_impl.set_phiFF_Value "" CURVE 0x00222098 FixLookup_FLOAT64_IEEE 0 Arizona_base_GOAT_CM_double -1.7E+308 1.7E+308
 /begin AXIS_DESCR FIX_AXIS NO_INPUT_QUANTITY Arizona_base_GOAT_CM_double 5000 0.000000 4999.000000 FIX_AXIS_PAR_DIST 0 1 5000 /end AXIS_DESCR
/end CHARACTERISTIC
/begin CHARACTERISTIC Arizona_base_GOAT_cal_impl.set_phiRef_Value "" CURVE 0x00252F78 FixLookup_FLOAT64_IEEE 0 Arizona_base_GOAT_CM_double -1.7E+308 1.7E+308
 /begin AXIS_DESCR FIX_AXIS NO_INPUT_QUANTITY Arizona_base_GOAT_CM_double 5000 0.000000 4999.000000 FIX_AXIS_PAR_DIST 0 1 5000 /end AXIS_DESCR
/end CHARACTERISTIC
/begin CHARACTERISTIC Arizona_base_GOAT_cal_impl.set_xFF_Value "" CURVE 0x0022BCD8 FixLookup_FLOAT64_IEEE 0 Arizona_base_GOAT_CM_double -1.7E+308 1.7E+308
 /begin AXIS_DESCR FIX_AXIS NO_INPUT_QUANTITY Arizona_base_GOAT_CM_double 5000 0.000000 4999.000000 FIX_AXIS_PAR_DIST 0 1 5000 /end AXIS_DESCR
/end CHARACTERISTIC
/begin CHARACTERISTIC Arizona_base_GOAT_cal_impl.set_xRef_Value "" CURVE 0x0025CBB8 FixLookup_FLOAT64_IEEE 0 Arizona_base_GOAT_CM_double -1.7E+308 1.7E+308
 /begin AXIS_DESCR FIX_AXIS NO_INPUT_QUANTITY Arizona_base_GOAT_CM_double 5000 0.000000 4999.000000 FIX_AXIS_PAR_DIST 0 1 5000 /end AXIS_DESCR
/end CHARACTERISTIC
/begin CHARACTERISTIC Arizona_base_GOAT_cal_impl.set_yFF_Value "" CURVE 0x00235918 FixLookup_FLOAT64_IEEE 0 Arizona_base_GOAT_CM_double -1.7E+308 1.7E+308
 /begin AXIS_DESCR FIX_AXIS NO_INPUT_QUANTITY Arizona_base_GOAT_CM_double 5000 0.000000 4999.000000 FIX_AXIS_PAR_DIST 0 1 5000 /end AXIS_DESCR
/end CHARACTERISTIC
/begin CHARACTERISTIC Arizona_base_GOAT_cal_impl.set_yRef_Value "" CURVE 0x0023F6F8 FixLookup_FLOAT64_IEEE 0 Arizona_base_GOAT_CM_double -1.7E+308 1.7E+308
 /begin AXIS_DESCR FIX_AXIS NO_INPUT_QUANTITY Arizona_base_GOAT_CM_double 5000 0.000000 4999.000000 FIX_AXIS_PAR_DIST 0 1 5000 /end AXIS_DESCR
/end CHARACTERISTIC
/begin CHARACTERISTIC Arizona_base_GOAT_cal_impl.startHoming_Value "" VALUE 0x00268988 Scalar_FLOAT64_IEEE 0 Arizona_base_GOAT_CM_double -1.7E+308 1.7E+308 /end CHARACTERISTIC
/begin CHARACTERISTIC Arizona_base_GOAT_cal_impl.startPenholder_Value "" VALUE 0x00268998 Scalar_FLOAT64_IEEE 0 Arizona_base_GOAT_CM_double -1.7E+308 1.7E+308 /end CHARACTERISTIC
/begin CHARACTERISTIC Arizona_base_GOAT_cal_impl.startTrial_Value "" VALUE 0x00268990 Scalar_FLOAT64_IEEE 0 Arizona_base_GOAT_CM_double -1.7E+308 1.7E+308 /end CHARACTERISTIC
/begin CHARACTERISTIC Arizona_base_GOAT_cal_impl.time_Y0 "" VALUE 0x0023F6C8 Scalar_FLOAT64_IEEE 0 Arizona_base_GOAT_CM_double -1.7E+308 1.7E+308 /end CHARACTERISTIC
/begin CHARACTERISTIC Arizona_base_GOAT_cal_impl.trialDone_Y0 "" VALUE 0x00268A58 Scalar_BOOLEAN 0 Arizona_base_GOAT_CM_logical 0 1 /end CHARACTERISTIC
/begin CHARACTERISTIC Arizona_base_GOAT_cal_impl.xFF_Y0 "" VALUE 0x00222088 Scalar_FLOAT64_IEEE 0 Arizona_base_GOAT_CM_double -1.7E+308 1.7E+308 /end CHARACTERISTIC
/begin CHARACTERISTIC Arizona_base_GOAT_cal_impl.xHome_Y0 "" VALUE 0x0023F570 Scalar_FLOAT64_IEEE 0 Arizona_base_GOAT_CM_double -1.7E+308 1.7E+308 /end CHARACTERISTIC
/begin CHARACTERISTIC Arizona_base_GOAT_cal_impl.xRef_Y0 "" VALUE 0x0023F6D8 Scalar_FLOAT64_IEEE 0 Arizona_base_GOAT_CM_double -1.7E+308 1.7E+308 /end CHARACTERISTIC
/begin CHARACTERISTIC Arizona_base_GOAT_cal_impl.yFF_Y0 "" VALUE 0x00222080 Scalar_FLOAT64_IEEE 0 Arizona_base_GOAT_CM_double -1.7E+308 1.7E+308 /end CHARACTERISTIC
/begin CHARACTERISTIC Arizona_base_GOAT_cal_impl.yHome_Y0 "" VALUE 0x0023F568 Scalar_FLOAT64_IEEE 0 Arizona_base_GOAT_CM_double -1.7E+308 1.7E+308 /end CHARACTERISTIC
/begin CHARACTERISTIC Arizona_base_GOAT_cal_impl.yRef_Y0 "" VALUE 0x0023F6D0 Scalar_FLOAT64_IEEE 0 Arizona_base_GOAT_CM_double -1.7E+308 1.7E+308 /end CHARACTERISTIC
/begin CHARACTERISTIC RTE_Param_Service.N_Init "" VALUE 0x00268AA0 Scalar_FLOAT64_IEEE 0 Arizona_base_GOAT_CM_double -1.7E+308 1.7E+308 /end CHARACTERISTIC
/begin CHARACTERISTIC RTE_Param_Service.Nref "" VALUE 0x00268AA8 Scalar_FLOAT64_IEEE 0 Arizona_base_GOAT_CM_double -1.7E+308 1.7E+308 /end CHARACTERISTIC
/begin CHARACTERISTIC RTE_Param_Service.Ts "" VALUE 0x00268AB0 Scalar_FLOAT64_IEEE 0 Arizona_base_GOAT_CM_double -1.7E+308 1.7E+308 /end CHARACTERISTIC
/begin CHARACTERISTIC RTE_Param_Service.phi_Init "" CURVE 0x00268AB8 FixLookup_FLOAT64_IEEE 0 Arizona_base_GOAT_CM_double -1.7E+308 1.7E+308
 /begin AXIS_DESCR FIX_AXIS NO_INPUT_QUANTITY Arizona_base_GOAT_CM_double 3493 0.000000 3492.000000 FIX_AXIS_PAR_DIST 0 1 3493 /end AXIS_DESCR
/end CHARACTERISTIC
/begin CHARACTERISTIC RTE_Param_Service.x_Init "" CURVE 0x0026F7E0 FixLookup_FLOAT64_IEEE 0 Arizona_base_GOAT_CM_double -1.7E+308 1.7E+308
 /begin AXIS_DESCR FIX_AXIS NO_INPUT_QUANTITY Arizona_base_GOAT_CM_double 3117 0.000000 3116.000000 FIX_AXIS_PAR_DIST 0 1 3117 /end AXIS_DESCR
/end CHARACTERISTIC
/begin CHARACTERISTIC RTE_Param_Service.y_Init "" CURVE 0x00275948 FixLookup_FLOAT64_IEEE 0 Arizona_base_GOAT_CM_double -1.7E+308 1.7E+308
 /begin AXIS_DESCR FIX_AXIS NO_INPUT_QUANTITY Arizona_base_GOAT_CM_double 3493 0.000000 3492.000000 FIX_AXIS_PAR_DIST 0 1 3493 /end AXIS_DESCR
/end CHARACTERISTIC
/begin MEASUREMENT Arizona_base_GOAT_B.AIcarriagevelocitymonitor "" FLOAT64_IEEE Arizona_base_GOAT_CM_double 0 0 -1.7E+308 1.7E+308 ECU_ADDRESS 0x0028D0F0 /end MEASUREMENT
/begin MEASUREMENT Arizona_base_GOAT_B.Abs "" FLOAT64_IEEE Arizona_base_GOAT_CM_double 0 0 -1.7E+308 1.7E+308 ECU_ADDRESS 0x0028D3E0 /end MEASUREMENT
/begin MEASUREMENT Arizona_base_GOAT_B.Abs1 "" FLOAT64_IEEE Arizona_base_GOAT_CM_double 0 0 -1.7E+308 1.7E+308 ECU_ADDRESS 0x0028D3F8 /end MEASUREMENT
/begin MEASUREMENT Arizona_base_GOAT_B.Abs1_l "" FLOAT64_IEEE Arizona_base_GOAT_CM_double 0 0 -1.7E+308 1.7E+308 ECU_ADDRESS 0x0028D458 /end MEASUREMENT
/begin MEASUREMENT Arizona_base_GOAT_B.Abs1_m "" FLOAT64_IEEE Arizona_base_GOAT_CM_double 0 0 -1.7E+308 1.7E+308 ECU_ADDRESS 0x0028D470 /end MEASUREMENT
/begin MEASUREMENT Arizona_base_GOAT_B.Abs_d "" FLOAT64_IEEE Arizona_base_GOAT_CM_double 0 0 -1.7E+308 1.7E+308 ECU_ADDRESS 0x0028D3E8 /end MEASUREMENT
/begin MEASUREMENT Arizona_base_GOAT_B.Abs_dw "" FLOAT64_IEEE Arizona_base_GOAT_CM_double 0 0 -1.7E+308 1.7E+308 ECU_ADDRESS 0x0028D460 /end MEASUREMENT
/begin MEASUREMENT Arizona_base_GOAT_B.AddphiHome "" FLOAT64_IEEE Arizona_base_GOAT_CM_double 0 0 -1.7E+308 1.7E+308 ECU_ADDRESS 0x0028D5E8 /end MEASUREMENT
/begin MEASUREMENT Arizona_base_GOAT_B.AddxHome "" FLOAT64_IEEE Arizona_base_GOAT_CM_double 0 0 -1.7E+308 1.7E+308 ECU_ADDRESS 0x0028D5F0 /end MEASUREMENT
/begin MEASUREMENT Arizona_base_GOAT_B.AddyHome "" FLOAT64_IEEE Arizona_base_GOAT_CM_double 0 0 -1.7E+308 1.7E+308 ECU_ADDRESS 0x0028D5F8 /end MEASUREMENT
/begin MEASUREMENT Arizona_base_GOAT_B.Analoginput1_o2 "" FLOAT64_IEEE Arizona_base_GOAT_CM_double 0 0 -1.7E+308 1.7E+308 ECU_ADDRESS 0x0028D0A8 /end MEASUREMENT
/begin MEASUREMENT Arizona_base_GOAT_B.Calibration1 "" FLOAT64_IEEE Arizona_base_GOAT_CM_double 0 0 -1.7E+308 1.7E+308 ECU_ADDRESS 0x0028D100 /end MEASUREMENT
/begin MEASUREMENT Arizona_base_GOAT_B.Calibration2 "" FLOAT64_IEEE Arizona_base_GOAT_CM_double 0 0 -1.7E+308 1.7E+308 ECU_ADDRESS 0x0028D118 /end MEASUREMENT
/begin MEASUREMENT Arizona_base_GOAT_B.Calibration3 "" FLOAT64_IEEE Arizona_base_GOAT_CM_double 0 0 -1.7E+308 1.7E+308 ECU_ADDRESS 0x0028D130 /end MEASUREMENT
/begin MEASUREMENT Arizona_base_GOAT_B.Calibration4 "" FLOAT64_IEEE Arizona_base_GOAT_CM_double 0 0 -1.7E+308 1.7E+308 ECU_ADDRESS 0x0028D320 /end MEASUREMENT
/begin MEASUREMENT Arizona_base_GOAT_B.Calibration5 "" FLOAT64_IEEE Arizona_base_GOAT_CM_double 0 0 -1.7E+308 1.7E+308 ECU_ADDRESS 0x0028D338 /end MEASUREMENT
/begin MEASUREMENT Arizona_base_GOAT_B.Calibration6 "" FLOAT64_IEEE Arizona_base_GOAT_CM_double 0 0 -1.7E+308 1.7E+308 ECU_ADDRESS 0x0028D350 /end MEASUREMENT
/begin MEASUREMENT Arizona_base_GOAT_B.Cariagesecundair "" FLOAT64_IEEE Arizona_base_GOAT_CM_double 0 0 -1.7E+308 1.7E+308 ECU_ADDRESS 0x0028D318 /end MEASUREMENT
/begin MEASUREMENT Arizona_base_GOAT_B.Carriageencoder "" FLOAT64_IEEE Arizona_base_GOAT_CM_double 0 0 -1.7E+308 1.7E+308 ECU_ADDRESS 0x0028D0F8 /end MEASUREMENT
/begin MEASUREMENT Arizona_base_GOAT_B.Compare "" UBYTE Arizona_base_GOAT_CM_logical 0 0 0 1 ECU_ADDRESS 0x0028D661 /end MEASUREMENT
/begin MEASUREMENT Arizona_base_GOAT_B.Compare_b "" UBYTE Arizona_base_GOAT_CM_logical 0 0 0 1 ECU_ADDRESS 0x0028D66A /end MEASUREMENT
/begin MEASUREMENT Arizona_base_GOAT_B.Compare_h "" UBYTE Arizona_base_GOAT_CM_logical 0 0 0 1 ECU_ADDRESS 0x0028D666 /end MEASUREMENT
/begin MEASUREMENT Arizona_base_GOAT_B.Compare_h2 "" UBYTE Arizona_base_GOAT_CM_logical 0 0 0 1 ECU_ADDRESS 0x0028D669 /end MEASUREMENT
/begin MEASUREMENT Arizona_base_GOAT_B.Compare_l "" UBYTE Arizona_base_GOAT_CM_logical 0 0 0 1 ECU_ADDRESS 0x0028D664 /end MEASUREMENT
/begin MEASUREMENT Arizona_base_GOAT_B.Compare_p "" UBYTE Arizona_base_GOAT_CM_logical 0 0 0 1 ECU_ADDRESS 0x0028D663 /end MEASUREMENT
/begin MEASUREMENT Arizona_base_GOAT_B.DIblacksoftwarebutton "" FLOAT64_IEEE Arizona_base_GOAT_CM_double 0 0 -1.7E+308 1.7E+308 ECU_ADDRESS 0x0028D0C8 /end MEASUREMENT
/begin MEASUREMENT Arizona_base_GOAT_B.DIblacksofwarefunctionbutton "" UBYTE Arizona_base_GOAT_CM_logical 0 0 0 1 ECU_ADDRESS 0x0028D660 /end MEASUREMENT
/begin MEASUREMENT Arizona_base_GOAT_B.DIcarriageamplifyerstatus "" FLOAT64_IEEE Arizona_base_GOAT_CM_double 0 0 -1.7E+308 1.7E+308 ECU_ADDRESS 0x0028D0D0 /end MEASUREMENT
/begin MEASUREMENT Arizona_base_GOAT_B.DIcarriagelimitswitch "" FLOAT64_IEEE Arizona_base_GOAT_CM_double 0 0 -1.7E+308 1.7E+308 ECU_ADDRESS 0x0028D0B0 /end MEASUREMENT
/begin MEASUREMENT Arizona_base_GOAT_B.DIcarriagelimitswitchsecundaird "" FLOAT64_IEEE Arizona_base_GOAT_CM_double 0 0 -1.7E+308 1.7E+308 ECU_ADDRESS 0x0028D360 /end MEASUREMENT
/begin MEASUREMENT Arizona_base_GOAT_B.DIgantryx1amplifyerstatus "" FLOAT64_IEEE Arizona_base_GOAT_CM_double 0 0 -1.7E+308 1.7E+308 ECU_ADDRESS 0x0028D0D8 /end MEASUREMENT
/begin MEASUREMENT Arizona_base_GOAT_B.DIgantryx1limitswitch "" FLOAT64_IEEE Arizona_base_GOAT_CM_double 0 0 -1.7E+308 1.7E+308 ECU_ADDRESS 0x0028D0B8 /end MEASUREMENT
/begin MEASUREMENT Arizona_base_GOAT_B.DIgantryx1limitswitchsecundaird "" FLOAT64_IEEE Arizona_base_GOAT_CM_double 0 0 -1.7E+308 1.7E+308 ECU_ADDRESS 0x0028D368 /end MEASUREMENT
/begin MEASUREMENT Arizona_base_GOAT_B.DIgantryx2amplifyerstatus "" FLOAT64_IEEE Arizona_base_GOAT_CM_double 0 0 -1.7E+308 1.7E+308 ECU_ADDRESS 0x0028D0E0 /end MEASUREMENT
/begin MEASUREMENT Arizona_base_GOAT_B.DIgantryx2limitswitch "" FLOAT64_IEEE Arizona_base_GOAT_CM_double 0 0 -1.7E+308 1.7E+308 ECU_ADDRESS 0x0028D0C0 /end MEASUREMENT
/begin MEASUREMENT Arizona_base_GOAT_B.DIgantryx2limitswitchsecundaird "" FLOAT64_IEEE Arizona_base_GOAT_CM_double 0 0 -1.7E+308 1.7E+308 ECU_ADDRESS 0x0028D370 /end MEASUREMENT
/begin MEASUREMENT Arizona_base_GOAT_B.DIredsoftwarefunctionbutton "" FLOAT64_IEEE Arizona_base_GOAT_CM_double 0 0 -1.7E+308 1.7E+308 ECU_ADDRESS 0x0028D0E8 /end MEASUREMENT
/begin MEASUREMENT Arizona_base_GOAT_B.DataTypeConversion "" UBYTE Arizona_base_GOAT_CM_logical 0 0 0 1 ECU_ADDRESS 0x0028D662 /end MEASUREMENT
/begin MEASUREMENT Arizona_base_GOAT_B.DataTypeConversion1 "" FLOAT64_IEEE Arizona_base_GOAT_CM_double 0 0 -1.7E+308 1.7E+308 ECU_ADDRESS 0x0028D3C0 /end MEASUREMENT
/begin MEASUREMENT Arizona_base_GOAT_B.DataTypeConversion1_n "" UBYTE Arizona_base_GOAT_CM_logical 0 0 0 1 ECU_ADDRESS 0x0028D665 /end MEASUREMENT
/begin MEASUREMENT Arizona_base_GOAT_B.DataTypeConversion2 "" FLOAT64_IEEE Arizona_base_GOAT_CM_double 0 0 -1.7E+308 1.7E+308 ECU_ADDRESS 0x0028D3B8 /end MEASUREMENT
/begin MEASUREMENT Arizona_base_GOAT_B.DataTypeConversion3 "" FLOAT64_IEEE Arizona_base_GOAT_CM_double 0 0 -1.7E+308 1.7E+308 ECU_ADDRESS 0x0028D3C8 /end MEASUREMENT
/begin MEASUREMENT Arizona_base_GOAT_B.DataTypeConversionendtrial "" FLOAT64_IEEE Arizona_base_GOAT_CM_double 0 0 -1.7E+308 1.7E+308 ECU_ADDRESS 0x0028D600 /end MEASUREMENT
/begin MEASUREMENT Arizona_base_GOAT_B.Dct2lowpasscurrent_carriageAirb "" FLOAT64_IEEE Arizona_base_GOAT_CM_double 0 0 -1.7E+308 1.7E+308 ECU_ADDRESS 0x0028D2D8 /end MEASUREMENT
/begin MEASUREMENT Arizona_base_GOAT_B.Dct2lowpasscurrent_gantryAirbag "" FLOAT64_IEEE Arizona_base_GOAT_CM_double 0 0 -1.7E+308 1.7E+308 ECU_ADDRESS 0x0028D270 /end MEASUREMENT
/begin MEASUREMENT Arizona_base_GOAT_B.Dct2lowpassoutput_x "" FLOAT64_IEEE Arizona_base_GOAT_CM_double 0 0 -1.7E+308 1.7E+308 ECU_ADDRESS 0x0028D200 /end MEASUREMENT
/begin MEASUREMENT Arizona_base_GOAT_B.Dct2lowpassoutput_y "" FLOAT64_IEEE Arizona_base_GOAT_CM_double 0 0 -1.7E+308 1.7E+308 ECU_ADDRESS 0x0028D198 /end MEASUREMENT
/begin MEASUREMENT Arizona_base_GOAT_B.Delay "" FLOAT64_IEEE Arizona_base_GOAT_CM_double 0 0 -1.7E+308 1.7E+308 ECU_ADDRESS 0x0028D160 /end MEASUREMENT
/begin MEASUREMENT Arizona_base_GOAT_B.Delay1 "" FLOAT64_IEEE Arizona_base_GOAT_CM_double 0 0 -1.7E+308 1.7E+308 ECU_ADDRESS 0x0028D158 /end MEASUREMENT
/begin MEASUREMENT Arizona_base_GOAT_B.Delay1_b "" FLOAT64_IEEE Arizona_base_GOAT_CM_double 0 0 -1.7E+308 1.7E+308 ECU_ADDRESS 0x0028D220 /end MEASUREMENT
/begin MEASUREMENT Arizona_base_GOAT_B.Delay1_g "" FLOAT64_IEEE Arizona_base_GOAT_CM_double 0 0 -1.7E+308 1.7E+308 ECU_ADDRESS 0x0028D1B8 /end MEASUREMENT
/begin MEASUREMENT Arizona_base_GOAT_B.Delay2 "" FLOAT64_IEEE Arizona_base_GOAT_CM_double 0 0 -1.7E+308 1.7E+308 ECU_ADDRESS 0x0028D150 /end MEASUREMENT
/begin MEASUREMENT Arizona_base_GOAT_B.Delay_c "" UBYTE Arizona_base_GOAT_CM_logical 0 0 0 1 ECU_ADDRESS 0x0028D667 /end MEASUREMENT
/begin MEASUREMENT Arizona_base_GOAT_B.Delay_j "" FLOAT64_IEEE Arizona_base_GOAT_CM_double 0 0 -1.7E+308 1.7E+308 ECU_ADDRESS 0x0028D230 /end MEASUREMENT
/begin MEASUREMENT Arizona_base_GOAT_B.Delay_l "" FLOAT64_IEEE Arizona_base_GOAT_CM_double 0 0 -1.7E+308 1.7E+308 ECU_ADDRESS 0x0028D578 /end MEASUREMENT
/begin MEASUREMENT Arizona_base_GOAT_B.Delay_m "" FLOAT64_IEEE Arizona_base_GOAT_CM_double 0 0 -1.7E+308 1.7E+308 ECU_ADDRESS 0x0028D1C0 /end MEASUREMENT
/begin MEASUREMENT Arizona_base_GOAT_B.Diff "" FLOAT64_IEEE Arizona_base_GOAT_CM_double 0 0 -1.7E+308 1.7E+308 ECU_ADDRESS 0x0028D1B0 /end MEASUREMENT
/begin MEASUREMENT Arizona_base_GOAT_B.Diff_n "" FLOAT64_IEEE Arizona_base_GOAT_CM_double 0 0 -1.7E+308 1.7E+308 ECU_ADDRESS 0x0028D218 /end MEASUREMENT
/begin MEASUREMENT Arizona_base_GOAT_B.DirectLookupTablechange_color "" FLOAT64_IEEE Arizona_base_GOAT_CM_double 0 0 -1.7E+308 1.7E+308 ECU_ADDRESS 0x0028D508 /end MEASUREMENT
/begin MEASUREMENT Arizona_base_GOAT_B.DirectLookupTablephiFF "" FLOAT64_IEEE Arizona_base_GOAT_CM_double 0 0 -1.7E+308 1.7E+308 ECU_ADDRESS 0x0028D5A8 /end MEASUREMENT
/begin MEASUREMENT Arizona_base_GOAT_B.DirectLookupTablephiRef "" FLOAT64_IEEE Arizona_base_GOAT_CM_double 0 0 -1.7E+308 1.7E+308 ECU_ADDRESS 0x0028D510 /end MEASUREMENT
/begin MEASUREMENT Arizona_base_GOAT_B.DirectLookupTablexFF "" FLOAT64_IEEE Arizona_base_GOAT_CM_double 0 0 -1.7E+308 1.7E+308 ECU_ADDRESS 0x0028D5A0 /end MEASUREMENT
/begin MEASUREMENT Arizona_base_GOAT_B.DirectLookupTablexRef "" FLOAT64_IEEE Arizona_base_GOAT_CM_double 0 0 -1.7E+308 1.7E+308 ECU_ADDRESS 0x0028D518 /end MEASUREMENT
/begin MEASUREMENT Arizona_base_GOAT_B.DirectLookupTableyFF "" FLOAT64_IEEE Arizona_base_GOAT_CM_double 0 0 -1.7E+308 1.7E+308 ECU_ADDRESS 0x0028D598 /end MEASUREMENT
/begin MEASUREMENT Arizona_base_GOAT_B.DiscreteTimeIntegratorx1JogSpee "" FLOAT64_IEEE Arizona_base_GOAT_CM_double 0 0 -1.7E+308 1.7E+308 ECU_ADDRESS 0x0028D5C0 /end MEASUREMENT
/begin MEASUREMENT Arizona_base_GOAT_B.DiscreteTimeIntegratorx2JogSpee "" FLOAT64_IEEE Arizona_base_GOAT_CM_double 0 0 -1.7E+308 1.7E+308 ECU_ADDRESS 0x0028D5B8 /end MEASUREMENT
/begin MEASUREMENT Arizona_base_GOAT_B.Divide "" FLOAT64_IEEE Arizona_base_GOAT_CM_double 0 0 -1.7E+308 1.7E+308 ECU_ADDRESS 0x0028D408 /end MEASUREMENT
/begin MEASUREMENT Arizona_base_GOAT_B.Divide1 "" FLOAT64_IEEE Arizona_base_GOAT_CM_double 0 0 -1.7E+308 1.7E+308 ECU_ADDRESS 0x0028D420 /end MEASUREMENT
/begin MEASUREMENT Arizona_base_GOAT_B.Divide1_c "" FLOAT64_IEEE Arizona_base_GOAT_CM_double 0 0 -1.7E+308 1.7E+308 ECU_ADDRESS 0x0028D498 /end MEASUREMENT
/begin MEASUREMENT Arizona_base_GOAT_B.Divide2 "" FLOAT64_IEEE Arizona_base_GOAT_CM_double 0 0 -1.7E+308 1.7E+308 ECU_ADDRESS 0x0028D428 /end MEASUREMENT
/begin MEASUREMENT Arizona_base_GOAT_B.Divide2_c "" FLOAT64_IEEE Arizona_base_GOAT_CM_double 0 0 -1.7E+308 1.7E+308 ECU_ADDRESS 0x0028D4A0 /end MEASUREMENT
/begin MEASUREMENT Arizona_base_GOAT_B.Divide3 "" FLOAT64_IEEE Arizona_base_GOAT_CM_double 0 0 -1.7E+308 1.7E+308 ECU_ADDRESS 0x0028D430 /end MEASUREMENT
/begin MEASUREMENT Arizona_base_GOAT_B.Divide3_g "" FLOAT64_IEEE Arizona_base_GOAT_CM_double 0 0 -1.7E+308 1.7E+308 ECU_ADDRESS 0x0028D4A8 /end MEASUREMENT
/begin MEASUREMENT Arizona_base_GOAT_B.Divide_b "" FLOAT64_IEEE Arizona_base_GOAT_CM_double 0 0 -1.7E+308 1.7E+308 ECU_ADDRESS 0x0028D480 /end MEASUREMENT
/begin MEASUREMENT Arizona_base_GOAT_B.Gain "" FLOAT64_IEEE Arizona_base_GOAT_CM_double 0 0 -1.7E+308 1.7E+308 ECU_ADDRESS 0x0028D410 /end MEASUREMENT
/begin MEASUREMENT Arizona_base_GOAT_B.Gain1 "" FLOAT64_IEEE Arizona_base_GOAT_CM_double 0 0 -1.7E+308 1.7E+308 ECU_ADDRESS 0x0028D3F0 /end MEASUREMENT
/begin MEASUREMENT Arizona_base_GOAT_B.Gain1_d "" FLOAT64_IEEE Arizona_base_GOAT_CM_double 0 0 -1.7E+308 1.7E+308 ECU_ADDRESS 0x0028D468 /end MEASUREMENT
/begin MEASUREMENT Arizona_base_GOAT_B.Gain8 "" FLOAT64_IEEE Arizona_base_GOAT_CM_double 0 0 -1.7E+308 1.7E+308 ECU_ADDRESS 0x0028D438 /end MEASUREMENT
/begin MEASUREMENT Arizona_base_GOAT_B.Gain8_o "" FLOAT64_IEEE Arizona_base_GOAT_CM_double 0 0 -1.7E+308 1.7E+308 ECU_ADDRESS 0x0028D4B0 /end MEASUREMENT
/begin MEASUREMENT Arizona_base_GOAT_B.Gain_b "" FLOAT64_IEEE Arizona_base_GOAT_CM_double 0 0 -1.7E+308 1.7E+308 ECU_ADDRESS 0x0028D488 /end MEASUREMENT
/begin MEASUREMENT Arizona_base_GOAT_B.Gainonphi2 "" FLOAT64_IEEE Arizona_base_GOAT_CM_double 0 0 -1.7E+308 1.7E+308 ECU_ADDRESS 0x0028D3D8 /end MEASUREMENT
/begin MEASUREMENT Arizona_base_GOAT_B.Gainonphi3 "" FLOAT64_IEEE Arizona_base_GOAT_CM_double 0 0 -1.7E+308 1.7E+308 ECU_ADDRESS 0x0028D450 /end MEASUREMENT
/begin MEASUREMENT Arizona_base_GOAT_B.Gainonu_phi "" FLOAT64_IEEE Arizona_base_GOAT_CM_double 0 0 -1.7E+308 1.7E+308 ECU_ADDRESS 0x0028D2A0 /end MEASUREMENT
/begin MEASUREMENT Arizona_base_GOAT_B.Gainonu_x "" FLOAT64_IEEE Arizona_base_GOAT_CM_double 0 0 -1.7E+308 1.7E+308 ECU_ADDRESS 0x0028D288 /end MEASUREMENT
/begin MEASUREMENT Arizona_base_GOAT_B.Gainphi "" FLOAT64_IEEE Arizona_base_GOAT_CM_double 0 0 -1.7E+308 1.7E+308 ECU_ADDRESS 0x0028D250 /end MEASUREMENT
/begin MEASUREMENT Arizona_base_GOAT_B.Gainx "" FLOAT64_IEEE Arizona_base_GOAT_CM_double 0 0 -1.7E+308 1.7E+308 ECU_ADDRESS 0x0028D1E0 /end MEASUREMENT
/begin MEASUREMENT Arizona_base_GOAT_B.GantryX1secundair "" FLOAT64_IEEE Arizona_base_GOAT_CM_double 0 0 -1.7E+308 1.7E+308 ECU_ADDRESS 0x0028D330 /end MEASUREMENT
/begin MEASUREMENT Arizona_base_GOAT_B.Gantryx1GantryxR "" FLOAT64_IEEE Arizona_base_GOAT_CM_double 0 0 -1.7E+308 1.7E+308 ECU_ADDRESS 0x0028D110 /end MEASUREMENT
/begin MEASUREMENT Arizona_base_GOAT_B.Gantryx2GantryxL "" FLOAT64_IEEE Arizona_base_GOAT_CM_double 0 0 -1.7E+308 1.7E+308 ECU_ADDRESS 0x0028D128 /end MEASUREMENT
/begin MEASUREMENT Arizona_base_GOAT_B.GentryX2secundair "" FLOAT64_IEEE Arizona_base_GOAT_CM_double 0 0 -1.7E+308 1.7E+308 ECU_ADDRESS 0x0028D348 /end MEASUREMENT
/begin MEASUREMENT Arizona_base_GOAT_B.Internal "" FLOAT64_IEEE Arizona_base_GOAT_CM_double 0 0 -1.7E+308 1.7E+308 ECU_ADDRESS 0x0028D278 /end MEASUREMENT
/begin MEASUREMENT Arizona_base_GOAT_B.Internal_g "" FLOAT64_IEEE Arizona_base_GOAT_CM_double 0 0 -1.7E+308 1.7E+308 ECU_ADDRESS 0x0028D2E0 /end MEASUREMENT
/begin MEASUREMENT Arizona_base_GOAT_B.Internal_j "" FLOAT64_IEEE Arizona_base_GOAT_CM_double 0 0 -1.7E+308 1.7E+308 ECU_ADDRESS 0x0028D290 /end MEASUREMENT
/begin MEASUREMENT Arizona_base_GOAT_B.LogicalOperator "" UBYTE Arizona_base_GOAT_CM_logical 0 0 0 1 ECU_ADDRESS 0x0028D668 /end MEASUREMENT
/begin MEASUREMENT Arizona_base_GOAT_B.Memory "" FLOAT64_IEEE Arizona_base_GOAT_CM_double 0 0 -1.7E+308 1.7E+308 ECU_ADDRESS 0x0028D520 /end MEASUREMENT
/begin MEASUREMENT Arizona_base_GOAT_B.Memory_loop_phi "" FLOAT64_IEEE Arizona_base_GOAT_CM_double 0 0 -1.7E+308 1.7E+308 ECU_ADDRESS 0x0028D398 /end MEASUREMENT
/begin MEASUREMENT Arizona_base_GOAT_B.Memory_loop_x "" FLOAT64_IEEE Arizona_base_GOAT_CM_double 0 0 -1.7E+308 1.7E+308 ECU_ADDRESS 0x0028D3A0 /end MEASUREMENT
/begin MEASUREMENT Arizona_base_GOAT_B.Memory_loop_y "" FLOAT64_IEEE Arizona_base_GOAT_CM_double 0 0 -1.7E+308 1.7E+308 ECU_ADDRESS 0x0028D3A8 /end MEASUREMENT
/begin MEASUREMENT Arizona_base_GOAT_B.PenColor "" FLOAT64_IEEE Arizona_base_GOAT_CM_double 0 0 -1.7E+308 1.7E+308 ECU_ADDRESS 0x0028D390 /end MEASUREMENT
/begin MEASUREMENT Arizona_base_GOAT_B.Product "" FLOAT64_IEEE Arizona_base_GOAT_CM_double 0 0 -1.7E+308 1.7E+308 ECU_ADDRESS 0x0028D4E8 /end MEASUREMENT
/begin MEASUREMENT Arizona_base_GOAT_B.Sign2 "" FLOAT64_IEEE Arizona_base_GOAT_CM_double 0 0 -1.7E+308 1.7E+308 ECU_ADDRESS 0x0028D440 /end MEASUREMENT
/begin MEASUREMENT Arizona_base_GOAT_B.Sign2_g "" FLOAT64_IEEE Arizona_base_GOAT_CM_double 0 0 -1.7E+308 1.7E+308 ECU_ADDRESS 0x0028D4B8 /end MEASUREMENT
/begin MEASUREMENT Arizona_base_GOAT_B.Subtract "" FLOAT64_IEEE Arizona_base_GOAT_CM_double 0 0 -1.7E+308 1.7E+308 ECU_ADDRESS 0x0028D418 /end MEASUREMENT
/begin MEASUREMENT Arizona_base_GOAT_B.Subtract_g "" FLOAT64_IEEE Arizona_base_GOAT_CM_double 0 0 -1.7E+308 1.7E+308 ECU_ADDRESS 0x0028D490 /end MEASUREMENT
/begin MEASUREMENT Arizona_base_GOAT_B.Sum "" FLOAT64_IEEE Arizona_base_GOAT_CM_double 0 0 -1.7E+308 1.7E+308 ECU_ADDRESS 0x0028D4F0 /end MEASUREMENT
/begin MEASUREMENT Arizona_base_GOAT_B.Sum_b "" FLOAT64_IEEE Arizona_base_GOAT_CM_double 0 0 -1.7E+308 1.7E+308 ECU_ADDRESS 0x0028D588 /end MEASUREMENT
/begin MEASUREMENT Arizona_base_GOAT_B.Sum_k "" FLOAT64_IEEE Arizona_base_GOAT_CM_double 0 0 -1.7E+308 1.7E+308 ECU_ADDRESS 0x0028D570 /end MEASUREMENT
/begin MEASUREMENT Arizona_base_GOAT_B.Sum_o "" FLOAT64_IEEE Arizona_base_GOAT_CM_double 0 0 -1.7E+308 1.7E+308 ECU_ADDRESS 0x0028D568 /end MEASUREMENT
/begin MEASUREMENT Arizona_base_GOAT_B.Sumcurrentx_L "" FLOAT64_IEEE Arizona_base_GOAT_CM_double 0 0 -1.7E+308 1.7E+308 ECU_ADDRESS 0x0028D2C0 /end MEASUREMENT
/begin MEASUREMENT Arizona_base_GOAT_B.Sumcurrentx_R "" FLOAT64_IEEE Arizona_base_GOAT_CM_double 0 0 -1.7E+308 1.7E+308 ECU_ADDRESS 0x0028D2A8 /end MEASUREMENT
/begin MEASUREMENT Arizona_base_GOAT_B.Sumx_Lx_R "" FLOAT64_IEEE Arizona_base_GOAT_CM_double 0 0 -1.7E+308 1.7E+308 ECU_ADDRESS 0x0028D1D8 /end MEASUREMENT
/begin MEASUREMENT Arizona_base_GOAT_B.Sumx_Rx_L "" FLOAT64_IEEE Arizona_base_GOAT_CM_double 0 0 -1.7E+308 1.7E+308 ECU_ADDRESS 0x0028D248 /end MEASUREMENT
/begin MEASUREMENT Arizona_base_GOAT_B.Switch "" FLOAT64_IEEE Arizona_base_GOAT_CM_double 0 0 -1.7E+308 1.7E+308 ECU_ADDRESS 0x0028D400 /end MEASUREMENT
/begin MEASUREMENT Arizona_base_GOAT_B.Switch1 "" FLOAT64_IEEE Arizona_base_GOAT_CM_double 0 0 -1.7E+308 1.7E+308 ECU_ADDRESS 0x0028D168 /end MEASUREMENT
/begin MEASUREMENT Arizona_base_GOAT_B.Switch1_c "" FLOAT64_IEEE Arizona_base_GOAT_CM_double 0 0 -1.7E+308 1.7E+308 ECU_ADDRESS 0x0028D238 /end MEASUREMENT
/begin MEASUREMENT Arizona_base_GOAT_B.Switch1_h "" FLOAT64_IEEE Arizona_base_GOAT_CM_double 0 0 -1.7E+308 1.7E+308 ECU_ADDRESS 0x0028D1C8 /end MEASUREMENT
/begin MEASUREMENT Arizona_base_GOAT_B.Switch1_hm "" FLOAT64_IEEE Arizona_base_GOAT_CM_double 0 0 -1.7E+308 1.7E+308 ECU_ADDRESS 0x0028D3B0 /end MEASUREMENT
/begin MEASUREMENT Arizona_base_GOAT_B.Switch_b "" FLOAT64_IEEE Arizona_base_GOAT_CM_double 0 0 -1.7E+308 1.7E+308 ECU_ADDRESS 0x0028D528 /end MEASUREMENT
/begin MEASUREMENT Arizona_base_GOAT_B.Switch_bb "" FLOAT64_IEEE Arizona_base_GOAT_CM_double 0 0 -1.7E+308 1.7E+308 ECU_ADDRESS 0x0028D580 /end MEASUREMENT
/begin MEASUREMENT Arizona_base_GOAT_B.Switch_i "" FLOAT64_IEEE Arizona_base_GOAT_CM_double 0 0 -1.7E+308 1.7E+308 ECU_ADDRESS 0x0028D478 /end MEASUREMENT
/begin MEASUREMENT Arizona_base_GOAT_B.TSamp "" FLOAT64_IEEE Arizona_base_GOAT_CM_double 0 0 -1.7E+308 1.7E+308 ECU_ADDRESS 0x0028D1A0 /end MEASUREMENT
/begin MEASUREMENT Arizona_base_GOAT_B.TSamp_n "" FLOAT64_IEEE Arizona_base_GOAT_CM_double 0 0 -1.7E+308 1.7E+308 ECU_ADDRESS 0x0028D208 /end MEASUREMENT
/begin MEASUREMENT Arizona_base_GOAT_B.Uk1 "" FLOAT64_IEEE Arizona_base_GOAT_CM_double 0 0 -1.7E+308 1.7E+308 ECU_ADDRESS 0x0028D1A8 /end MEASUREMENT
/begin MEASUREMENT Arizona_base_GOAT_B.Uk1_o "" FLOAT64_IEEE Arizona_base_GOAT_CM_double 0 0 -1.7E+308 1.7E+308 ECU_ADDRESS 0x0028D210 /end MEASUREMENT
/begin MEASUREMENT Arizona_base_GOAT_B.XtranMo_DIR "" FLOAT64_IEEE Arizona_base_GOAT_CM_double 0 0 -1.7E+308 1.7E+308 ECU_ADDRESS 0x0028D448 /end MEASUREMENT
/begin MEASUREMENT Arizona_base_GOAT_B.XtranMo_DIR_k "" FLOAT64_IEEE Arizona_base_GOAT_CM_double 0 0 -1.7E+308 1.7E+308 ECU_ADDRESS 0x0028D4C0 /end MEASUREMENT
/begin MEASUREMENT Arizona_base_GOAT_B.active "" FLOAT64_IEEE Arizona_base_GOAT_CM_double 0 0 -1.7E+308 1.7E+308 ECU_ADDRESS 0x0028D560 /end MEASUREMENT
/begin MEASUREMENT Arizona_base_GOAT_B.analogvelin "" FLOAT64_IEEE Arizona_base_GOAT_CM_double 0 0 -1.7E+308 1.7E+308 ECU_ADDRESS 0x0028D0A0 /end MEASUREMENT
/begin MEASUREMENT Arizona_base_GOAT_B.carriageamplifierenable "" FLOAT64_IEEE Arizona_base_GOAT_CM_double 0 0 -1.7E+308 1.7E+308 ECU_ADDRESS 0x0028D300 /end MEASUREMENT
/begin MEASUREMENT Arizona_base_GOAT_B.carriagemotorvoltage "" FLOAT64_IEEE Arizona_base_GOAT_CM_double 0 0 -1.7E+308 1.7E+308 ECU_ADDRESS 0x0028D2F0 /end MEASUREMENT
/begin MEASUREMENT Arizona_base_GOAT_B.carriagemotorvoltage_o "" FLOAT64_IEEE Arizona_base_GOAT_CM_double 0 0 -1.7E+308 1.7E+308 ECU_ADDRESS 0x0028D2F8 /end MEASUREMENT
/begin MEASUREMENT Arizona_base_GOAT_B.change_color "" FLOAT64_IEEE Arizona_base_GOAT_CM_double 0 0 -1.7E+308 1.7E+308 ECU_ADDRESS 0x0028D4E0 /end MEASUREMENT
/begin MEASUREMENT Arizona_base_GOAT_B.change_color_j "" FLOAT64_IEEE Arizona_base_GOAT_CM_double 0 0 -1.7E+308 1.7E+308 ECU_ADDRESS 0x0028D640 /end MEASUREMENT
/begin MEASUREMENT Arizona_base_GOAT_B.current_carriageAirbag "" FLOAT64_IEEE Arizona_base_GOAT_CM_double 0 0 -1.7E+308 1.7E+308 ECU_ADDRESS 0x0028D530 /end MEASUREMENT
/begin MEASUREMENT Arizona_base_GOAT_B.current_gantryAirbag "" FLOAT64_IEEE Arizona_base_GOAT_CM_double 0 0 -1.7E+308 1.7E+308 ECU_ADDRESS 0x0028D540 /end MEASUREMENT
/begin MEASUREMENT Arizona_base_GOAT_B.current_x3 "" FLOAT64_IEEE Arizona_base_GOAT_CM_double 0 0 -1.7E+308 1.7E+308 ECU_ADDRESS 0x0028D5D8 /end MEASUREMENT
/begin MEASUREMENT Arizona_base_GOAT_B.current_x4 "" FLOAT64_IEEE Arizona_base_GOAT_CM_double 0 0 -1.7E+308 1.7E+308 ECU_ADDRESS 0x0028D5C8 /end MEASUREMENT
/begin MEASUREMENT Arizona_base_GOAT_B.e_phirad "" FLOAT64_IEEE Arizona_base_GOAT_CM_double 0 0 -1.7E+308 1.7E+308 ECU_ADDRESS 0x0028D260 /end MEASUREMENT
/begin MEASUREMENT Arizona_base_GOAT_B.e_xm "" FLOAT64_IEEE Arizona_base_GOAT_CM_double 0 0 -1.7E+308 1.7E+308 ECU_ADDRESS 0x0028D1F0 /end MEASUREMENT
/begin MEASUREMENT Arizona_base_GOAT_B.e_ym "" FLOAT64_IEEE Arizona_base_GOAT_CM_double 0 0 -1.7E+308 1.7E+308 ECU_ADDRESS 0x0028D188 /end MEASUREMENT
/begin MEASUREMENT Arizona_base_GOAT_B.enableAirbags "" FLOAT64_IEEE Arizona_base_GOAT_CM_double 0 0 -1.7E+308 1.7E+308 ECU_ADDRESS 0x0028D538 /end MEASUREMENT
/begin MEASUREMENT Arizona_base_GOAT_B.encodercarriage "" FLOAT64_IEEE Arizona_base_GOAT_CM_double 0 0 -1.7E+308 1.7E+308 ECU_ADDRESS 0x0028D108 /end MEASUREMENT
/begin MEASUREMENT Arizona_base_GOAT_B.encodergantryx1 "" FLOAT64_IEEE Arizona_base_GOAT_CM_double 0 0 -1.7E+308 1.7E+308 ECU_ADDRESS 0x0028D120 /end MEASUREMENT
/begin MEASUREMENT Arizona_base_GOAT_B.encodergantryx2 "" FLOAT64_IEEE Arizona_base_GOAT_CM_double 0 0 -1.7E+308 1.7E+308 ECU_ADDRESS 0x0028D138 /end MEASUREMENT
/begin MEASUREMENT Arizona_base_GOAT_B.errorphi "" FLOAT64_IEEE Arizona_base_GOAT_CM_double 0 0 -1.7E+308 1.7E+308 ECU_ADDRESS 0x0028D258 /end MEASUREMENT
/begin MEASUREMENT Arizona_base_GOAT_B.errorx "" FLOAT64_IEEE Arizona_base_GOAT_CM_double 0 0 -1.7E+308 1.7E+308 ECU_ADDRESS 0x0028D1E8 /end MEASUREMENT
/begin MEASUREMENT Arizona_base_GOAT_B.errory "" FLOAT64_IEEE Arizona_base_GOAT_CM_double 0 0 -1.7E+308 1.7E+308 ECU_ADDRESS 0x0028D180 /end MEASUREMENT
/begin MEASUREMENT Arizona_base_GOAT_B.f_phi "" FLOAT64_IEEE Arizona_base_GOAT_CM_double 0 0 -1.7E+308 1.7E+308 ECU_ADDRESS 0x0028D648 /end MEASUREMENT
/begin MEASUREMENT Arizona_base_GOAT_B.f_x "" FLOAT64_IEEE Arizona_base_GOAT_CM_double 0 0 -1.7E+308 1.7E+308 ECU_ADDRESS 0x0028D650 /end MEASUREMENT
/begin MEASUREMENT Arizona_base_GOAT_B.f_y "" FLOAT64_IEEE Arizona_base_GOAT_CM_double 0 0 -1.7E+308 1.7E+308 ECU_ADDRESS 0x0028D658 /end MEASUREMENT
/begin MEASUREMENT Arizona_base_GOAT_B.gantryx1motorvoltage "" FLOAT64_IEEE Arizona_base_GOAT_CM_double 0 0 -1.7E+308 1.7E+308 ECU_ADDRESS 0x0028D2B8 /end MEASUREMENT
/begin MEASUREMENT Arizona_base_GOAT_B.gantryx2motorvoltage "" FLOAT64_IEEE Arizona_base_GOAT_CM_double 0 0 -1.7E+308 1.7E+308 ECU_ADDRESS 0x0028D2D0 /end MEASUREMENT
/begin MEASUREMENT Arizona_base_GOAT_B.gantryx_Lamplifierenable "" FLOAT64_IEEE Arizona_base_GOAT_CM_double 0 0 -1.7E+308 1.7E+308 ECU_ADDRESS 0x0028D310 /end MEASUREMENT
/begin MEASUREMENT Arizona_base_GOAT_B.gantryx_Lmotorvoltage "" FLOAT64_IEEE Arizona_base_GOAT_CM_double 0 0 -1.7E+308 1.7E+308 ECU_ADDRESS 0x0028D2C8 /end MEASUREMENT
/begin MEASUREMENT Arizona_base_GOAT_B.gantryx_Ramplifierenable "" FLOAT64_IEEE Arizona_base_GOAT_CM_double 0 0 -1.7E+308 1.7E+308 ECU_ADDRESS 0x0028D308 /end MEASUREMENT
/begin MEASUREMENT Arizona_base_GOAT_B.gantryx_Rmotorvoltage "" FLOAT64_IEEE Arizona_base_GOAT_CM_double 0 0 -1.7E+308 1.7E+308 ECU_ADDRESS 0x0028D2B0 /end MEASUREMENT
/begin MEASUREMENT Arizona_base_GOAT_B.homeTrigger "" FLOAT64_IEEE Arizona_base_GOAT_CM_double 0 0 -1.7E+308 1.7E+308 ECU_ADDRESS 0x0028D4C8 /end MEASUREMENT
/begin MEASUREMENT Arizona_base_GOAT_B.home_time "" FLOAT64_IEEE Arizona_base_GOAT_CM_double 0 0 -1.7E+308 1.7E+308 ECU_ADDRESS 0x0028D590 /end MEASUREMENT
/begin MEASUREMENT Arizona_base_GOAT_B.jogSpeed "" FLOAT64_IEEE Arizona_base_GOAT_CM_double 0 0 -1.7E+308 1.7E+308 ECU_ADDRESS 0x0028D3D0 /end MEASUREMENT
/begin MEASUREMENT Arizona_base_GOAT_B.jogdistance_phi_reset "" FLOAT64_IEEE Arizona_base_GOAT_CM_double 0 0 -1.7E+308 1.7E+308 ECU_ADDRESS 0x0028D5E0 /end MEASUREMENT
/begin MEASUREMENT Arizona_base_GOAT_B.jogdistance_x_reset "" FLOAT64_IEEE Arizona_base_GOAT_CM_double 0 0 -1.7E+308 1.7E+308 ECU_ADDRESS 0x0028D5D0 /end MEASUREMENT
/begin MEASUREMENT Arizona_base_GOAT_B.jogdistance_y_reset "" FLOAT64_IEEE Arizona_base_GOAT_CM_double 0 0 -1.7E+308 1.7E+308 ECU_ADDRESS 0x0028D5B0 /end MEASUREMENT
/begin MEASUREMENT Arizona_base_GOAT_B.jogspeed_Theta "" FLOAT64_IEEE Arizona_base_GOAT_CM_double 0 0 -1.7E+308 1.7E+308 ECU_ADDRESS 0x0028D558 /end MEASUREMENT
/begin MEASUREMENT Arizona_base_GOAT_B.jogspeed_Z "" FLOAT64_IEEE Arizona_base_GOAT_CM_double 0 0 -1.7E+308 1.7E+308 ECU_ADDRESS 0x0028D550 /end MEASUREMENT
/begin MEASUREMENT Arizona_base_GOAT_B.jogspeed_xL_reset "" FLOAT64_IEEE Arizona_base_GOAT_CM_double 0 0 -1.7E+308 1.7E+308 ECU_ADDRESS 0x0028D610 /end MEASUREMENT
/begin MEASUREMENT Arizona_base_GOAT_B.jogspeed_xL_reset_j "" FLOAT64_IEEE Arizona_base_GOAT_CM_double 0 0 -1.7E+308 1.7E+308 ECU_ADDRESS 0x0028D628 /end MEASUREMENT
/begin MEASUREMENT Arizona_base_GOAT_B.jogspeed_xR_reset "" FLOAT64_IEEE Arizona_base_GOAT_CM_double 0 0 -1.7E+308 1.7E+308 ECU_ADDRESS 0x0028D608 /end MEASUREMENT
/begin MEASUREMENT Arizona_base_GOAT_B.jogspeed_xR_reset_f "" FLOAT64_IEEE Arizona_base_GOAT_CM_double 0 0 -1.7E+308 1.7E+308 ECU_ADDRESS 0x0028D630 /end MEASUREMENT
/begin MEASUREMENT Arizona_base_GOAT_B.jogspeed_y_reset "" FLOAT64_IEEE Arizona_base_GOAT_CM_double 0 0 -1.7E+308 1.7E+308 ECU_ADDRESS 0x0028D618 /end MEASUREMENT
/begin MEASUREMENT Arizona_base_GOAT_B.jogspeed_y_reset_d "" FLOAT64_IEEE Arizona_base_GOAT_CM_double 0 0 -1.7E+308 1.7E+308 ECU_ADDRESS 0x0028D620 /end MEASUREMENT
/begin MEASUREMENT Arizona_base_GOAT_B.main "" FLOAT64_IEEE Arizona_base_GOAT_CM_double 0 0 -1.7E+308 1.7E+308 ECU_ADDRESS 0x0028D228 /end MEASUREMENT
/begin MEASUREMENT Arizona_base_GOAT_B.penholderActive "" FLOAT64_IEEE Arizona_base_GOAT_CM_double 0 0 -1.7E+308 1.7E+308 ECU_ADDRESS 0x0028D148 /end MEASUREMENT
/begin MEASUREMENT Arizona_base_GOAT_B.phiNomrad "" FLOAT64_IEEE Arizona_base_GOAT_CM_double 0 0 -1.7E+308 1.7E+308 ECU_ADDRESS 0x0028D268 /end MEASUREMENT
/begin MEASUREMENT Arizona_base_GOAT_B.r_phirad "" FLOAT64_IEEE Arizona_base_GOAT_CM_double 0 0 -1.7E+308 1.7E+308 ECU_ADDRESS 0x0028D240 /end MEASUREMENT
/begin MEASUREMENT Arizona_base_GOAT_B.r_xm "" FLOAT64_IEEE Arizona_base_GOAT_CM_double 0 0 -1.7E+308 1.7E+308 ECU_ADDRESS 0x0028D1D0 /end MEASUREMENT
/begin MEASUREMENT Arizona_base_GOAT_B.r_ym "" FLOAT64_IEEE Arizona_base_GOAT_CM_double 0 0 -1.7E+308 1.7E+308 ECU_ADDRESS 0x0028D178 /end MEASUREMENT
/begin MEASUREMENT Arizona_base_GOAT_B.resetDone "" FLOAT64_IEEE Arizona_base_GOAT_CM_double 0 0 -1.7E+308 1.7E+308 ECU_ADDRESS 0x0028D638 /end MEASUREMENT
/begin MEASUREMENT Arizona_base_GOAT_B.startHoming "" FLOAT64_IEEE Arizona_base_GOAT_CM_double 0 0 -1.7E+308 1.7E+308 ECU_ADDRESS 0x0028D378 /end MEASUREMENT
/begin MEASUREMENT Arizona_base_GOAT_B.startPenholder "" FLOAT64_IEEE Arizona_base_GOAT_CM_double 0 0 -1.7E+308 1.7E+308 ECU_ADDRESS 0x0028D388 /end MEASUREMENT
/begin MEASUREMENT Arizona_base_GOAT_B.startTrial "" FLOAT64_IEEE Arizona_base_GOAT_CM_double 0 0 -1.7E+308 1.7E+308 ECU_ADDRESS 0x0028D380 /end MEASUREMENT
/begin MEASUREMENT Arizona_base_GOAT_B.stopSimulation "" FLOAT64_IEEE Arizona_base_GOAT_CM_double 0 0 -1.7E+308 1.7E+308 ECU_ADDRESS 0x0028D548 /end MEASUREMENT
/begin MEASUREMENT Arizona_base_GOAT_B.time "" FLOAT64_IEEE Arizona_base_GOAT_CM_double 0 0 -1.7E+308 1.7E+308 ECU_ADDRESS 0x0028D4F8 /end MEASUREMENT
/begin MEASUREMENT Arizona_base_GOAT_B.trialIndex "" FLOAT64_IEEE Arizona_base_GOAT_CM_double 0 0 -1.7E+308 1.7E+308 ECU_ADDRESS 0x0028D4D8 /end MEASUREMENT
/begin MEASUREMENT Arizona_base_GOAT_B.trialTrigger "" FLOAT64_IEEE Arizona_base_GOAT_CM_double 0 0 -1.7E+308 1.7E+308 ECU_ADDRESS 0x0028D170 /end MEASUREMENT
/begin MEASUREMENT Arizona_base_GOAT_B.trialTrigger_e "" FLOAT64_IEEE Arizona_base_GOAT_CM_double 0 0 -1.7E+308 1.7E+308 ECU_ADDRESS 0x0028D4D0 /end MEASUREMENT
/begin MEASUREMENT Arizona_base_GOAT_B.u_loopback_yV "" FLOAT64_IEEE Arizona_base_GOAT_CM_double 0 0 -1.7E+308 1.7E+308 ECU_ADDRESS 0x0028D140 /end MEASUREMENT
/begin MEASUREMENT Arizona_base_GOAT_B.u_phiV "" FLOAT64_IEEE Arizona_base_GOAT_CM_double 0 0 -1.7E+308 1.7E+308 ECU_ADDRESS 0x0028D298 /end MEASUREMENT
/begin MEASUREMENT Arizona_base_GOAT_B.u_xV "" FLOAT64_IEEE Arizona_base_GOAT_CM_double 0 0 -1.7E+308 1.7E+308 ECU_ADDRESS 0x0028D280 /end MEASUREMENT
/begin MEASUREMENT Arizona_base_GOAT_B.u_yV "" FLOAT64_IEEE Arizona_base_GOAT_CM_double 0 0 -1.7E+308 1.7E+308 ECU_ADDRESS 0x0028D2E8 /end MEASUREMENT
/begin MEASUREMENT Arizona_base_GOAT_B.xNomm "" FLOAT64_IEEE Arizona_base_GOAT_CM_double 0 0 -1.7E+308 1.7E+308 ECU_ADDRESS 0x0028D1F8 /end MEASUREMENT
/begin MEASUREMENT Arizona_base_GOAT_B.x_L_secundairm "" FLOAT64_IEEE Arizona_base_GOAT_CM_double 0 0 -1.7E+308 1.7E+308 ECU_ADDRESS 0x0028D358 /end MEASUREMENT
/begin MEASUREMENT Arizona_base_GOAT_B.x_R_secundairm "" FLOAT64_IEEE Arizona_base_GOAT_CM_double 0 0 -1.7E+308 1.7E+308 ECU_ADDRESS 0x0028D340 /end MEASUREMENT
/begin MEASUREMENT Arizona_base_GOAT_B.yNomm "" FLOAT64_IEEE Arizona_base_GOAT_CM_double 0 0 -1.7E+308 1.7E+308 ECU_ADDRESS 0x0028D190 /end MEASUREMENT
/begin MEASUREMENT Arizona_base_GOAT_B.y_secundairm "" FLOAT64_IEEE Arizona_base_GOAT_CM_double 0 0 -1.7E+308 1.7E+308 ECU_ADDRESS 0x0028D328 /end MEASUREMENT
/begin MEASUREMENT Arizona_base_GOAT_B.yref_check "" FLOAT64_IEEE Arizona_base_GOAT_CM_double 0 0 -1.7E+308 1.7E+308 ECU_ADDRESS 0x0028D500 /end MEASUREMENT
/begin MEASUREMENT Arizona_base_GOAT_DW.Delay1_DSTATE "" FLOAT64_IEEE Arizona_base_GOAT_CM_double 0 0 -1.7E+308 1.7E+308 ECU_ADDRESS 0x0028C950 /end MEASUREMENT
/begin MEASUREMENT Arizona_base_GOAT_DW.Delay1_DSTATE_g "" FLOAT64_IEEE Arizona_base_GOAT_CM_double 0 0 -1.7E+308 1.7E+308 ECU_ADDRESS 0x0028C960 /end MEASUREMENT
/begin MEASUREMENT Arizona_base_GOAT_DW.Delay1_DSTATE_i "" FLOAT64_IEEE Arizona_base_GOAT_CM_double 0 0 -1.7E+308 1.7E+308 ECU_ADDRESS 0x0028C970 /end MEASUREMENT
/begin MEASUREMENT Arizona_base_GOAT_DW.Delay1_DSTATE_o "" FLOAT64_IEEE Arizona_base_GOAT_CM_double 0 0 -1.7E+308 1.7E+308 ECU_ADDRESS 0x0028C988 /end MEASUREMENT
/begin MEASUREMENT Arizona_base_GOAT_DW.Delay2_DSTATE "" FLOAT64_IEEE Arizona_base_GOAT_CM_double 0 0 -1.7E+308 1.7E+308 ECU_ADDRESS 0x0028C948 /end MEASUREMENT
/begin MEASUREMENT Arizona_base_GOAT_DW.Delay_DSTATE "" FLOAT64_IEEE Arizona_base_GOAT_CM_double 0 0 -1.7E+308 1.7E+308 ECU_ADDRESS 0x0028C958 /end MEASUREMENT
/begin MEASUREMENT Arizona_base_GOAT_DW.Delay_DSTATE_h "" FLOAT64_IEEE Arizona_base_GOAT_CM_double 0 0 -1.7E+308 1.7E+308 ECU_ADDRESS 0x0028C990 /end MEASUREMENT
/begin MEASUREMENT Arizona_base_GOAT_DW.Delay_DSTATE_j "" FLOAT64_IEEE Arizona_base_GOAT_CM_double 0 0 -1.7E+308 1.7E+308 ECU_ADDRESS 0x0028C978 /end MEASUREMENT
/begin MEASUREMENT Arizona_base_GOAT_DW.Delay_DSTATE_k "" UBYTE Arizona_base_GOAT_CM_logical 0 0 0 1 ECU_ADDRESS 0x0028D06C /end MEASUREMENT
/begin MEASUREMENT Arizona_base_GOAT_DW.Delay_DSTATE_m "" FLOAT64_IEEE Arizona_base_GOAT_CM_double 0 0 -1.7E+308 1.7E+308 ECU_ADDRESS 0x0028C9D0 /end MEASUREMENT
/begin MEASUREMENT Arizona_base_GOAT_DW.DiscreteTimeIntegratorx1JogSpee "" FLOAT64_IEEE Arizona_base_GOAT_CM_double 0 0 -1.7E+308 1.7E+308 ECU_ADDRESS 0x0028C9E8 /end MEASUREMENT
/begin MEASUREMENT Arizona_base_GOAT_DW.DiscreteTimeIntegratorx2JogSp_a "" FLOAT64_IEEE Arizona_base_GOAT_CM_double 0 0 -1.7E+308 1.7E+308 ECU_ADDRESS 0x0028C9E0 /end MEASUREMENT
/begin MEASUREMENT Arizona_base_GOAT_DW.DiscreteTimeIntegratorx2JogSpee "" FLOAT64_IEEE Arizona_base_GOAT_CM_double 0 0 -1.7E+308 1.7E+308 ECU_ADDRESS 0x0028C9D8 /end MEASUREMENT
/begin MEASUREMENT Arizona_base_GOAT_DW.Enabledsubsystem_MODE "" UBYTE Arizona_base_GOAT_CM_logical 0 0 0 1 ECU_ADDRESS 0x0028D081 /end MEASUREMENT
/begin MEASUREMENT Arizona_base_GOAT_DW.Enabledsubsystem_SubsysRanBC "" SBYTE Arizona_base_GOAT_CM_int8 0 0 -128 127 ECU_ADDRESS 0x0028D06E /end MEASUREMENT
/begin MEASUREMENT Arizona_base_GOAT_DW.Feedforward_SubsysRanBC "" SBYTE Arizona_base_GOAT_CM_int8 0 0 -128 127 ECU_ADDRESS 0x0028D06F /end MEASUREMENT
/begin MEASUREMENT Arizona_base_GOAT_DW.Internal_DSTATE "" FLOAT64_IEEE Arizona_base_GOAT_CM_double 0 0 -1.7E+308 1.7E+308 LAYOUT COLUMN_DIR MATRIX_DIM 2 ECU_ADDRESS 0x0028C998 /end MEASUREMENT
/begin MEASUREMENT Arizona_base_GOAT_DW.Internal_DSTATE_h "" FLOAT64_IEEE Arizona_base_GOAT_CM_double 0 0 -1.7E+308 1.7E+308 LAYOUT COLUMN_DIR MATRIX_DIM 2 ECU_ADDRESS 0x0028C9C0 /end MEASUREMENT
/begin MEASUREMENT Arizona_base_GOAT_DW.Internal_DSTATE_l "" FLOAT64_IEEE Arizona_base_GOAT_CM_double 0 0 -1.7E+308 1.7E+308 LAYOUT COLUMN_DIR MATRIX_DIM 3 ECU_ADDRESS 0x0028C9A8 /end MEASUREMENT
/begin MEASUREMENT Arizona_base_GOAT_DW.Memory_PreviousInput "" FLOAT64_IEEE Arizona_base_GOAT_CM_double 0 0 -1.7E+308 1.7E+308 ECU_ADDRESS 0x0028C9F8 /end MEASUREMENT
/begin MEASUREMENT Arizona_base_GOAT_DW.Trajectory_MODE "" UBYTE Arizona_base_GOAT_CM_logical 0 0 0 1 ECU_ADDRESS 0x0028D080 /end MEASUREMENT
/begin MEASUREMENT Arizona_base_GOAT_DW.Trajectory_SubsysRanBC "" SBYTE Arizona_base_GOAT_CM_int8 0 0 -128 127 ECU_ADDRESS 0x0028D06D /end MEASUREMENT
/begin MEASUREMENT Arizona_base_GOAT_DW.Ts_l "" FLOAT64_IEEE Arizona_base_GOAT_CM_double 0 0 -1.7E+308 1.7E+308 ECU_ADDRESS 0x0028CA20 /end MEASUREMENT
/begin MEASUREMENT Arizona_base_GOAT_DW.UD_DSTATE "" FLOAT64_IEEE Arizona_base_GOAT_CM_double 0 0 -1.7E+308 1.7E+308 ECU_ADDRESS 0x0028C968 /end MEASUREMENT
/begin MEASUREMENT Arizona_base_GOAT_DW.UD_DSTATE_a "" FLOAT64_IEEE Arizona_base_GOAT_CM_double 0 0 -1.7E+308 1.7E+308 ECU_ADDRESS 0x0028C980 /end MEASUREMENT
/begin MEASUREMENT Arizona_base_GOAT_DW.color_pos "" FLOAT64_IEEE Arizona_base_GOAT_CM_double 0 0 -1.7E+308 1.7E+308 ECU_ADDRESS 0x0028CA18 /end MEASUREMENT
/begin MEASUREMENT Arizona_base_GOAT_DW.counter "" FLOAT64_IEEE Arizona_base_GOAT_CM_double 0 0 -1.7E+308 1.7E+308 ECU_ADDRESS 0x0028CA00 /end MEASUREMENT
/begin MEASUREMENT Arizona_base_GOAT_DW.durationCounter_1 "" SLONG Arizona_base_GOAT_CM_int32 0 0 -2147483648 2147483647 ECU_ADDRESS 0x0028D020 /end MEASUREMENT
/begin MEASUREMENT Arizona_base_GOAT_DW.durationCounter_1_d "" SLONG Arizona_base_GOAT_CM_int32 0 0 -2147483648 2147483647 ECU_ADDRESS 0x0028D028 /end MEASUREMENT
/begin MEASUREMENT Arizona_base_GOAT_DW.durationCounter_1_n "" SLONG Arizona_base_GOAT_CM_int32 0 0 -2147483648 2147483647 ECU_ADDRESS 0x0028D024 /end MEASUREMENT
/begin MEASUREMENT Arizona_base_GOAT_DW.is_HOME "" ULONG Arizona_base_GOAT_CM_uint32 0 0 0 4294967295 ECU_ADDRESS 0x0028D050 /end MEASUREMENT
/begin MEASUREMENT Arizona_base_GOAT_DW.is_MAIN "" ULONG Arizona_base_GOAT_CM_uint32 0 0 0 4294967295 ECU_ADDRESS 0x0028D044 /end MEASUREMENT
/begin MEASUREMENT Arizona_base_GOAT_DW.is_ROTATION "" ULONG Arizona_base_GOAT_CM_uint32 0 0 0 4294967295 ECU_ADDRESS 0x0028D04C /end MEASUREMENT
/begin MEASUREMENT Arizona_base_GOAT_DW.is_VERTICAL "" ULONG Arizona_base_GOAT_CM_uint32 0 0 0 4294967295 ECU_ADDRESS 0x0028D048 /end MEASUREMENT
/begin MEASUREMENT Arizona_base_GOAT_DW.is_active_HOME "" UBYTE Arizona_base_GOAT_CM_uint8 0 0 0 255 ECU_ADDRESS 0x0028D079 /end MEASUREMENT
/begin MEASUREMENT Arizona_base_GOAT_DW.is_active_MAIN "" UBYTE Arizona_base_GOAT_CM_uint8 0 0 0 255 ECU_ADDRESS 0x0028D076 /end MEASUREMENT
/begin MEASUREMENT Arizona_base_GOAT_DW.is_active_ROTATION "" UBYTE Arizona_base_GOAT_CM_uint8 0 0 0 255 ECU_ADDRESS 0x0028D078 /end MEASUREMENT
/begin MEASUREMENT Arizona_base_GOAT_DW.is_active_VERTICAL "" UBYTE Arizona_base_GOAT_CM_uint8 0 0 0 255 ECU_ADDRESS 0x0028D077 /end MEASUREMENT
/begin MEASUREMENT Arizona_base_GOAT_DW.is_active_c3_Arizona_base_GOAT "" UBYTE Arizona_base_GOAT_CM_uint8 0 0 0 255 ECU_ADDRESS 0x0028D071 /end MEASUREMENT
/begin MEASUREMENT Arizona_base_GOAT_DW.is_active_c4_Arizona_base_GOAT "" UBYTE Arizona_base_GOAT_CM_uint8 0 0 0 255 ECU_ADDRESS 0x0028D075 /end MEASUREMENT
/begin MEASUREMENT Arizona_base_GOAT_DW.is_active_c5_Arizona_base_GOAT "" UBYTE Arizona_base_GOAT_CM_uint8 0 0 0 255 ECU_ADDRESS 0x0028D070 /end MEASUREMENT
/begin MEASUREMENT Arizona_base_GOAT_DW.is_active_c7_Arizona_base_GOAT "" UBYTE Arizona_base_GOAT_CM_uint8 0 0 0 255 ECU_ADDRESS 0x0028D07C /end MEASUREMENT
/begin MEASUREMENT Arizona_base_GOAT_DW.is_active_carriageAirbag "" UBYTE Arizona_base_GOAT_CM_uint8 0 0 0 255 ECU_ADDRESS 0x0028D074 /end MEASUREMENT
/begin MEASUREMENT Arizona_base_GOAT_DW.is_active_errorAirbag "" UBYTE Arizona_base_GOAT_CM_uint8 0 0 0 255 ECU_ADDRESS 0x0028D073 /end MEASUREMENT
/begin MEASUREMENT Arizona_base_GOAT_DW.is_active_gantryAirbag "" UBYTE Arizona_base_GOAT_CM_uint8 0 0 0 255 ECU_ADDRESS 0x0028D072 /end MEASUREMENT
/begin MEASUREMENT Arizona_base_GOAT_DW.is_active_reset_carriage "" UBYTE Arizona_base_GOAT_CM_uint8 0 0 0 255 ECU_ADDRESS 0x0028D07F /end MEASUREMENT
/begin MEASUREMENT Arizona_base_GOAT_DW.is_active_reset_gantryLeft "" UBYTE Arizona_base_GOAT_CM_uint8 0 0 0 255 ECU_ADDRESS 0x0028D07D /end MEASUREMENT
/begin MEASUREMENT Arizona_base_GOAT_DW.is_active_reset_gantryright "" UBYTE Arizona_base_GOAT_CM_uint8 0 0 0 255 ECU_ADDRESS 0x0028D07E /end MEASUREMENT
/begin MEASUREMENT Arizona_base_GOAT_DW.is_c3_Arizona_base_GOAT "" ULONG Arizona_base_GOAT_CM_uint32 0 0 0 4294967295 ECU_ADDRESS 0x0028D030 /end MEASUREMENT
/begin MEASUREMENT Arizona_base_GOAT_DW.is_c4_Arizona_base_GOAT "" ULONG Arizona_base_GOAT_CM_uint32 0 0 0 4294967295 ECU_ADDRESS 0x0028D040 /end MEASUREMENT
/begin MEASUREMENT Arizona_base_GOAT_DW.is_c5_Arizona_base_GOAT "" ULONG Arizona_base_GOAT_CM_uint32 0 0 0 4294967295 ECU_ADDRESS 0x0028D02C /end MEASUREMENT
/begin MEASUREMENT Arizona_base_GOAT_DW.is_c7_Arizona_base_GOAT "" ULONG Arizona_base_GOAT_CM_uint32 0 0 0 4294967295 ECU_ADDRESS 0x0028D054 /end MEASUREMENT
/begin MEASUREMENT Arizona_base_GOAT_DW.is_carriageAirbag "" ULONG Arizona_base_GOAT_CM_uint32 0 0 0 4294967295 ECU_ADDRESS 0x0028D03C /end MEASUREMENT
/begin MEASUREMENT Arizona_base_GOAT_DW.is_errorAirbag "" ULONG Arizona_base_GOAT_CM_uint32 0 0 0 4294967295 ECU_ADDRESS 0x0028D038 /end MEASUREMENT
/begin MEASUREMENT Arizona_base_GOAT_DW.is_gantryAirbag "" ULONG Arizona_base_GOAT_CM_uint32 0 0 0 4294967295 ECU_ADDRESS 0x0028D034 /end MEASUREMENT
/begin MEASUREMENT Arizona_base_GOAT_DW.is_reset_carriage "" ULONG Arizona_base_GOAT_CM_uint32 0 0 0 4294967295 ECU_ADDRESS 0x0028D060 /end MEASUREMENT
/begin MEASUREMENT Arizona_base_GOAT_DW.is_reset_gantryLeft "" ULONG Arizona_base_GOAT_CM_uint32 0 0 0 4294967295 ECU_ADDRESS 0x0028D058 /end MEASUREMENT
/begin MEASUREMENT Arizona_base_GOAT_DW.is_reset_gantryright "" ULONG Arizona_base_GOAT_CM_uint32 0 0 0 4294967295 ECU_ADDRESS 0x0028D05C /end MEASUREMENT
/begin MEASUREMENT Arizona_base_GOAT_DW.job "" FLOAT64_IEEE Arizona_base_GOAT_CM_double 0 0 -1.7E+308 1.7E+308 ECU_ADDRESS 0x0028CA08 /end MEASUREMENT
/begin MEASUREMENT Arizona_base_GOAT_DW.log_penholder_active_DSTATE "" FLOAT64_IEEE Arizona_base_GOAT_CM_double 0 0 -1.7E+308 1.7E+308 ECU_ADDRESS 0x0028C940 /end MEASUREMENT
/begin MEASUREMENT Arizona_base_GOAT_DW.rot_change "" FLOAT64_IEEE Arizona_base_GOAT_CM_double 0 0 -1.7E+308 1.7E+308 ECU_ADDRESS 0x0028CA10 /end MEASUREMENT
/begin MEASUREMENT Arizona_base_GOAT_DW.sfEvent "" SLONG Arizona_base_GOAT_CM_int32 0 0 -2147483648 2147483647 ECU_ADDRESS 0x0028D010 /end MEASUREMENT
/begin MEASUREMENT Arizona_base_GOAT_DW.sfEvent_h "" SLONG Arizona_base_GOAT_CM_int32 0 0 -2147483648 2147483647 ECU_ADDRESS 0x0028D01C /end MEASUREMENT
/begin MEASUREMENT Arizona_base_GOAT_DW.sfEvent_i "" SLONG Arizona_base_GOAT_CM_int32 0 0 -2147483648 2147483647 ECU_ADDRESS 0x0028D014 /end MEASUREMENT
/begin MEASUREMENT Arizona_base_GOAT_DW.sfEvent_l "" SLONG Arizona_base_GOAT_CM_int32 0 0 -2147483648 2147483647 ECU_ADDRESS 0x0028D018 /end MEASUREMENT
/begin MEASUREMENT Arizona_base_GOAT_DW.temporalCounter_i1 "" UWORD Arizona_base_GOAT_CM_uint16 0 0 0 65535 ECU_ADDRESS 0x0028D06A /end MEASUREMENT
/begin MEASUREMENT Arizona_base_GOAT_DW.temporalCounter_i1_b "" UBYTE Arizona_base_GOAT_CM_uint8 0 0 0 255 ECU_ADDRESS 0x0028D07A /end MEASUREMENT
/begin MEASUREMENT Arizona_base_GOAT_DW.temporalCounter_i2 "" UWORD Arizona_base_GOAT_CM_uint16 0 0 0 65535 ECU_ADDRESS 0x0028D068 /end MEASUREMENT
/begin MEASUREMENT Arizona_base_GOAT_DW.temporalCounter_i3 "" UBYTE Arizona_base_GOAT_CM_uint8 0 0 0 255 ECU_ADDRESS 0x0028D07B /end MEASUREMENT
/begin MEASUREMENT Arizona_base_GOAT_DW.timeIndex "" FLOAT64_IEEE Arizona_base_GOAT_CM_double 0 0 -1.7E+308 1.7E+308 ECU_ADDRESS 0x0028C9F0 /end MEASUREMENT
/begin MEASUREMENT Arizona_base_GOAT_PrevZCX.ResettableSubsystemMemory_Reset "" UBYTE Arizona_base_GOAT_CM_ZCSigState 0 0 0 255 ECU_ADDRESS 0x0028C930 /end MEASUREMENT
/begin COMPU_METHOD Arizona_base_GOAT_CM_ZCSigState "" IDENTICAL "customformat" "" /end COMPU_METHOD
/begin COMPU_METHOD Arizona_base_GOAT_CM_double "" IDENTICAL "%15.10" "" /end COMPU_METHOD
/begin COMPU_METHOD Arizona_base_GOAT_CM_int32 "" IDENTICAL "%10.0" "" /end COMPU_METHOD
/begin COMPU_METHOD Arizona_base_GOAT_CM_int8 "" IDENTICAL "%3.0" "" /end COMPU_METHOD
/begin COMPU_METHOD Arizona_base_GOAT_CM_logical "" IDENTICAL "%1.0" "" /end COMPU_METHOD
/begin COMPU_METHOD Arizona_base_GOAT_CM_uint16 "" IDENTICAL "%5.0" "" /end COMPU_METHOD
/begin COMPU_METHOD Arizona_base_GOAT_CM_uint32 "" IDENTICAL "%10.0" "" /end COMPU_METHOD
/begin COMPU_METHOD Arizona_base_GOAT_CM_uint8 "" IDENTICAL "%3.0" "" /end COMPU_METHOD
/begin RECORD_LAYOUT FixLookup_FLOAT64_IEEE FNC_VALUES 1 FLOAT64_IEEE COLUMN_DIR DIRECT /end RECORD_LAYOUT
/begin RECORD_LAYOUT Scalar_BOOLEAN FNC_VALUES 1 UBYTE COLUMN_DIR DIRECT /end RECORD_LAYOUT
/begin RECORD_LAYOUT Scalar_FLOAT64_IEEE FNC_VALUES 1 FLOAT64_IEEE COLUMN_DIR DIRECT /end RECORD_LAYOUT
/begin RECORD_LAYOUT Scalar_SBYTE FNC_VALUES 1 SBYTE COLUMN_DIR DIRECT /end RECORD_LAYOUT
/begin RECORD_LAYOUT Scalar_SLONG FNC_VALUES 1 SLONG COLUMN_DIR DIRECT /end RECORD_LAYOUT
/begin RECORD_LAYOUT Scalar_UBYTE FNC_VALUES 1 UBYTE COLUMN_DIR DIRECT /end RECORD_LAYOUT
/begin RECORD_LAYOUT Scalar_ULONG FNC_VALUES 1 ULONG COLUMN_DIR DIRECT /end RECORD_LAYOUT
/begin RECORD_LAYOUT Scalar_UWORD FNC_VALUES 1 UWORD COLUMN_DIR DIRECT /end RECORD_LAYOUT
/begin GROUP Arizona_base_GOAT "Arizona_base_GOAT" ROOT
 /begin SUB_GROUP Arizona_base_GOAT_Coupling Arizona_base_GOAT_Decoupling Arizona_base_GOAT_Feedforward Arizona_base_GOAT_Homing Arizona_base_GOAT_IO_Arizona Arizona_base_GOAT_LTI_System Arizona_base_GOAT_LTI_System1 Arizona_base_GOAT_LTI_System2 Arizona_base_GOAT_Penholder_mechanism1 Arizona_base_GOAT_Safety Arizona_base_GOAT_Trajectory /end SUB_GROUP
 /begin REF_CHARACTERISTIC Arizona_base_GOAT_cal_impl.Delay1_InitialCondition_m Arizona_base_GOAT_cal_impl.Delay2_InitialCondition Arizona_base_GOAT_cal_impl.Gain10_Gain Arizona_base_GOAT_cal_impl.Gain8_Gain Arizona_base_GOAT_cal_impl.Gain9_Gain Arizona_base_GOAT_cal_impl.PenColor_Value Arizona_base_GOAT_cal_impl.log_penholder_active_InitialCon Arizona_base_GOAT_cal_impl.startHoming_Value Arizona_base_GOAT_cal_impl.startPenholder_Value Arizona_base_GOAT_cal_impl.startTrial_Value /end REF_CHARACTERISTIC
 /begin REF_MEASUREMENT Arizona_base_GOAT_B.Compare_h2 Arizona_base_GOAT_B.DataTypeConversionendtrial Arizona_base_GOAT_B.Delay2 Arizona_base_GOAT_B.DirectLookupTablechange_color Arizona_base_GOAT_B.DirectLookupTablephiRef Arizona_base_GOAT_B.DirectLookupTablexRef Arizona_base_GOAT_B.Gainphi Arizona_base_GOAT_B.Gainx Arizona_base_GOAT_B.Internal Arizona_base_GOAT_B.Internal_g Arizona_base_GOAT_B.Internal_j Arizona_base_GOAT_B.PenColor Arizona_base_GOAT_B.Switch1 Arizona_base_GOAT_B.Switch1_c Arizona_base_GOAT_B.Switch1_h Arizona_base_GOAT_B.Switch1_hm Arizona_base_GOAT_B.Switch_b Arizona_base_GOAT_B.active Arizona_base_GOAT_B.change_color Arizona_base_GOAT_B.change_color_j Arizona_base_GOAT_B.e_phirad Arizona_base_GOAT_B.e_xm Arizona_base_GOAT_B.e_ym Arizona_base_GOAT_B.encodercarriage Arizona_base_GOAT_B.errorphi Arizona_base_GOAT_B.errorx Arizona_base_GOAT_B.errory Arizona_base_GOAT_B.f_phi Arizona_base_GOAT_B.f_x Arizona_base_GOAT_B.f_y Arizona_base_GOAT_B.homeTrigger Arizona_base_GOAT_B.penholderActive Arizona_base_GOAT_B.r_phirad Arizona_base_GOAT_B.r_xm Arizona_base_GOAT_B.r_ym Arizona_base_GOAT_B.startHoming Arizona_base_GOAT_B.startPenholder Arizona_base_GOAT_B.startTrial Arizona_base_GOAT_B.trialIndex Arizona_base_GOAT_B.trialTrigger Arizona_base_GOAT_B.trialTrigger_e Arizona_base_GOAT_B.u_phiV Arizona_base_GOAT_B.u_xV Arizona_base_GOAT_B.u_yV Arizona_base_GOAT_B.yref_check Arizona_base_GOAT_DW.Delay1_DSTATE_g Arizona_base_GOAT_DW.Delay2_DSTATE Arizona_base_GOAT_DW.is_active_c5_Arizona_base_GOAT Arizona_base_GOAT_DW.is_c5_Arizona_base_GOAT Arizona_base_GOAT_DW.log_penholder_active_DSTATE Arizona_base_GOAT_DW.sfEvent Arizona_base_GOAT_DW.timeIndex /end REF_MEASUREMENT
/end GROUP
/begin GROUP Arizona_base_GOAT_Coupling "Arizona_base_GOAT/Coupling"
 /begin REF_CHARACTERISTIC Arizona_base_GOAT_cal_impl.Gainonu_phi_Gain Arizona_base_GOAT_cal_impl.Gainonu_x_Gain /end REF_CHARACTERISTIC
 /begin REF_MEASUREMENT Arizona_base_GOAT_B.Gainonu_phi Arizona_base_GOAT_B.Gainonu_x Arizona_base_GOAT_B.Sumcurrentx_L Arizona_base_GOAT_B.Sumcurrentx_R Arizona_base_GOAT_B.u_phiV Arizona_base_GOAT_B.u_xV /end REF_MEASUREMENT
/end GROUP
/begin GROUP Arizona_base_GOAT_Decoupling "Arizona_base_GOAT/Decoupling"
 /begin REF_CHARACTERISTIC Arizona_base_GOAT_cal_impl.Gainphi_Gain Arizona_base_GOAT_cal_impl.Gainx_Gain /end REF_CHARACTERISTIC
 /begin REF_MEASUREMENT Arizona_base_GOAT_B.Gainphi Arizona_base_GOAT_B.Gainx Arizona_base_GOAT_B.Sumx_Lx_R Arizona_base_GOAT_B.Sumx_Rx_L Arizona_base_GOAT_B.encodergantryx1 Arizona_base_GOAT_B.encodergantryx2 /end REF_MEASUREMENT
/end GROUP
/begin GROUP Arizona_base_GOAT_Feedforward "Arizona_base_GOAT/Feedforward"
 /begin REF_CHARACTERISTIC Arizona_base_GOAT_cal_impl.phiFF_Y0 Arizona_base_GOAT_cal_impl.set_phiFF_Value Arizona_base_GOAT_cal_impl.set_xFF_Value Arizona_base_GOAT_cal_impl.set_yFF_Value Arizona_base_GOAT_cal_impl.xFF_Y0 Arizona_base_GOAT_cal_impl.yFF_Y0 /end REF_CHARACTERISTIC
 /begin REF_MEASUREMENT Arizona_base_GOAT_B.f_phi Arizona_base_GOAT_B.f_x Arizona_base_GOAT_B.f_y Arizona_base_GOAT_B.time /end REF_MEASUREMENT
/end GROUP
/begin GROUP Arizona_base_GOAT_Homing "Arizona_base_GOAT/Homing"
 /begin SUB_GROUP Arizona_base_GOAT_Homing_Enabled_subsystem Arizona_base_GOAT_Homing_Memory_block_for_homing_during_trials /end SUB_GROUP
/end GROUP
/begin GROUP Arizona_base_GOAT_Homing_Enabled_subsystem "Arizona_base_GOAT/Homing/Enabled subsystem"
 /begin SUB_GROUP Arizona_base_GOAT_Homing_Enabled_subsystem_Initialization Arizona_base_GOAT_Homing_Enabled_subsystem_Reset /end SUB_GROUP
 /begin REF_CHARACTERISTIC Arizona_base_GOAT_cal_impl.homingDone_Y0 Arizona_base_GOAT_cal_impl.phiHome_Y0 Arizona_base_GOAT_cal_impl.xHome_Y0 Arizona_base_GOAT_cal_impl.yHome_Y0 /end REF_CHARACTERISTIC
 /begin REF_MEASUREMENT Arizona_base_GOAT_B.AddphiHome Arizona_base_GOAT_B.AddxHome Arizona_base_GOAT_B.AddyHome Arizona_base_GOAT_B.DirectLookupTablephiFF Arizona_base_GOAT_B.DirectLookupTablexFF Arizona_base_GOAT_B.DirectLookupTableyFF Arizona_base_GOAT_B.jogdistance_phi_reset Arizona_base_GOAT_B.jogdistance_x_reset Arizona_base_GOAT_B.jogdistance_y_reset /end REF_MEASUREMENT
/end GROUP
/begin GROUP Arizona_base_GOAT_Homing_Enabled_subsystem_Initialization "Arizona_base_GOAT/Homing/Enabled subsystem/Initialization"
 /begin SUB_GROUP Arizona_base_GOAT_Homing_Enabled_subsystem_Initialization_Compare_To_Constant_NInit /end SUB_GROUP
 /begin REF_CHARACTERISTIC Arizona_base_GOAT_cal_impl.Constant1_Value Arizona_base_GOAT_cal_impl.Constant_Value Arizona_base_GOAT_cal_impl.Delay_InitialCondition Arizona_base_GOAT_cal_impl.Switch_Threshold /end REF_CHARACTERISTIC
 /begin REF_MEASUREMENT Arizona_base_GOAT_B.Compare_b Arizona_base_GOAT_B.DataTypeConversionendtrial Arizona_base_GOAT_B.Delay_l Arizona_base_GOAT_B.DirectLookupTablephiFF Arizona_base_GOAT_B.DirectLookupTablexFF Arizona_base_GOAT_B.DirectLookupTableyFF Arizona_base_GOAT_B.Sum_b Arizona_base_GOAT_B.Switch_bb Arizona_base_GOAT_B.home_time Arizona_base_GOAT_B.resetDone Arizona_base_GOAT_DW.Delay_DSTATE_m /end REF_MEASUREMENT
/end GROUP
/begin GROUP Arizona_base_GOAT_Homing_Enabled_subsystem_Initialization_Compare_To_Constant_NInit "Arizona_base_GOAT/Homing/Enabled subsystem/Initialization/Compare To
Constant NInit"
 /begin REF_MEASUREMENT Arizona_base_GOAT_B.Compare_b Arizona_base_GOAT_B.home_time /end REF_MEASUREMENT
/end GROUP
/begin GROUP Arizona_base_GOAT_Homing_Enabled_subsystem_Reset "Arizona_base_GOAT/Homing/Enabled subsystem/Reset"
 /begin REF_CHARACTERISTIC Arizona_base_GOAT_cal_impl.Dct2lowpassx1JogSpeed_P1 Arizona_base_GOAT_cal_impl.Dct2lowpassx1JogSpeed_P2 Arizona_base_GOAT_cal_impl.Dct2lowpassx1JogSpeed_P3 Arizona_base_GOAT_cal_impl.Dct2lowpassx2JogSpeed_P1 Arizona_base_GOAT_cal_impl.Dct2lowpassx2JogSpeed_P2 Arizona_base_GOAT_cal_impl.Dct2lowpassx2JogSpeed_P3 Arizona_base_GOAT_cal_impl.Dct2lowpassyJogSpeed_P1 Arizona_base_GOAT_cal_impl.Dct2lowpassyJogSpeed_P2 Arizona_base_GOAT_cal_impl.Dct2lowpassyJogSpeed_P3 Arizona_base_GOAT_cal_impl.DiscreteTimeIntegratorx1JogSp_k Arizona_base_GOAT_cal_impl.DiscreteTimeIntegratorx1JogSpee Arizona_base_GOAT_cal_impl.DiscreteTimeIntegratorx2JogSp_e Arizona_base_GOAT_cal_impl.DiscreteTimeIntegratorx2JogSp_m Arizona_base_GOAT_cal_impl.DiscreteTimeIntegratorx2JogSp_n Arizona_base_GOAT_cal_impl.DiscreteTimeIntegratorx2JogSpee Arizona_base_GOAT_cal_impl.Gainx2_Gain Arizona_base_GOAT_cal_impl.Gainx3_Gain /end REF_CHARACTERISTIC
 /begin REF_MEASUREMENT Arizona_base_GOAT_B.DIcarriagelimitswitch Arizona_base_GOAT_B.DIgantryx1limitswitch Arizona_base_GOAT_B.DIgantryx2limitswitch Arizona_base_GOAT_B.DiscreteTimeIntegratorx1JogSpee Arizona_base_GOAT_B.DiscreteTimeIntegratorx2JogSpee Arizona_base_GOAT_B.change_color_j Arizona_base_GOAT_B.current_x3 Arizona_base_GOAT_B.current_x4 Arizona_base_GOAT_B.jogdistance_phi_reset Arizona_base_GOAT_B.jogdistance_x_reset Arizona_base_GOAT_B.jogdistance_y_reset Arizona_base_GOAT_B.jogspeed_xL_reset Arizona_base_GOAT_B.jogspeed_xL_reset_j Arizona_base_GOAT_B.jogspeed_xR_reset Arizona_base_GOAT_B.jogspeed_xR_reset_f Arizona_base_GOAT_B.jogspeed_y_reset Arizona_base_GOAT_B.jogspeed_y_reset_d Arizona_base_GOAT_B.penholderActive Arizona_base_GOAT_B.resetDone Arizona_base_GOAT_DW.DiscreteTimeIntegratorx1JogSpee Arizona_base_GOAT_DW.DiscreteTimeIntegratorx2JogSp_a Arizona_base_GOAT_DW.DiscreteTimeIntegratorx2JogSpee Arizona_base_GOAT_DW.Ts_l Arizona_base_GOAT_DW.durationCounter_1 Arizona_base_GOAT_DW.durationCounter_1_d Arizona_base_GOAT_DW.durationCounter_1_n Arizona_base_GOAT_DW.is_active_c7_Arizona_base_GOAT Arizona_base_GOAT_DW.is_active_reset_carriage Arizona_base_GOAT_DW.is_active_reset_gantryLeft Arizona_base_GOAT_DW.is_active_reset_gantryright Arizona_base_GOAT_DW.is_c7_Arizona_base_GOAT Arizona_base_GOAT_DW.is_reset_carriage Arizona_base_GOAT_DW.is_reset_gantryLeft Arizona_base_GOAT_DW.is_reset_gantryright Arizona_base_GOAT_DW.sfEvent_h Arizona_base_GOAT_DW.temporalCounter_i1 /end REF_MEASUREMENT
/end GROUP
/begin GROUP Arizona_base_GOAT_Homing_Memory_block_for_homing_during_trials "Arizona_base_GOAT/Homing/Memory block for homing during trials"
 /begin SUB_GROUP Arizona_base_GOAT_Homing_Memory_block_for_homing_during_trials_Memory_phi Arizona_base_GOAT_Homing_Memory_block_for_homing_during_trials_Memory_x Arizona_base_GOAT_Homing_Memory_block_for_homing_during_trials_Memory_y /end SUB_GROUP
/end GROUP
/begin GROUP Arizona_base_GOAT_Homing_Memory_block_for_homing_during_trials_Memory_phi "Arizona_base_GOAT/Homing/Memory block for homing during trials/Memory_phi"
 /begin REF_CHARACTERISTIC Arizona_base_GOAT_cal_impl.Delay1_InitialCondition_l Arizona_base_GOAT_cal_impl.Delay_InitialCondition_a Arizona_base_GOAT_cal_impl.Switch1_Threshold_e Arizona_base_GOAT_cal_impl.Switch_Threshold_l /end REF_CHARACTERISTIC
 /begin REF_MEASUREMENT Arizona_base_GOAT_B.AddphiHome Arizona_base_GOAT_B.Delay1_b Arizona_base_GOAT_B.Delay2 Arizona_base_GOAT_B.Delay_j Arizona_base_GOAT_B.Memory_loop_phi Arizona_base_GOAT_B.Switch1_c Arizona_base_GOAT_B.main Arizona_base_GOAT_DW.Delay1_DSTATE_o Arizona_base_GOAT_DW.Delay_DSTATE_h /end REF_MEASUREMENT
/end GROUP
/begin GROUP Arizona_base_GOAT_Homing_Memory_block_for_homing_during_trials_Memory_x "Arizona_base_GOAT/Homing/Memory block for homing during trials/Memory_x"
 /begin REF_CHARACTERISTIC Arizona_base_GOAT_cal_impl.Delay1_InitialCondition_mu Arizona_base_GOAT_cal_impl.Delay_InitialCondition_d Arizona_base_GOAT_cal_impl.Switch1_Threshold_m Arizona_base_GOAT_cal_impl.Switch_Threshold_b /end REF_CHARACTERISTIC
 /begin REF_MEASUREMENT Arizona_base_GOAT_B.AddxHome Arizona_base_GOAT_B.Delay1_g Arizona_base_GOAT_B.Delay2 Arizona_base_GOAT_B.Delay_m Arizona_base_GOAT_B.Memory_loop_x Arizona_base_GOAT_B.Sum_k Arizona_base_GOAT_B.Switch1_h Arizona_base_GOAT_DW.Delay1_DSTATE_i Arizona_base_GOAT_DW.Delay_DSTATE_j /end REF_MEASUREMENT
/end GROUP
/begin GROUP Arizona_base_GOAT_Homing_Memory_block_for_homing_during_trials_Memory_y "Arizona_base_GOAT/Homing/Memory block for homing during trials/Memory_y"
 /begin REF_CHARACTERISTIC Arizona_base_GOAT_cal_impl.Delay1_InitialCondition Arizona_base_GOAT_cal_impl.Delay_InitialCondition_o Arizona_base_GOAT_cal_impl.Switch1_Threshold Arizona_base_GOAT_cal_impl.Switch_Threshold_o /end REF_CHARACTERISTIC
 /begin REF_MEASUREMENT Arizona_base_GOAT_B.AddyHome Arizona_base_GOAT_B.Delay Arizona_base_GOAT_B.Delay1 Arizona_base_GOAT_B.Delay2 Arizona_base_GOAT_B.Memory_loop_y Arizona_base_GOAT_B.Sum_o Arizona_base_GOAT_B.Switch1 Arizona_base_GOAT_DW.Delay1_DSTATE Arizona_base_GOAT_DW.Delay_DSTATE /end REF_MEASUREMENT
/end GROUP
/begin GROUP Arizona_base_GOAT_IO_Arizona "Arizona_base_GOAT/IO Arizona"
 /begin REF_CHARACTERISTIC Arizona_base_GOAT_cal_impl.Analoginput1_P1 Arizona_base_GOAT_cal_impl.Analoginput1_P10 Arizona_base_GOAT_cal_impl.Analoginput1_P11 Arizona_base_GOAT_cal_impl.Analoginput1_P12 Arizona_base_GOAT_cal_impl.Analoginput1_P2 Arizona_base_GOAT_cal_impl.Analoginput1_P3 Arizona_base_GOAT_cal_impl.Analoginput1_P4 Arizona_base_GOAT_cal_impl.Analoginput1_P5 Arizona_base_GOAT_cal_impl.Analoginput1_P6 Arizona_base_GOAT_cal_impl.Analoginput1_P7 Arizona_base_GOAT_cal_impl.Analoginput1_P8 Arizona_base_GOAT_cal_impl.Analoginput1_P9 Arizona_base_GOAT_cal_impl.Analogoutput2_P1 Arizona_base_GOAT_cal_impl.Analogoutput2_P10 Arizona_base_GOAT_cal_impl.Analogoutput2_P11 Arizona_base_GOAT_cal_impl.Analogoutput2_P12 Arizona_base_GOAT_cal_impl.Analogoutput2_P13 Arizona_base_GOAT_cal_impl.Analogoutput2_P14 Arizona_base_GOAT_cal_impl.Analogoutput2_P2 Arizona_base_GOAT_cal_impl.Analogoutput2_P3 Arizona_base_GOAT_cal_impl.Analogoutput2_P4 Arizona_base_GOAT_cal_impl.Analogoutput2_P5 Arizona_base_GOAT_cal_impl.Analogoutput2_P6 Arizona_base_GOAT_cal_impl.Analogoutput2_P7 Arizona_base_GOAT_cal_impl.Analogoutput2_P8 Arizona_base_GOAT_cal_impl.Analogoutput2_P9 Arizona_base_GOAT_cal_impl.Calibration1_Gain Arizona_base_GOAT_cal_impl.Calibration2_Gain Arizona_base_GOAT_cal_impl.Calibration3_Gain Arizona_base_GOAT_cal_impl.Calibration4_Gain Arizona_base_GOAT_cal_impl.Calibration5_Gain Arizona_base_GOAT_cal_impl.Calibration6_Gain Arizona_base_GOAT_cal_impl.Cariagesecundair_P1 Arizona_base_GOAT_cal_impl.Cariagesecundair_P10 Arizona_base_GOAT_cal_impl.Cariagesecundair_P11 Arizona_base_GOAT_cal_impl.Cariagesecundair_P12 Arizona_base_GOAT_cal_impl.Cariagesecundair_P13 Arizona_base_GOAT_cal_impl.Cariagesecundair_P14 Arizona_base_GOAT_cal_impl.Cariagesecundair_P15 Arizona_base_GOAT_cal_impl.Cariagesecundair_P16 Arizona_base_GOAT_cal_impl.Cariagesecundair_P17 Arizona_base_GOAT_cal_impl.Cariagesecundair_P18 Arizona_base_GOAT_cal_impl.Cariagesecundair_P19 Arizona_base_GOAT_cal_impl.Cariagesecundair_P2 Arizona_base_GOAT_cal_impl.Cariagesecundair_P20 Arizona_base_GOAT_cal_impl.Cariagesecundair_P21 Arizona_base_GOAT_cal_impl.Cariagesecundair_P22 Arizona_base_GOAT_cal_impl.Cariagesecundair_P23 Arizona_base_GOAT_cal_impl.Cariagesecundair_P24 Arizona_base_GOAT_cal_impl.Cariagesecundair_P3 Arizona_base_GOAT_cal_impl.Cariagesecundair_P4 Arizona_base_GOAT_cal_impl.Cariagesecundair_P5 Arizona_base_GOAT_cal_impl.Cariagesecundair_P6 Arizona_base_GOAT_cal_impl.Cariagesecundair_P7 Arizona_base_GOAT_cal_impl.Cariagesecundair_P8 Arizona_base_GOAT_cal_impl.Cariagesecundair_P9 Arizona_base_GOAT_cal_impl.Carriageencoder_P1 Arizona_base_GOAT_cal_impl.Carriageencoder_P10 Arizona_base_GOAT_cal_impl.Carriageencoder_P11 Arizona_base_GOAT_cal_impl.Carriageencoder_P12 Arizona_base_GOAT_cal_impl.Carriageencoder_P13 Arizona_base_GOAT_cal_impl.Carriageencoder_P14 Arizona_base_GOAT_cal_impl.Carriageencoder_P15 Arizona_base_GOAT_cal_impl.Carriageencoder_P16 Arizona_base_GOAT_cal_impl.Carriageencoder_P17 Arizona_base_GOAT_cal_impl.Carriageencoder_P18 Arizona_base_GOAT_cal_impl.Carriageencoder_P19 Arizona_base_GOAT_cal_impl.Carriageencoder_P2 Arizona_base_GOAT_cal_impl.Carriageencoder_P20 Arizona_base_GOAT_cal_impl.Carriageencoder_P21 Arizona_base_GOAT_cal_impl.Carriageencoder_P22 Arizona_base_GOAT_cal_impl.Carriageencoder_P23 Arizona_base_GOAT_cal_impl.Carriageencoder_P24 Arizona_base_GOAT_cal_impl.Carriageencoder_P3 Arizona_base_GOAT_cal_impl.Carriageencoder_P4 Arizona_base_GOAT_cal_impl.Carriageencoder_P5 Arizona_base_GOAT_cal_impl.Carriageencoder_P6 Arizona_base_GOAT_cal_impl.Carriageencoder_P7 Arizona_base_GOAT_cal_impl.Carriageencoder_P8 Arizona_base_GOAT_cal_impl.Carriageencoder_P9 Arizona_base_GOAT_cal_impl.DILimitCarriage_P1 Arizona_base_GOAT_cal_impl.DILimitCarriage_P2 Arizona_base_GOAT_cal_impl.DILimitCarriage_P3 Arizona_base_GOAT_cal_impl.DILimitCarriage_P4 Arizona_base_GOAT_cal_impl.DILimitCarriage_P5 Arizona_base_GOAT_cal_impl.DILimitCarriage_P6 Arizona_base_GOAT_cal_impl.DILimitCarriagesecundairwerk_ix Arizona_base_GOAT_cal_impl.DILimitCarriagesecundairwerk_nn Arizona_base_GOAT_cal_impl.DILimitCarriagesecundairwerkt_a Arizona_base_GOAT_cal_impl.DILimitCarriagesecundairwerkt_g Arizona_base_GOAT_cal_impl.DILimitCarriagesecundairwerkt_l Arizona_base_GOAT_cal_impl.DILimitCarriagesecundairwerkt_n Arizona_base_GOAT_cal_impl.DILimitGantryx1GantryxR_P1 Arizona_base_GOAT_cal_impl.DILimitGantryx1GantryxR_P2 Arizona_base_GOAT_cal_impl.DILimitGantryx1GantryxR_P3 Arizona_base_GOAT_cal_impl.DILimitGantryx1GantryxR_P4 Arizona_base_GOAT_cal_impl.DILimitGantryx1GantryxR_P5 Arizona_base_GOAT_cal_impl.DILimitGantryx1GantryxR_P6 Arizona_base_GOAT_cal_impl.DILimitGantryx1secundairGant_du Arizona_base_GOAT_cal_impl.DILimitGantryx1secundairGant_ir Arizona_base_GOAT_cal_impl.DILimitGantryx1secundairGant_ns Arizona_base_GOAT_cal_impl.DILimitGantryx1secundairGantr_b Arizona_base_GOAT_cal_impl.DILimitGantryx1secundairGantr_d Arizona_base_GOAT_cal_impl.DILimitGantryx1secundairGantr_n Arizona_base_GOAT_cal_impl.DILimitGantryx2GantryxL_P1 Arizona_base_GOAT_cal_impl.DILimitGantryx2GantryxL_P2 Arizona_base_GOAT_cal_impl.DILimitGantryx2GantryxL_P3 Arizona_base_GOAT_cal_impl.DILimitGantryx2GantryxL_P4 Arizona_base_GOAT_cal_impl.DILimitGantryx2GantryxL_P5 Arizona_base_GOAT_cal_impl.DILimitGantryx2GantryxL_P6 Arizona_base_GOAT_cal_impl.DILimitGantryx2secundairGant_dj Arizona_base_GOAT_cal_impl.DILimitGantryx2secundairGantr_a Arizona_base_GOAT_cal_impl.DILimitGantryx2secundairGantr_d Arizona_base_GOAT_cal_impl.DILimitGantryx2secundairGantr_f Arizona_base_GOAT_cal_impl.DILimitGantryx2secundairGantr_l Arizona_base_GOAT_cal_impl.DILimitGantryx2secundairGantr_o Arizona_base_GOAT_cal_impl.DIblacksoftwarebutton_P1 Arizona_base_GOAT_cal_impl.DIblacksoftwarebutton_P2 Arizona_base_GOAT_cal_impl.DIblacksoftwarebutton_P3 Arizona_base_GOAT_cal_impl.DIblacksoftwarebutton_P4 Arizona_base_GOAT_cal_impl.DIblacksoftwarebutton_P5 Arizona_base_GOAT_cal_impl.DIblacksoftwarebutton_P6 Arizona_base_GOAT_cal_impl.DIcarriageampfaultstatus_P1 Arizona_base_GOAT_cal_impl.DIcarriageampfaultstatus_P2 Arizona_base_GOAT_cal_impl.DIcarriageampfaultstatus_P3 Arizona_base_GOAT_cal_impl.DIcarriageampfaultstatus_P4 Arizona_base_GOAT_cal_impl.DIcarriageampfaultstatus_P5 Arizona_base_GOAT_cal_impl.DIcarriageampfaultstatus_P6 Arizona_base_GOAT_cal_impl.DIgantryx1faultstatus_P1 Arizona_base_GOAT_cal_impl.DIgantryx1faultstatus_P2 Arizona_base_GOAT_cal_impl.DIgantryx1faultstatus_P3 Arizona_base_GOAT_cal_impl.DIgantryx1faultstatus_P4 Arizona_base_GOAT_cal_impl.DIgantryx1faultstatus_P5 Arizona_base_GOAT_cal_impl.DIgantryx1faultstatus_P6 Arizona_base_GOAT_cal_impl.DIgantryx2faultstatus_P1 Arizona_base_GOAT_cal_impl.DIgantryx2faultstatus_P2 Arizona_base_GOAT_cal_impl.DIgantryx2faultstatus_P3 Arizona_base_GOAT_cal_impl.DIgantryx2faultstatus_P4 Arizona_base_GOAT_cal_impl.DIgantryx2faultstatus_P5 Arizona_base_GOAT_cal_impl.DIgantryx2faultstatus_P6 Arizona_base_GOAT_cal_impl.DIredsoftwarebutton_P1 Arizona_base_GOAT_cal_impl.DIredsoftwarebutton_P2 Arizona_base_GOAT_cal_impl.DIredsoftwarebutton_P3 Arizona_base_GOAT_cal_impl.DIredsoftwarebutton_P4 Arizona_base_GOAT_cal_impl.DIredsoftwarebutton_P5 Arizona_base_GOAT_cal_impl.DIredsoftwarebutton_P6 Arizona_base_GOAT_cal_impl.DOInhibitCarriage_P1 Arizona_base_GOAT_cal_impl.DOInhibitCarriage_P2 Arizona_base_GOAT_cal_impl.DOInhibitCarriage_P3 Arizona_base_GOAT_cal_impl.DOInhibitCarriage_P4 Arizona_base_GOAT_cal_impl.DOInhibitCarriage_P5 Arizona_base_GOAT_cal_impl.DOInhibitCarriage_P6 Arizona_base_GOAT_cal_impl.DOInhibitCarriage_P7 Arizona_base_GOAT_cal_impl.DOInhibitCarriage_P8 Arizona_base_GOAT_cal_impl.DOInhibitGantryx1GantryxR_P1 Arizona_base_GOAT_cal_impl.DOInhibitGantryx1GantryxR_P2 Arizona_base_GOAT_cal_impl.DOInhibitGantryx1GantryxR_P3 Arizona_base_GOAT_cal_impl.DOInhibitGantryx1GantryxR_P4 Arizona_base_GOAT_cal_impl.DOInhibitGantryx1GantryxR_P5 Arizona_base_GOAT_cal_impl.DOInhibitGantryx1GantryxR_P6 Arizona_base_GOAT_cal_impl.DOInhibitGantryx1GantryxR_P7 Arizona_base_GOAT_cal_impl.DOInhibitGantryx1GantryxR_P8 Arizona_base_GOAT_cal_impl.DOInhibitGantryx2DOGantryxL_P1 Arizona_base_GOAT_cal_impl.DOInhibitGantryx2DOGantryxL_P2 Arizona_base_GOAT_cal_impl.DOInhibitGantryx2DOGantryxL_P3 Arizona_base_GOAT_cal_impl.DOInhibitGantryx2DOGantryxL_P4 Arizona_base_GOAT_cal_impl.DOInhibitGantryx2DOGantryxL_P5 Arizona_base_GOAT_cal_impl.DOInhibitGantryx2DOGantryxL_P6 Arizona_base_GOAT_cal_impl.DOInhibitGantryx2DOGantryxL_P7 Arizona_base_GOAT_cal_impl.DOInhibitGantryx2DOGantryxL_P8 Arizona_base_GOAT_cal_impl.Gain10_Gain_n Arizona_base_GOAT_cal_impl.Gain1_Gain Arizona_base_GOAT_cal_impl.Gain5_Gain Arizona_base_GOAT_cal_impl.Gain6_Gain Arizona_base_GOAT_cal_impl.Gain7_Gain Arizona_base_GOAT_cal_impl.Gain8_Gain_l Arizona_base_GOAT_cal_impl.Gain9_Gain_j Arizona_base_GOAT_cal_impl.Gain_Gain Arizona_base_GOAT_cal_impl.Gaincarriagemotorcurrent_Gain Arizona_base_GOAT_cal_impl.Gaingantryx2motorcurrent1_Gain Arizona_base_GOAT_cal_impl.Gaingantryx2motorcurrent_Gain Arizona_base_GOAT_cal_impl.GantryX1secundair_P1 Arizona_base_GOAT_cal_impl.GantryX1secundair_P10 Arizona_base_GOAT_cal_impl.GantryX1secundair_P11 Arizona_base_GOAT_cal_impl.GantryX1secundair_P12 Arizona_base_GOAT_cal_impl.GantryX1secundair_P13 Arizona_base_GOAT_cal_impl.GantryX1secundair_P14 Arizona_base_GOAT_cal_impl.GantryX1secundair_P15 Arizona_base_GOAT_cal_impl.GantryX1secundair_P16 Arizona_base_GOAT_cal_impl.GantryX1secundair_P17 Arizona_base_GOAT_cal_impl.GantryX1secundair_P18 Arizona_base_GOAT_cal_impl.GantryX1secundair_P19 Arizona_base_GOAT_cal_impl.GantryX1secundair_P2 Arizona_base_GOAT_cal_impl.GantryX1secundair_P20 Arizona_base_GOAT_cal_impl.GantryX1secundair_P21 Arizona_base_GOAT_cal_impl.GantryX1secundair_P22 Arizona_base_GOAT_cal_impl.GantryX1secundair_P23 Arizona_base_GOAT_cal_impl.GantryX1secundair_P24 Arizona_base_GOAT_cal_impl.GantryX1secundair_P3 Arizona_base_GOAT_cal_impl.GantryX1secundair_P4 Arizona_base_GOAT_cal_impl.GantryX1secundair_P5 Arizona_base_GOAT_cal_impl.GantryX1secundair_P6 Arizona_base_GOAT_cal_impl.GantryX1secundair_P7 Arizona_base_GOAT_cal_impl.GantryX1secundair_P8 Arizona_base_GOAT_cal_impl.GantryX1secundair_P9 Arizona_base_GOAT_cal_impl.Gantryx1GantryxR_P1 Arizona_base_GOAT_cal_impl.Gantryx1GantryxR_P10 Arizona_base_GOAT_cal_impl.Gantryx1GantryxR_P11 Arizona_base_GOAT_cal_impl.Gantryx1GantryxR_P12 Arizona_base_GOAT_cal_impl.Gantryx1GantryxR_P13 Arizona_base_GOAT_cal_impl.Gantryx1GantryxR_P14 Arizona_base_GOAT_cal_impl.Gantryx1GantryxR_P15 Arizona_base_GOAT_cal_impl.Gantryx1GantryxR_P16 Arizona_base_GOAT_cal_impl.Gantryx1GantryxR_P17 Arizona_base_GOAT_cal_impl.Gantryx1GantryxR_P18 Arizona_base_GOAT_cal_impl.Gantryx1GantryxR_P19 Arizona_base_GOAT_cal_impl.Gantryx1GantryxR_P2 Arizona_base_GOAT_cal_impl.Gantryx1GantryxR_P20 Arizona_base_GOAT_cal_impl.Gantryx1GantryxR_P21 Arizona_base_GOAT_cal_impl.Gantryx1GantryxR_P22 Arizona_base_GOAT_cal_impl.Gantryx1GantryxR_P23 Arizona_base_GOAT_cal_impl.Gantryx1GantryxR_P24 Arizona_base_GOAT_cal_impl.Gantryx1GantryxR_P3 Arizona_base_GOAT_cal_impl.Gantryx1GantryxR_P4 Arizona_base_GOAT_cal_impl.Gantryx1GantryxR_P5 Arizona_base_GOAT_cal_impl.Gantryx1GantryxR_P6 Arizona_base_GOAT_cal_impl.Gantryx1GantryxR_P7 Arizona_base_GOAT_cal_impl.Gantryx1GantryxR_P8 Arizona_base_GOAT_cal_impl.Gantryx1GantryxR_P9 Arizona_base_GOAT_cal_impl.Gantryx2GantryxL_P1 Arizona_base_GOAT_cal_impl.Gantryx2GantryxL_P10 Arizona_base_GOAT_cal_impl.Gantryx2GantryxL_P11 Arizona_base_GOAT_cal_impl.Gantryx2GantryxL_P12 Arizona_base_GOAT_cal_impl.Gantryx2GantryxL_P13 Arizona_base_GOAT_cal_impl.Gantryx2GantryxL_P14 Arizona_base_GOAT_cal_impl.Gantryx2GantryxL_P15 Arizona_base_GOAT_cal_impl.Gantryx2GantryxL_P16 Arizona_base_GOAT_cal_impl.Gantryx2GantryxL_P17 Arizona_base_GOAT_cal_impl.Gantryx2GantryxL_P18 Arizona_base_GOAT_cal_impl.Gantryx2GantryxL_P19 Arizona_base_GOAT_cal_impl.Gantryx2GantryxL_P2 Arizona_base_GOAT_cal_impl.Gantryx2GantryxL_P20 Arizona_base_GOAT_cal_impl.Gantryx2GantryxL_P21 Arizona_base_GOAT_cal_impl.Gantryx2GantryxL_P22 Arizona_base_GOAT_cal_impl.Gantryx2GantryxL_P23 Arizona_base_GOAT_cal_impl.Gantryx2GantryxL_P24 Arizona_base_GOAT_cal_impl.Gantryx2GantryxL_P3 Arizona_base_GOAT_cal_impl.Gantryx2GantryxL_P4 Arizona_base_GOAT_cal_impl.Gantryx2GantryxL_P5 Arizona_base_GOAT_cal_impl.Gantryx2GantryxL_P6 Arizona_base_GOAT_cal_impl.Gantryx2GantryxL_P7 Arizona_base_GOAT_cal_impl.Gantryx2GantryxL_P8 Arizona_base_GOAT_cal_impl.Gantryx2GantryxL_P9 Arizona_base_GOAT_cal_impl.GentryX2secundair_P1 Arizona_base_GOAT_cal_impl.GentryX2secundair_P10 Arizona_base_GOAT_cal_impl.GentryX2secundair_P11 Arizona_base_GOAT_cal_impl.GentryX2secundair_P12 Arizona_base_GOAT_cal_impl.GentryX2secundair_P13 Arizona_base_GOAT_cal_impl.GentryX2secundair_P14 Arizona_base_GOAT_cal_impl.GentryX2secundair_P15 Arizona_base_GOAT_cal_impl.GentryX2secundair_P16 Arizona_base_GOAT_cal_impl.GentryX2secundair_P17 Arizona_base_GOAT_cal_impl.GentryX2secundair_P18 Arizona_base_GOAT_cal_impl.GentryX2secundair_P19 Arizona_base_GOAT_cal_impl.GentryX2secundair_P2 Arizona_base_GOAT_cal_impl.GentryX2secundair_P20 Arizona_base_GOAT_cal_impl.GentryX2secundair_P21 Arizona_base_GOAT_cal_impl.GentryX2secundair_P22 Arizona_base_GOAT_cal_impl.GentryX2secundair_P23 Arizona_base_GOAT_cal_impl.GentryX2secundair_P24 Arizona_base_GOAT_cal_impl.GentryX2secundair_P3 Arizona_base_GOAT_cal_impl.GentryX2secundair_P4 Arizona_base_GOAT_cal_impl.GentryX2secundair_P5 Arizona_base_GOAT_cal_impl.GentryX2secundair_P6 Arizona_base_GOAT_cal_impl.GentryX2secundair_P7 Arizona_base_GOAT_cal_impl.GentryX2secundair_P8 Arizona_base_GOAT_cal_impl.GentryX2secundair_P9 Arizona_base_GOAT_cal_impl.Setup1_P1 Arizona_base_GOAT_cal_impl.Setup1_P10 Arizona_base_GOAT_cal_impl.Setup1_P11 Arizona_base_GOAT_cal_impl.Setup1_P12 Arizona_base_GOAT_cal_impl.Setup1_P13 Arizona_base_GOAT_cal_impl.Setup1_P14 Arizona_base_GOAT_cal_impl.Setup1_P15 Arizona_base_GOAT_cal_impl.Setup1_P16 Arizona_base_GOAT_cal_impl.Setup1_P17 Arizona_base_GOAT_cal_impl.Setup1_P18 Arizona_base_GOAT_cal_impl.Setup1_P19 Arizona_base_GOAT_cal_impl.Setup1_P2 Arizona_base_GOAT_cal_impl.Setup1_P20 Arizona_base_GOAT_cal_impl.Setup1_P21 Arizona_base_GOAT_cal_impl.Setup1_P22 Arizona_base_GOAT_cal_impl.Setup1_P23 Arizona_base_GOAT_cal_impl.Setup1_P24 Arizona_base_GOAT_cal_impl.Setup1_P25 Arizona_base_GOAT_cal_impl.Setup1_P26 Arizona_base_GOAT_cal_impl.Setup1_P27 Arizona_base_GOAT_cal_impl.Setup1_P28 Arizona_base_GOAT_cal_impl.Setup1_P29 Arizona_base_GOAT_cal_impl.Setup1_P3 Arizona_base_GOAT_cal_impl.Setup1_P30 Arizona_base_GOAT_cal_impl.Setup1_P31 Arizona_base_GOAT_cal_impl.Setup1_P32 Arizona_base_GOAT_cal_impl.Setup1_P33 Arizona_base_GOAT_cal_impl.Setup1_P34 Arizona_base_GOAT_cal_impl.Setup1_P35 Arizona_base_GOAT_cal_impl.Setup1_P36 Arizona_base_GOAT_cal_impl.Setup1_P37 Arizona_base_GOAT_cal_impl.Setup1_P4 Arizona_base_GOAT_cal_impl.Setup1_P5 Arizona_base_GOAT_cal_impl.Setup1_P6 Arizona_base_GOAT_cal_impl.Setup1_P7 Arizona_base_GOAT_cal_impl.Setup1_P8 Arizona_base_GOAT_cal_impl.Setup1_P9 /end REF_CHARACTERISTIC
 /begin REF_MEASUREMENT Arizona_base_GOAT_B.AIcarriagevelocitymonitor Arizona_base_GOAT_B.Analoginput1_o2 Arizona_base_GOAT_B.Calibration1 Arizona_base_GOAT_B.Calibration2 Arizona_base_GOAT_B.Calibration3 Arizona_base_GOAT_B.Calibration4 Arizona_base_GOAT_B.Calibration5 Arizona_base_GOAT_B.Calibration6 Arizona_base_GOAT_B.Cariagesecundair Arizona_base_GOAT_B.Carriageencoder Arizona_base_GOAT_B.DIblacksoftwarebutton Arizona_base_GOAT_B.DIblacksofwarefunctionbutton Arizona_base_GOAT_B.DIcarriageamplifyerstatus Arizona_base_GOAT_B.DIcarriagelimitswitch Arizona_base_GOAT_B.DIcarriagelimitswitchsecundaird Arizona_base_GOAT_B.DIgantryx1amplifyerstatus Arizona_base_GOAT_B.DIgantryx1limitswitch Arizona_base_GOAT_B.DIgantryx1limitswitchsecundaird Arizona_base_GOAT_B.DIgantryx2amplifyerstatus Arizona_base_GOAT_B.DIgantryx2limitswitch Arizona_base_GOAT_B.DIgantryx2limitswitchsecundaird Arizona_base_GOAT_B.DIredsoftwarefunctionbutton Arizona_base_GOAT_B.GantryX1secundair Arizona_base_GOAT_B.Gantryx1GantryxR Arizona_base_GOAT_B.Gantryx2GantryxL Arizona_base_GOAT_B.GentryX2secundair Arizona_base_GOAT_B.analogvelin Arizona_base_GOAT_B.carriageamplifierenable Arizona_base_GOAT_B.carriagemotorvoltage Arizona_base_GOAT_B.carriagemotorvoltage_o Arizona_base_GOAT_B.encodercarriage Arizona_base_GOAT_B.encodergantryx1 Arizona_base_GOAT_B.encodergantryx2 Arizona_base_GOAT_B.gantryx1motorvoltage Arizona_base_GOAT_B.gantryx2motorvoltage Arizona_base_GOAT_B.gantryx_Lamplifierenable Arizona_base_GOAT_B.gantryx_Lmotorvoltage Arizona_base_GOAT_B.gantryx_Ramplifierenable Arizona_base_GOAT_B.gantryx_Rmotorvoltage Arizona_base_GOAT_B.u_loopback_yV Arizona_base_GOAT_B.x_L_secundairm Arizona_base_GOAT_B.x_R_secundairm Arizona_base_GOAT_B.y_secundairm Arizona_base_GOAT_DW.Analoginput1_PWORK Arizona_base_GOAT_DW.Analogoutput2_PWORK Arizona_base_GOAT_DW.Cariagesecundair_PWORK Arizona_base_GOAT_DW.Carriageencoder_PWORK Arizona_base_GOAT_DW.DILimitCarriage_PWORK Arizona_base_GOAT_DW.DILimitCarriagesecundairwerktni Arizona_base_GOAT_DW.DILimitGantryx1GantryxR_PWORK Arizona_base_GOAT_DW.DILimitGantryx1secundairGantryx Arizona_base_GOAT_DW.DILimitGantryx2GantryxL_PWORK Arizona_base_GOAT_DW.DILimitGantryx2secundairGantryx Arizona_base_GOAT_DW.DIblacksoftwarebutton_PWORK Arizona_base_GOAT_DW.DIcarriageampfaultstatus_PWORK Arizona_base_GOAT_DW.DIgantryx1faultstatus_PWORK Arizona_base_GOAT_DW.DIgantryx2faultstatus_PWORK Arizona_base_GOAT_DW.DIredsoftwarebutton_PWORK Arizona_base_GOAT_DW.DOInhibitCarriage_PWORK Arizona_base_GOAT_DW.DOInhibitGantryx1GantryxR_PWORK Arizona_base_GOAT_DW.DOInhibitGantryx2DOGantryxL_PWO Arizona_base_GOAT_DW.GantryX1secundair_PWORK Arizona_base_GOAT_DW.Gantryx1GantryxR_PWORK Arizona_base_GOAT_DW.Gantryx2GantryxL_PWORK Arizona_base_GOAT_DW.GentryX2secundair_PWORK Arizona_base_GOAT_DW.Setup_PWORK /end REF_MEASUREMENT
/end GROUP
/begin GROUP Arizona_base_GOAT_LTI_System "Arizona_base_GOAT/LTI System"
 /begin REF_CHARACTERISTIC Arizona_base_GOAT_cal_impl.Internal_A_g Arizona_base_GOAT_cal_impl.Internal_B_j Arizona_base_GOAT_cal_impl.Internal_C_l Arizona_base_GOAT_cal_impl.Internal_D_f Arizona_base_GOAT_cal_impl.Internal_InitialCondition_o /end REF_CHARACTERISTIC
 /begin REF_MEASUREMENT Arizona_base_GOAT_B.Internal_g Arizona_base_GOAT_B.e_ym Arizona_base_GOAT_DW.Internal_DSTATE_h /end REF_MEASUREMENT
/end GROUP
/begin GROUP Arizona_base_GOAT_LTI_System1 "Arizona_base_GOAT/LTI System1"
 /begin REF_CHARACTERISTIC Arizona_base_GOAT_cal_impl.Internal_A Arizona_base_GOAT_cal_impl.Internal_B Arizona_base_GOAT_cal_impl.Internal_C Arizona_base_GOAT_cal_impl.Internal_D Arizona_base_GOAT_cal_impl.Internal_InitialCondition /end REF_CHARACTERISTIC
 /begin REF_MEASUREMENT Arizona_base_GOAT_B.Internal Arizona_base_GOAT_B.e_xm Arizona_base_GOAT_DW.Internal_DSTATE /end REF_MEASUREMENT
/end GROUP
/begin GROUP Arizona_base_GOAT_LTI_System2 "Arizona_base_GOAT/LTI System2"
 /begin REF_CHARACTERISTIC Arizona_base_GOAT_cal_impl.Internal_A_p Arizona_base_GOAT_cal_impl.Internal_B_g Arizona_base_GOAT_cal_impl.Internal_C_i Arizona_base_GOAT_cal_impl.Internal_D_g Arizona_base_GOAT_cal_impl.Internal_InitialCondition_e /end REF_CHARACTERISTIC
 /begin REF_MEASUREMENT Arizona_base_GOAT_B.Internal_j Arizona_base_GOAT_B.e_phirad Arizona_base_GOAT_DW.Internal_DSTATE_l /end REF_MEASUREMENT
/end GROUP
/begin GROUP Arizona_base_GOAT_Penholder_mechanism1 "Arizona_base_GOAT/Penholder mechanism1"
 /begin SUB_GROUP Arizona_base_GOAT_Penholder_mechanism1_Motor_Theta Arizona_base_GOAT_Penholder_mechanism1_Motor_Z /end SUB_GROUP
 /begin REF_CHARACTERISTIC Arizona_base_GOAT_cal_impl.Gainonphi2_Gain Arizona_base_GOAT_cal_impl.Gainonphi3_Gain Arizona_base_GOAT_cal_impl.log_jogspeed_Gain /end REF_CHARACTERISTIC
 /begin REF_MEASUREMENT Arizona_base_GOAT_B.DataTypeConversion1 Arizona_base_GOAT_B.DataTypeConversion2 Arizona_base_GOAT_B.DataTypeConversion3 Arizona_base_GOAT_B.DataTypeConversionendtrial Arizona_base_GOAT_B.Gainonphi2 Arizona_base_GOAT_B.Gainonphi3 Arizona_base_GOAT_B.Switch1_hm Arizona_base_GOAT_B.active Arizona_base_GOAT_B.jogSpeed Arizona_base_GOAT_B.jogspeed_Theta Arizona_base_GOAT_B.jogspeed_Z Arizona_base_GOAT_DW.color_pos Arizona_base_GOAT_DW.counter Arizona_base_GOAT_DW.is_HOME Arizona_base_GOAT_DW.is_MAIN Arizona_base_GOAT_DW.is_ROTATION Arizona_base_GOAT_DW.is_VERTICAL Arizona_base_GOAT_DW.is_active_HOME Arizona_base_GOAT_DW.is_active_MAIN Arizona_base_GOAT_DW.is_active_ROTATION Arizona_base_GOAT_DW.is_active_VERTICAL Arizona_base_GOAT_DW.is_active_c4_Arizona_base_GOAT Arizona_base_GOAT_DW.is_c4_Arizona_base_GOAT Arizona_base_GOAT_DW.job Arizona_base_GOAT_DW.rot_change Arizona_base_GOAT_DW.sfEvent_l Arizona_base_GOAT_DW.temporalCounter_i1_b Arizona_base_GOAT_DW.temporalCounter_i2 Arizona_base_GOAT_DW.temporalCounter_i3 /end REF_MEASUREMENT
/end GROUP
/begin GROUP Arizona_base_GOAT_Penholder_mechanism1_Motor_Theta "Arizona_base_GOAT/Penholder mechanism1/Motor Theta"
 /begin SUB_GROUP Arizona_base_GOAT_Penholder_mechanism1_Motor_Theta_Compare_To_Zero Arizona_base_GOAT_Penholder_mechanism1_Motor_Theta_PWMcreator5 /end SUB_GROUP
 /begin REF_MEASUREMENT Arizona_base_GOAT_B.Abs Arizona_base_GOAT_B.Compare Arizona_base_GOAT_B.DataTypeConversion Arizona_base_GOAT_B.Gainonphi2 /end REF_MEASUREMENT
/end GROUP
/begin GROUP Arizona_base_GOAT_Penholder_mechanism1_Motor_Theta_Compare_To_Zero "Arizona_base_GOAT/Penholder mechanism1/Motor Theta/Compare
To Zero" /begin REF_CHARACTERISTIC Arizona_base_GOAT_cal_impl.Constant_Value_a /end REF_CHARACTERISTIC /begin REF_MEASUREMENT Arizona_base_GOAT_B.Abs Arizona_base_GOAT_B.Compare /end REF_MEASUREMENT /end GROUP
/begin GROUP Arizona_base_GOAT_Penholder_mechanism1_Motor_Theta_PWMcreator5 "Arizona_base_GOAT/Penholder mechanism1/Motor Theta/PWMcreator5"
 /begin SUB_GROUP Arizona_base_GOAT_Penholder_mechanism1_Motor_Theta_PWMcreator5_Compare_To_Constant /end SUB_GROUP
 /begin REF_CHARACTERISTIC Arizona_base_GOAT_cal_impl.Gain1_Gain_o Arizona_base_GOAT_cal_impl.Gain8_Gain_e Arizona_base_GOAT_cal_impl.Gain_Gain_c Arizona_base_GOAT_cal_impl.PWM1_Value Arizona_base_GOAT_cal_impl.Saturation2_LowerSat Arizona_base_GOAT_cal_impl.Saturation2_UpperSat Arizona_base_GOAT_cal_impl.basefreq_Value Arizona_base_GOAT_cal_impl.dutycycleblockwave1_Value Arizona_base_GOAT_cal_impl.dutycycleblockwave_Value /end REF_CHARACTERISTIC
 /begin REF_MEASUREMENT Arizona_base_GOAT_B.Abs1 Arizona_base_GOAT_B.Abs_d Arizona_base_GOAT_B.Compare_p Arizona_base_GOAT_B.Divide Arizona_base_GOAT_B.Divide1 Arizona_base_GOAT_B.Divide2 Arizona_base_GOAT_B.Divide3 Arizona_base_GOAT_B.Gain Arizona_base_GOAT_B.Gain1 Arizona_base_GOAT_B.Gain8 Arizona_base_GOAT_B.Gainonphi2 Arizona_base_GOAT_B.Sign2 Arizona_base_GOAT_B.Subtract Arizona_base_GOAT_B.Switch Arizona_base_GOAT_B.XtranMo_DIR /end REF_MEASUREMENT
/end GROUP
/begin GROUP Arizona_base_GOAT_Penholder_mechanism1_Motor_Theta_PWMcreator5_Compare_To_Constant "Arizona_base_GOAT/Penholder mechanism1/Motor Theta/PWMcreator5/Compare
To Constant" /begin REF_CHARACTERISTIC Arizona_base_GOAT_cal_impl.CompareToConstant_const /end REF_CHARACTERISTIC /begin REF_MEASUREMENT Arizona_base_GOAT_B.Abs1 Arizona_base_GOAT_B.Compare_p /end REF_MEASUREMENT /end GROUP
/begin GROUP Arizona_base_GOAT_Penholder_mechanism1_Motor_Z "Arizona_base_GOAT/Penholder mechanism1/Motor Z"
 /begin SUB_GROUP Arizona_base_GOAT_Penholder_mechanism1_Motor_Z_Compare_To_Zero1 Arizona_base_GOAT_Penholder_mechanism1_Motor_Z_PWMcreator1 /end SUB_GROUP
 /begin REF_MEASUREMENT Arizona_base_GOAT_B.Abs1_l Arizona_base_GOAT_B.Compare_l Arizona_base_GOAT_B.DataTypeConversion1_n Arizona_base_GOAT_B.Gainonphi3 /end REF_MEASUREMENT
/end GROUP
/begin GROUP Arizona_base_GOAT_Penholder_mechanism1_Motor_Z_Compare_To_Zero1 "Arizona_base_GOAT/Penholder mechanism1/Motor Z/Compare
To Zero1" /begin REF_CHARACTERISTIC Arizona_base_GOAT_cal_impl.Constant_Value_l /end REF_CHARACTERISTIC /begin REF_MEASUREMENT Arizona_base_GOAT_B.Abs1_l Arizona_base_GOAT_B.Compare_l /end REF_MEASUREMENT /end GROUP
/begin GROUP Arizona_base_GOAT_Penholder_mechanism1_Motor_Z_PWMcreator1 "Arizona_base_GOAT/Penholder mechanism1/Motor Z/PWMcreator1"
 /begin SUB_GROUP Arizona_base_GOAT_Penholder_mechanism1_Motor_Z_PWMcreator1_Compare_To_Constant /end SUB_GROUP
 /begin REF_CHARACTERISTIC Arizona_base_GOAT_cal_impl.Gain1_Gain_i Arizona_base_GOAT_cal_impl.Gain8_Gain_c Arizona_base_GOAT_cal_impl.Gain_Gain_f Arizona_base_GOAT_cal_impl.PWM1_Value_l Arizona_base_GOAT_cal_impl.Saturation2_LowerSat_e Arizona_base_GOAT_cal_impl.Saturation2_UpperSat_m Arizona_base_GOAT_cal_impl.basefreq_Value_i Arizona_base_GOAT_cal_impl.dutycycleblockwave1_Value_k Arizona_base_GOAT_cal_impl.dutycycleblockwave_Value_h /end REF_CHARACTERISTIC
 /begin REF_MEASUREMENT Arizona_base_GOAT_B.Abs1_m Arizona_base_GOAT_B.Abs_dw Arizona_base_GOAT_B.Compare_h Arizona_base_GOAT_B.Divide1_c Arizona_base_GOAT_B.Divide2_c Arizona_base_GOAT_B.Divide3_g Arizona_base_GOAT_B.Divide_b Arizona_base_GOAT_B.Gain1_d Arizona_base_GOAT_B.Gain8_o Arizona_base_GOAT_B.Gain_b Arizona_base_GOAT_B.Gainonphi3 Arizona_base_GOAT_B.Sign2_g Arizona_base_GOAT_B.Subtract_g Arizona_base_GOAT_B.Switch_i Arizona_base_GOAT_B.XtranMo_DIR_k /end REF_MEASUREMENT
/end GROUP
/begin GROUP Arizona_base_GOAT_Penholder_mechanism1_Motor_Z_PWMcreator1_Compare_To_Constant "Arizona_base_GOAT/Penholder mechanism1/Motor Z/PWMcreator1/Compare
To Constant" /begin REF_CHARACTERISTIC Arizona_base_GOAT_cal_impl.CompareToConstant_const_n /end REF_CHARACTERISTIC /begin REF_MEASUREMENT Arizona_base_GOAT_B.Abs1_m Arizona_base_GOAT_B.Compare_h /end REF_MEASUREMENT /end GROUP
/begin GROUP Arizona_base_GOAT_Safety "Arizona_base_GOAT/Safety"
 /begin SUB_GROUP Arizona_base_GOAT_Safety_Discrete_Derivative_output_x Arizona_base_GOAT_Safety_Discrete_Derivative_output_y /end SUB_GROUP
 /begin REF_CHARACTERISTIC Arizona_base_GOAT_cal_impl.Dct2lowpasscurrent_carriageAi_c Arizona_base_GOAT_cal_impl.Dct2lowpasscurrent_carriageAi_l Arizona_base_GOAT_cal_impl.Dct2lowpasscurrent_carriageAi_n Arizona_base_GOAT_cal_impl.Dct2lowpasscurrent_gantryAirb_a Arizona_base_GOAT_cal_impl.Dct2lowpasscurrent_gantryAirb_e Arizona_base_GOAT_cal_impl.Dct2lowpasscurrent_gantryAirb_m Arizona_base_GOAT_cal_impl.Dct2lowpassoutput_x_P1 Arizona_base_GOAT_cal_impl.Dct2lowpassoutput_x_P2 Arizona_base_GOAT_cal_impl.Dct2lowpassoutput_x_P3 Arizona_base_GOAT_cal_impl.Dct2lowpassoutput_y_P1 Arizona_base_GOAT_cal_impl.Dct2lowpassoutput_y_P2 Arizona_base_GOAT_cal_impl.Dct2lowpassoutput_y_P3 Arizona_base_GOAT_cal_impl.Enable_amplifier_xL_Value Arizona_base_GOAT_cal_impl.Enable_amplifier_xR_Value Arizona_base_GOAT_cal_impl.Enable_amplifier_y_Value /end REF_CHARACTERISTIC
 /begin REF_MEASUREMENT Arizona_base_GOAT_B.DataTypeConversionendtrial Arizona_base_GOAT_B.Dct2lowpasscurrent_carriageAirb Arizona_base_GOAT_B.Dct2lowpasscurrent_gantryAirbag Arizona_base_GOAT_B.Dct2lowpassoutput_x Arizona_base_GOAT_B.Dct2lowpassoutput_y Arizona_base_GOAT_B.Diff Arizona_base_GOAT_B.Diff_n Arizona_base_GOAT_B.Gainphi Arizona_base_GOAT_B.Gainx Arizona_base_GOAT_B.Sumcurrentx_L Arizona_base_GOAT_B.Sumcurrentx_R Arizona_base_GOAT_B.Switch1 Arizona_base_GOAT_B.Switch1_c Arizona_base_GOAT_B.Switch1_h Arizona_base_GOAT_B.carriageamplifierenable Arizona_base_GOAT_B.carriagemotorvoltage Arizona_base_GOAT_B.current_carriageAirbag Arizona_base_GOAT_B.current_gantryAirbag Arizona_base_GOAT_B.e_phirad Arizona_base_GOAT_B.e_xm Arizona_base_GOAT_B.e_ym Arizona_base_GOAT_B.enableAirbags Arizona_base_GOAT_B.encodercarriage Arizona_base_GOAT_B.gantryx_Lamplifierenable Arizona_base_GOAT_B.gantryx_Lmotorvoltage Arizona_base_GOAT_B.gantryx_Ramplifierenable Arizona_base_GOAT_B.gantryx_Rmotorvoltage Arizona_base_GOAT_B.phiNomrad Arizona_base_GOAT_B.stopSimulation Arizona_base_GOAT_B.u_yV Arizona_base_GOAT_B.xNomm Arizona_base_GOAT_B.yNomm Arizona_base_GOAT_DW.is_active_c3_Arizona_base_GOAT Arizona_base_GOAT_DW.is_active_carriageAirbag Arizona_base_GOAT_DW.is_active_errorAirbag Arizona_base_GOAT_DW.is_active_gantryAirbag Arizona_base_GOAT_DW.is_c3_Arizona_base_GOAT Arizona_base_GOAT_DW.is_carriageAirbag Arizona_base_GOAT_DW.is_errorAirbag Arizona_base_GOAT_DW.is_gantryAirbag Arizona_base_GOAT_DW.sfEvent_i /end REF_MEASUREMENT
/end GROUP
/begin GROUP Arizona_base_GOAT_Safety_Discrete_Derivative_output_x "Arizona_base_GOAT/Safety/Discrete Derivative
output_x"
 /begin REF_CHARACTERISTIC Arizona_base_GOAT_cal_impl.DiscreteDerivativeoutput_x_ICPr Arizona_base_GOAT_cal_impl.TSamp_WtEt_p /end REF_CHARACTERISTIC
 /begin REF_MEASUREMENT Arizona_base_GOAT_B.Dct2lowpassoutput_x Arizona_base_GOAT_B.Diff_n Arizona_base_GOAT_B.TSamp_n Arizona_base_GOAT_B.Uk1_o Arizona_base_GOAT_DW.UD_DSTATE_a /end REF_MEASUREMENT
/end GROUP
/begin GROUP Arizona_base_GOAT_Safety_Discrete_Derivative_output_y "Arizona_base_GOAT/Safety/Discrete Derivative
output_y"
 /begin REF_CHARACTERISTIC Arizona_base_GOAT_cal_impl.DiscreteDerivativeoutput_y_ICPr Arizona_base_GOAT_cal_impl.TSamp_WtEt /end REF_CHARACTERISTIC
 /begin REF_MEASUREMENT Arizona_base_GOAT_B.Dct2lowpassoutput_y Arizona_base_GOAT_B.Diff Arizona_base_GOAT_B.TSamp Arizona_base_GOAT_B.Uk1 Arizona_base_GOAT_DW.UD_DSTATE /end REF_MEASUREMENT
/end GROUP
/begin GROUP Arizona_base_GOAT_Trajectory "Arizona_base_GOAT/Trajectory"
 /begin SUB_GROUP Arizona_base_GOAT_Trajectory_Compare_To_Constant Arizona_base_GOAT_Trajectory_Resettable_Subsystem____Memory /end SUB_GROUP
 /begin REF_CHARACTERISTIC Arizona_base_GOAT_cal_impl.Constant_Value_e Arizona_base_GOAT_cal_impl.Delay_InitialCondition_g Arizona_base_GOAT_cal_impl.change_color_Y0 Arizona_base_GOAT_cal_impl.phiRef_Y0 Arizona_base_GOAT_cal_impl.set_cRef_Value Arizona_base_GOAT_cal_impl.set_phiRef_Value Arizona_base_GOAT_cal_impl.set_xRef_Value Arizona_base_GOAT_cal_impl.set_yRef_Value Arizona_base_GOAT_cal_impl.time_Y0 Arizona_base_GOAT_cal_impl.trialDone_Y0 Arizona_base_GOAT_cal_impl.xRef_Y0 Arizona_base_GOAT_cal_impl.yRef_Y0 /end REF_CHARACTERISTIC
 /begin REF_MEASUREMENT Arizona_base_GOAT_B.Compare_h2 Arizona_base_GOAT_B.Delay_c Arizona_base_GOAT_B.DirectLookupTablechange_color Arizona_base_GOAT_B.DirectLookupTablephiRef Arizona_base_GOAT_B.DirectLookupTablexRef Arizona_base_GOAT_B.LogicalOperator Arizona_base_GOAT_B.Memory Arizona_base_GOAT_B.Product Arizona_base_GOAT_B.Sum Arizona_base_GOAT_B.penholderActive Arizona_base_GOAT_B.time Arizona_base_GOAT_B.yref_check Arizona_base_GOAT_DW.Delay_DSTATE_k /end REF_MEASUREMENT
/end GROUP
/begin GROUP Arizona_base_GOAT_Trajectory_Compare_To_Constant "Arizona_base_GOAT/Trajectory/Compare
To Constant" /begin REF_MEASUREMENT Arizona_base_GOAT_B.Compare_h2 Arizona_base_GOAT_B.time /end REF_MEASUREMENT /end GROUP
/begin GROUP Arizona_base_GOAT_Trajectory_Resettable_Subsystem____Memory "Arizona_base_GOAT/Trajectory/Resettable
Subsystem // Memory" /begin REF_CHARACTERISTIC Arizona_base_GOAT_cal_impl.Memory_InitialCondition /end REF_CHARACTERISTIC
 /begin REF_MEASUREMENT Arizona_base_GOAT_B.Memory Arizona_base_GOAT_B.Sum Arizona_base_GOAT_DW.Memory_PreviousInput /end REF_MEASUREMENT
/end GROUP
/end MODULE
/end PROJECT
