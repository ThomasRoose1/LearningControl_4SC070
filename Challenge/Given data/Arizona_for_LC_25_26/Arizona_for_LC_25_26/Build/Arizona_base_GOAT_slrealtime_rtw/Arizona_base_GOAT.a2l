/******************************************************************************
* ASAP2 file: Arizona_base_GOAT.a2l
* Academic License - for use in teaching, academic research, and meeting
* course requirements at degree granting institutions only. Not for
* government, commercial, or other organizational use.
* Code generation for model "Arizona_base_GOAT".
* Model version : 12.234
* Simulink Coder version : 10.5 R2022a
* C source code generated on : Fri May 29 15:31:10 2026
* Target selection: slrealtime.tlc
* Embedded hardware selection: Intel->x86-64 (Linux 64)
* Code generation objectives: Unspecified
* Validation result: Not run
* (add additional file header information here)
******************************************************************************/ ASAP2_VERSION 1 71
/begin PROJECT ProjectName "Project Comment Goes Here"
/begin HEADER "Header Comments go here" /end HEADER
/begin MODULE ModuleName "Module Comment Goes Here"
/begin IF_DATA XCP
 /begin PROTOCOL_LAYER 0x0100 0x03E8 0x00C8 0x0000 0x0000 0x0000 0x0000 0x0000 0xFC 0x0578 BYTE_ORDER_MSB_LAST ADDRESS_GRANULARITY_BYTE OPTIONAL_CMD ALLOC_ODT_ENTRY OPTIONAL_CMD ALLOC_ODT OPTIONAL_CMD ALLOC_DAQ OPTIONAL_CMD FREE_DAQ OPTIONAL_CMD GET_DAQ_CLOCK OPTIONAL_CMD GET_DAQ_RESOLUTION_INFO OPTIONAL_CMD GET_DAQ_PROCESSOR_INFO OPTIONAL_CMD START_STOP_SYNCH OPTIONAL_CMD START_STOP_DAQ_LIST OPTIONAL_CMD SET_DAQ_LIST_MODE OPTIONAL_CMD WRITE_DAQ OPTIONAL_CMD SET_DAQ_PTR OPTIONAL_CMD GET_CAL_PAGE OPTIONAL_CMD SET_CAL_PAGE OPTIONAL_CMD COPY_CAL_PAGE OPTIONAL_CMD SHORT_DOWNLOAD OPTIONAL_CMD DOWNLOAD_MAX OPTIONAL_CMD DOWNLOAD OPTIONAL_CMD SHORT_UPLOAD OPTIONAL_CMD UPLOAD OPTIONAL_CMD SET_MTA OPTIONAL_CMD GET_SEGMENT_INFO OPTIONAL_CMD GET_PAGE_INFO OPTIONAL_CMD SET_SEGMENT_MODE OPTIONAL_CMD GET_SEGMENT_MODE OPTIONAL_CMD GET_PAG_PROCESSOR_INFO OPTIONAL_CMD MODIFY_BITS /end PROTOCOL_LAYER
 /begin DAQ DYNAMIC 0x0000 0x0080 0x00 OPTIMISATION_TYPE_DEFAULT ADDRESS_EXTENSION_FREE IDENTIFICATION_FIELD_TYPE_RELATIVE_WORD_ALIGNED GRANULARITY_ODT_ENTRY_SIZE_DAQ_BYTE 0xFF OVERLOAD_INDICATION_PID PRESCALER_SUPPORTED /begin STIM GRANULARITY_ODT_ENTRY_SIZE_STIM_BYTE 0xFF /end STIM /begin TIMESTAMP_SUPPORTED 0x0001 SIZE_DWORD UNIT_1US TIMESTAMP_FIXED /end TIMESTAMP_SUPPORTED /begin EVENT "1 ms" "1 ms" 0x0000 DAQ 0xFF 0x01 0x06 0x00 /end EVENT /end DAQ
 /begin XCP_ON_UDP_IP 0x0100 0x15B3 ADDRESS "192.168.7.5" /end XCP_ON_UDP_IP
/end IF_DATA
/begin MOD_PAR "MOD PAR Comment Goes Here"
 /begin MEMORY_SEGMENT RTE_Param_Service "RTE_Param_Service" DATA FLASH INTERN 0x0025DA60 0x9AC0 -1 -1 -1 -1 -1
  /begin IF_DATA XCP
   /begin SEGMENT 0x00 0x02 0x00 0x00 0x00
    /begin PAGE 0x00 ECU_ACCESS_DONT_CARE XCP_READ_ACCESS_DONT_CARE XCP_WRITE_ACCESS_NOT_ALLOWED /end PAGE
    /begin PAGE 0x01 ECU_ACCESS_DONT_CARE XCP_READ_ACCESS_DONT_CARE XCP_WRITE_ACCESS_DONT_CARE /end PAGE
   /end SEGMENT
  /end IF_DATA
 /end MEMORY_SEGMENT
 /begin MEMORY_SEGMENT Arizona_base_GOAT_cal_impl "Arizona_base_GOAT_cal_impl" DATA FLASH INTERN 0x00222060 0x3B9B0 -1 -1 -1 -1 -1
  /begin IF_DATA XCP
   /begin SEGMENT 0x01 0x02 0x00 0x00 0x00
    /begin PAGE 0x00 ECU_ACCESS_DONT_CARE XCP_READ_ACCESS_DONT_CARE XCP_WRITE_ACCESS_NOT_ALLOWED /end PAGE
    /begin PAGE 0x01 ECU_ACCESS_DONT_CARE XCP_READ_ACCESS_DONT_CARE XCP_WRITE_ACCESS_DONT_CARE /end PAGE
   /end SEGMENT
  /end IF_DATA
 /end MEMORY_SEGMENT
/end MOD_PAR
/begin MOD_COMMON "Mod Common Comment Here" BYTE_ORDER MSB_LAST ALIGNMENT_BYTE 1 ALIGNMENT_WORD 2 ALIGNMENT_LONG 4 ALIGNMENT_FLOAT32_IEEE 4 ALIGNMENT_FLOAT64_IEEE 8 ALIGNMENT_INT64 8 /end MOD_COMMON
/begin CHARACTERISTIC Arizona_base_GOAT_cal_impl.Analoginput1_P1 "" VALUE 0x0025BC68 Scalar_FLOAT64_IEEE 0 Arizona_base_GOAT_CM_double -1.7E+308 1.7E+308 /end CHARACTERISTIC
/begin CHARACTERISTIC Arizona_base_GOAT_cal_impl.Analoginput1_P10 "" VALUE 0x0025BDD0 Scalar_FLOAT64_IEEE 0 Arizona_base_GOAT_CM_double -1.7E+308 1.7E+308 /end CHARACTERISTIC
/begin CHARACTERISTIC Arizona_base_GOAT_cal_impl.Analoginput1_P11 "" VAL_BLK 0x0025BDE8 Scalar_FLOAT64_IEEE 0 Arizona_base_GOAT_CM_double -1.7E+308 1.7E+308 MATRIX_DIM 4 1 /end CHARACTERISTIC
/begin CHARACTERISTIC Arizona_base_GOAT_cal_impl.Analoginput1_P12 "" VALUE 0x0025BE18 Scalar_FLOAT64_IEEE 0 Arizona_base_GOAT_CM_double -1.7E+308 1.7E+308 /end CHARACTERISTIC
/begin CHARACTERISTIC Arizona_base_GOAT_cal_impl.Analoginput1_P2 "" VALUE 0x0025BC80 Scalar_FLOAT64_IEEE 0 Arizona_base_GOAT_CM_double -1.7E+308 1.7E+308 /end CHARACTERISTIC
/begin CHARACTERISTIC Arizona_base_GOAT_cal_impl.Analoginput1_P3 "" VALUE 0x0025BC98 Scalar_FLOAT64_IEEE 0 Arizona_base_GOAT_CM_double -1.7E+308 1.7E+308 /end CHARACTERISTIC
/begin CHARACTERISTIC Arizona_base_GOAT_cal_impl.Analoginput1_P4 "" VALUE 0x0025BCB0 Scalar_FLOAT64_IEEE 0 Arizona_base_GOAT_CM_double -1.7E+308 1.7E+308 /end CHARACTERISTIC
/begin CHARACTERISTIC Arizona_base_GOAT_cal_impl.Analoginput1_P5 "" VAL_BLK 0x0025BCC8 Scalar_FLOAT64_IEEE 0 Arizona_base_GOAT_CM_double -1.7E+308 1.7E+308 MATRIX_DIM 2 1 /end CHARACTERISTIC
/begin CHARACTERISTIC Arizona_base_GOAT_cal_impl.Analoginput1_P6 "" VAL_BLK 0x0025BCE8 Scalar_FLOAT64_IEEE 0 Arizona_base_GOAT_CM_double -1.7E+308 1.7E+308 MATRIX_DIM 2 1 /end CHARACTERISTIC
/begin CHARACTERISTIC Arizona_base_GOAT_cal_impl.Analoginput1_P7 "" VAL_BLK 0x0025BD08 Scalar_FLOAT64_IEEE 0 Arizona_base_GOAT_CM_double -1.7E+308 1.7E+308 MATRIX_DIM 16 1 /end CHARACTERISTIC
/begin CHARACTERISTIC Arizona_base_GOAT_cal_impl.Analoginput1_P8 "" VAL_BLK 0x0025BD98 Scalar_FLOAT64_IEEE 0 Arizona_base_GOAT_CM_double -1.7E+308 1.7E+308 MATRIX_DIM 2 1 /end CHARACTERISTIC
/begin CHARACTERISTIC Arizona_base_GOAT_cal_impl.Analoginput1_P9 "" VALUE 0x0025BDB8 Scalar_FLOAT64_IEEE 0 Arizona_base_GOAT_CM_double -1.7E+308 1.7E+308 /end CHARACTERISTIC
/begin CHARACTERISTIC Arizona_base_GOAT_cal_impl.Analogoutput2_P1 "" VALUE 0x0025CC88 Scalar_FLOAT64_IEEE 0 Arizona_base_GOAT_CM_double -1.7E+308 1.7E+308 /end CHARACTERISTIC
/begin CHARACTERISTIC Arizona_base_GOAT_cal_impl.Analogoutput2_P10 "" VALUE 0x0025CDC0 Scalar_FLOAT64_IEEE 0 Arizona_base_GOAT_CM_double -1.7E+308 1.7E+308 /end CHARACTERISTIC
/begin CHARACTERISTIC Arizona_base_GOAT_cal_impl.Analogoutput2_P11 "" VALUE 0x0025CDD8 Scalar_FLOAT64_IEEE 0 Arizona_base_GOAT_CM_double -1.7E+308 1.7E+308 /end CHARACTERISTIC
/begin CHARACTERISTIC Arizona_base_GOAT_cal_impl.Analogoutput2_P12 "" VAL_BLK 0x0025CDF0 Scalar_FLOAT64_IEEE 0 Arizona_base_GOAT_CM_double -1.7E+308 1.7E+308 MATRIX_DIM 4 1 /end CHARACTERISTIC
/begin CHARACTERISTIC Arizona_base_GOAT_cal_impl.Analogoutput2_P13 "" VALUE 0x0025CE20 Scalar_FLOAT64_IEEE 0 Arizona_base_GOAT_CM_double -1.7E+308 1.7E+308 /end CHARACTERISTIC
/begin CHARACTERISTIC Arizona_base_GOAT_cal_impl.Analogoutput2_P14 "" VALUE 0x0025CE38 Scalar_FLOAT64_IEEE 0 Arizona_base_GOAT_CM_double -1.7E+308 1.7E+308 /end CHARACTERISTIC
/begin CHARACTERISTIC Arizona_base_GOAT_cal_impl.Analogoutput2_P2 "" VALUE 0x0025CCA0 Scalar_FLOAT64_IEEE 0 Arizona_base_GOAT_CM_double -1.7E+308 1.7E+308 /end CHARACTERISTIC
/begin CHARACTERISTIC Arizona_base_GOAT_cal_impl.Analogoutput2_P3 "" VALUE 0x0025CCB8 Scalar_FLOAT64_IEEE 0 Arizona_base_GOAT_CM_double -1.7E+308 1.7E+308 /end CHARACTERISTIC
/begin CHARACTERISTIC Arizona_base_GOAT_cal_impl.Analogoutput2_P4 "" VALUE 0x0025CCD0 Scalar_FLOAT64_IEEE 0 Arizona_base_GOAT_CM_double -1.7E+308 1.7E+308 /end CHARACTERISTIC
/begin CHARACTERISTIC Arizona_base_GOAT_cal_impl.Analogoutput2_P5 "" VAL_BLK 0x0025CCE8 Scalar_FLOAT64_IEEE 0 Arizona_base_GOAT_CM_double -1.7E+308 1.7E+308 MATRIX_DIM 3 1 /end CHARACTERISTIC
/begin CHARACTERISTIC Arizona_base_GOAT_cal_impl.Analogoutput2_P6 "" VAL_BLK 0x0025CD10 Scalar_FLOAT64_IEEE 0 Arizona_base_GOAT_CM_double -1.7E+308 1.7E+308 MATRIX_DIM 4 1 /end CHARACTERISTIC
/begin CHARACTERISTIC Arizona_base_GOAT_cal_impl.Analogoutput2_P7 "" VAL_BLK 0x0025CD40 Scalar_FLOAT64_IEEE 0 Arizona_base_GOAT_CM_double -1.7E+308 1.7E+308 MATRIX_DIM 4 1 /end CHARACTERISTIC
/begin CHARACTERISTIC Arizona_base_GOAT_cal_impl.Analogoutput2_P8 "" VAL_BLK 0x0025CD70 Scalar_FLOAT64_IEEE 0 Arizona_base_GOAT_CM_double -1.7E+308 1.7E+308 MATRIX_DIM 3 1 /end CHARACTERISTIC
/begin CHARACTERISTIC Arizona_base_GOAT_cal_impl.Analogoutput2_P9 "" VAL_BLK 0x0025CD98 Scalar_FLOAT64_IEEE 0 Arizona_base_GOAT_CM_double -1.7E+308 1.7E+308 MATRIX_DIM 3 1 /end CHARACTERISTIC
/begin CHARACTERISTIC Arizona_base_GOAT_cal_impl.Calibration1_Gain "" VALUE 0x0025C4E8 Scalar_FLOAT64_IEEE 0 Arizona_base_GOAT_CM_double -1.7E+308 1.7E+308 /end CHARACTERISTIC
/begin CHARACTERISTIC Arizona_base_GOAT_cal_impl.Calibration2_Gain "" VALUE 0x0025C738 Scalar_FLOAT64_IEEE 0 Arizona_base_GOAT_CM_double -1.7E+308 1.7E+308 /end CHARACTERISTIC
/begin CHARACTERISTIC Arizona_base_GOAT_cal_impl.Calibration3_Gain "" VALUE 0x0025C988 Scalar_FLOAT64_IEEE 0 Arizona_base_GOAT_CM_double -1.7E+308 1.7E+308 /end CHARACTERISTIC
/begin CHARACTERISTIC Arizona_base_GOAT_cal_impl.Calibration4_Gain "" VALUE 0x0025D2D8 Scalar_FLOAT64_IEEE 0 Arizona_base_GOAT_CM_double -1.7E+308 1.7E+308 /end CHARACTERISTIC
/begin CHARACTERISTIC Arizona_base_GOAT_cal_impl.Calibration5_Gain "" VALUE 0x0025D528 Scalar_FLOAT64_IEEE 0 Arizona_base_GOAT_CM_double -1.7E+308 1.7E+308 /end CHARACTERISTIC
/begin CHARACTERISTIC Arizona_base_GOAT_cal_impl.Calibration6_Gain "" VALUE 0x0025D778 Scalar_FLOAT64_IEEE 0 Arizona_base_GOAT_CM_double -1.7E+308 1.7E+308 /end CHARACTERISTIC
/begin CHARACTERISTIC Arizona_base_GOAT_cal_impl.Cariagesecundair_P1 "" VALUE 0x0025D0A8 Scalar_FLOAT64_IEEE 0 Arizona_base_GOAT_CM_double -1.7E+308 1.7E+308 /end CHARACTERISTIC
/begin CHARACTERISTIC Arizona_base_GOAT_cal_impl.Cariagesecundair_P10 "" VALUE 0x0025D180 Scalar_FLOAT64_IEEE 0 Arizona_base_GOAT_CM_double -1.7E+308 1.7E+308 /end CHARACTERISTIC
/begin CHARACTERISTIC Arizona_base_GOAT_cal_impl.Cariagesecundair_P11 "" VALUE 0x0025D198 Scalar_FLOAT64_IEEE 0 Arizona_base_GOAT_CM_double -1.7E+308 1.7E+308 /end CHARACTERISTIC
/begin CHARACTERISTIC Arizona_base_GOAT_cal_impl.Cariagesecundair_P12 "" VALUE 0x0025D1B0 Scalar_FLOAT64_IEEE 0 Arizona_base_GOAT_CM_double -1.7E+308 1.7E+308 /end CHARACTERISTIC
/begin CHARACTERISTIC Arizona_base_GOAT_cal_impl.Cariagesecundair_P13 "" VALUE 0x0025D1C8 Scalar_FLOAT64_IEEE 0 Arizona_base_GOAT_CM_double -1.7E+308 1.7E+308 /end CHARACTERISTIC
/begin CHARACTERISTIC Arizona_base_GOAT_cal_impl.Cariagesecundair_P14 "" VALUE 0x0025D1E0 Scalar_FLOAT64_IEEE 0 Arizona_base_GOAT_CM_double -1.7E+308 1.7E+308 /end CHARACTERISTIC
/begin CHARACTERISTIC Arizona_base_GOAT_cal_impl.Cariagesecundair_P15 "" VALUE 0x0025D1F8 Scalar_FLOAT64_IEEE 0 Arizona_base_GOAT_CM_double -1.7E+308 1.7E+308 /end CHARACTERISTIC
/begin CHARACTERISTIC Arizona_base_GOAT_cal_impl.Cariagesecundair_P16 "" VALUE 0x0025D210 Scalar_FLOAT64_IEEE 0 Arizona_base_GOAT_CM_double -1.7E+308 1.7E+308 /end CHARACTERISTIC
/begin CHARACTERISTIC Arizona_base_GOAT_cal_impl.Cariagesecundair_P17 "" VALUE 0x0025D228 Scalar_FLOAT64_IEEE 0 Arizona_base_GOAT_CM_double -1.7E+308 1.7E+308 /end CHARACTERISTIC
/begin CHARACTERISTIC Arizona_base_GOAT_cal_impl.Cariagesecundair_P18 "" VALUE 0x0025D240 Scalar_FLOAT64_IEEE 0 Arizona_base_GOAT_CM_double -1.7E+308 1.7E+308 /end CHARACTERISTIC
/begin CHARACTERISTIC Arizona_base_GOAT_cal_impl.Cariagesecundair_P19 "" VALUE 0x0025D258 Scalar_FLOAT64_IEEE 0 Arizona_base_GOAT_CM_double -1.7E+308 1.7E+308 /end CHARACTERISTIC
/begin CHARACTERISTIC Arizona_base_GOAT_cal_impl.Cariagesecundair_P2 "" VALUE 0x0025D0C0 Scalar_FLOAT64_IEEE 0 Arizona_base_GOAT_CM_double -1.7E+308 1.7E+308 /end CHARACTERISTIC
/begin CHARACTERISTIC Arizona_base_GOAT_cal_impl.Cariagesecundair_P20 "" VALUE 0x0025D270 Scalar_FLOAT64_IEEE 0 Arizona_base_GOAT_CM_double -1.7E+308 1.7E+308 /end CHARACTERISTIC
/begin CHARACTERISTIC Arizona_base_GOAT_cal_impl.Cariagesecundair_P21 "" VALUE 0x0025D288 Scalar_FLOAT64_IEEE 0 Arizona_base_GOAT_CM_double -1.7E+308 1.7E+308 /end CHARACTERISTIC
/begin CHARACTERISTIC Arizona_base_GOAT_cal_impl.Cariagesecundair_P22 "" VALUE 0x0025D2A0 Scalar_FLOAT64_IEEE 0 Arizona_base_GOAT_CM_double -1.7E+308 1.7E+308 /end CHARACTERISTIC
/begin CHARACTERISTIC Arizona_base_GOAT_cal_impl.Cariagesecundair_P23 "" VALUE 0x0025D2B8 Scalar_FLOAT64_IEEE 0 Arizona_base_GOAT_CM_double -1.7E+308 1.7E+308 /end CHARACTERISTIC
/begin CHARACTERISTIC Arizona_base_GOAT_cal_impl.Cariagesecundair_P24 "" VALUE 0x0025D2D0 Scalar_FLOAT64_IEEE 0 Arizona_base_GOAT_CM_double -1.7E+308 1.7E+308 /end CHARACTERISTIC
/begin CHARACTERISTIC Arizona_base_GOAT_cal_impl.Cariagesecundair_P3 "" VALUE 0x0025D0D8 Scalar_FLOAT64_IEEE 0 Arizona_base_GOAT_CM_double -1.7E+308 1.7E+308 /end CHARACTERISTIC
/begin CHARACTERISTIC Arizona_base_GOAT_cal_impl.Cariagesecundair_P4 "" VALUE 0x0025D0F0 Scalar_FLOAT64_IEEE 0 Arizona_base_GOAT_CM_double -1.7E+308 1.7E+308 /end CHARACTERISTIC
/begin CHARACTERISTIC Arizona_base_GOAT_cal_impl.Cariagesecundair_P5 "" VALUE 0x0025D108 Scalar_FLOAT64_IEEE 0 Arizona_base_GOAT_CM_double -1.7E+308 1.7E+308 /end CHARACTERISTIC
/begin CHARACTERISTIC Arizona_base_GOAT_cal_impl.Cariagesecundair_P6 "" VALUE 0x0025D120 Scalar_FLOAT64_IEEE 0 Arizona_base_GOAT_CM_double -1.7E+308 1.7E+308 /end CHARACTERISTIC
/begin CHARACTERISTIC Arizona_base_GOAT_cal_impl.Cariagesecundair_P7 "" VALUE 0x0025D138 Scalar_FLOAT64_IEEE 0 Arizona_base_GOAT_CM_double -1.7E+308 1.7E+308 /end CHARACTERISTIC
/begin CHARACTERISTIC Arizona_base_GOAT_cal_impl.Cariagesecundair_P8 "" VALUE 0x0025D150 Scalar_FLOAT64_IEEE 0 Arizona_base_GOAT_CM_double -1.7E+308 1.7E+308 /end CHARACTERISTIC
/begin CHARACTERISTIC Arizona_base_GOAT_cal_impl.Cariagesecundair_P9 "" VALUE 0x0025D168 Scalar_FLOAT64_IEEE 0 Arizona_base_GOAT_CM_double -1.7E+308 1.7E+308 /end CHARACTERISTIC
/begin CHARACTERISTIC Arizona_base_GOAT_cal_impl.Carriageencoder_P1 "" VALUE 0x0025C2B8 Scalar_FLOAT64_IEEE 0 Arizona_base_GOAT_CM_double -1.7E+308 1.7E+308 /end CHARACTERISTIC
/begin CHARACTERISTIC Arizona_base_GOAT_cal_impl.Carriageencoder_P10 "" VALUE 0x0025C390 Scalar_FLOAT64_IEEE 0 Arizona_base_GOAT_CM_double -1.7E+308 1.7E+308 /end CHARACTERISTIC
/begin CHARACTERISTIC Arizona_base_GOAT_cal_impl.Carriageencoder_P11 "" VALUE 0x0025C3A8 Scalar_FLOAT64_IEEE 0 Arizona_base_GOAT_CM_double -1.7E+308 1.7E+308 /end CHARACTERISTIC
/begin CHARACTERISTIC Arizona_base_GOAT_cal_impl.Carriageencoder_P12 "" VALUE 0x0025C3C0 Scalar_FLOAT64_IEEE 0 Arizona_base_GOAT_CM_double -1.7E+308 1.7E+308 /end CHARACTERISTIC
/begin CHARACTERISTIC Arizona_base_GOAT_cal_impl.Carriageencoder_P13 "" VALUE 0x0025C3D8 Scalar_FLOAT64_IEEE 0 Arizona_base_GOAT_CM_double -1.7E+308 1.7E+308 /end CHARACTERISTIC
/begin CHARACTERISTIC Arizona_base_GOAT_cal_impl.Carriageencoder_P14 "" VALUE 0x0025C3F0 Scalar_FLOAT64_IEEE 0 Arizona_base_GOAT_CM_double -1.7E+308 1.7E+308 /end CHARACTERISTIC
/begin CHARACTERISTIC Arizona_base_GOAT_cal_impl.Carriageencoder_P15 "" VALUE 0x0025C408 Scalar_FLOAT64_IEEE 0 Arizona_base_GOAT_CM_double -1.7E+308 1.7E+308 /end CHARACTERISTIC
/begin CHARACTERISTIC Arizona_base_GOAT_cal_impl.Carriageencoder_P16 "" VALUE 0x0025C420 Scalar_FLOAT64_IEEE 0 Arizona_base_GOAT_CM_double -1.7E+308 1.7E+308 /end CHARACTERISTIC
/begin CHARACTERISTIC Arizona_base_GOAT_cal_impl.Carriageencoder_P17 "" VALUE 0x0025C438 Scalar_FLOAT64_IEEE 0 Arizona_base_GOAT_CM_double -1.7E+308 1.7E+308 /end CHARACTERISTIC
/begin CHARACTERISTIC Arizona_base_GOAT_cal_impl.Carriageencoder_P18 "" VALUE 0x0025C450 Scalar_FLOAT64_IEEE 0 Arizona_base_GOAT_CM_double -1.7E+308 1.7E+308 /end CHARACTERISTIC
/begin CHARACTERISTIC Arizona_base_GOAT_cal_impl.Carriageencoder_P19 "" VALUE 0x0025C468 Scalar_FLOAT64_IEEE 0 Arizona_base_GOAT_CM_double -1.7E+308 1.7E+308 /end CHARACTERISTIC
/begin CHARACTERISTIC Arizona_base_GOAT_cal_impl.Carriageencoder_P2 "" VALUE 0x0025C2D0 Scalar_FLOAT64_IEEE 0 Arizona_base_GOAT_CM_double -1.7E+308 1.7E+308 /end CHARACTERISTIC
/begin CHARACTERISTIC Arizona_base_GOAT_cal_impl.Carriageencoder_P20 "" VALUE 0x0025C480 Scalar_FLOAT64_IEEE 0 Arizona_base_GOAT_CM_double -1.7E+308 1.7E+308 /end CHARACTERISTIC
/begin CHARACTERISTIC Arizona_base_GOAT_cal_impl.Carriageencoder_P21 "" VALUE 0x0025C498 Scalar_FLOAT64_IEEE 0 Arizona_base_GOAT_CM_double -1.7E+308 1.7E+308 /end CHARACTERISTIC
/begin CHARACTERISTIC Arizona_base_GOAT_cal_impl.Carriageencoder_P22 "" VALUE 0x0025C4B0 Scalar_FLOAT64_IEEE 0 Arizona_base_GOAT_CM_double -1.7E+308 1.7E+308 /end CHARACTERISTIC
/begin CHARACTERISTIC Arizona_base_GOAT_cal_impl.Carriageencoder_P23 "" VALUE 0x0025C4C8 Scalar_FLOAT64_IEEE 0 Arizona_base_GOAT_CM_double -1.7E+308 1.7E+308 /end CHARACTERISTIC
/begin CHARACTERISTIC Arizona_base_GOAT_cal_impl.Carriageencoder_P24 "" VALUE 0x0025C4E0 Scalar_FLOAT64_IEEE 0 Arizona_base_GOAT_CM_double -1.7E+308 1.7E+308 /end CHARACTERISTIC
/begin CHARACTERISTIC Arizona_base_GOAT_cal_impl.Carriageencoder_P3 "" VALUE 0x0025C2E8 Scalar_FLOAT64_IEEE 0 Arizona_base_GOAT_CM_double -1.7E+308 1.7E+308 /end CHARACTERISTIC
/begin CHARACTERISTIC Arizona_base_GOAT_cal_impl.Carriageencoder_P4 "" VALUE 0x0025C300 Scalar_FLOAT64_IEEE 0 Arizona_base_GOAT_CM_double -1.7E+308 1.7E+308 /end CHARACTERISTIC
/begin CHARACTERISTIC Arizona_base_GOAT_cal_impl.Carriageencoder_P5 "" VALUE 0x0025C318 Scalar_FLOAT64_IEEE 0 Arizona_base_GOAT_CM_double -1.7E+308 1.7E+308 /end CHARACTERISTIC
/begin CHARACTERISTIC Arizona_base_GOAT_cal_impl.Carriageencoder_P6 "" VALUE 0x0025C330 Scalar_FLOAT64_IEEE 0 Arizona_base_GOAT_CM_double -1.7E+308 1.7E+308 /end CHARACTERISTIC
/begin CHARACTERISTIC Arizona_base_GOAT_cal_impl.Carriageencoder_P7 "" VALUE 0x0025C348 Scalar_FLOAT64_IEEE 0 Arizona_base_GOAT_CM_double -1.7E+308 1.7E+308 /end CHARACTERISTIC
/begin CHARACTERISTIC Arizona_base_GOAT_cal_impl.Carriageencoder_P8 "" VALUE 0x0025C360 Scalar_FLOAT64_IEEE 0 Arizona_base_GOAT_CM_double -1.7E+308 1.7E+308 /end CHARACTERISTIC
/begin CHARACTERISTIC Arizona_base_GOAT_cal_impl.Carriageencoder_P9 "" VALUE 0x0025C378 Scalar_FLOAT64_IEEE 0 Arizona_base_GOAT_CM_double -1.7E+308 1.7E+308 /end CHARACTERISTIC
/begin CHARACTERISTIC Arizona_base_GOAT_cal_impl.CompareToConstant_const "" VALUE 0x00222070 Scalar_FLOAT64_IEEE 0 Arizona_base_GOAT_CM_double -1.7E+308 1.7E+308 /end CHARACTERISTIC
/begin CHARACTERISTIC Arizona_base_GOAT_cal_impl.CompareToConstant_const_n "" VALUE 0x00222078 Scalar_FLOAT64_IEEE 0 Arizona_base_GOAT_CM_double -1.7E+308 1.7E+308 /end CHARACTERISTIC
/begin CHARACTERISTIC Arizona_base_GOAT_cal_impl.Constant1_Value "" VALUE 0x0023A9C8 Scalar_FLOAT64_IEEE 0 Arizona_base_GOAT_CM_double -1.7E+308 1.7E+308 /end CHARACTERISTIC
/begin CHARACTERISTIC Arizona_base_GOAT_cal_impl.Constant_Value "" VALUE 0x0023A9D0 Scalar_FLOAT64_IEEE 0 Arizona_base_GOAT_CM_double -1.7E+308 1.7E+308 /end CHARACTERISTIC
/begin CHARACTERISTIC Arizona_base_GOAT_cal_impl.Constant_Value_a "" VALUE 0x0025B7A8 Scalar_FLOAT64_IEEE 0 Arizona_base_GOAT_CM_double -1.7E+308 1.7E+308 /end CHARACTERISTIC
/begin CHARACTERISTIC Arizona_base_GOAT_cal_impl.Constant_Value_e "" VALUE 0x0023AB60 Scalar_FLOAT64_IEEE 0 Arizona_base_GOAT_CM_double -1.7E+308 1.7E+308 /end CHARACTERISTIC
/begin CHARACTERISTIC Arizona_base_GOAT_cal_impl.Constant_Value_l "" VALUE 0x0025B7B0 Scalar_FLOAT64_IEEE 0 Arizona_base_GOAT_CM_double -1.7E+308 1.7E+308 /end CHARACTERISTIC
/begin CHARACTERISTIC Arizona_base_GOAT_cal_impl.DILimitCarriage_P1 "" VALUE 0x0025BE30 Scalar_FLOAT64_IEEE 0 Arizona_base_GOAT_CM_double -1.7E+308 1.7E+308 /end CHARACTERISTIC
/begin CHARACTERISTIC Arizona_base_GOAT_cal_impl.DILimitCarriage_P2 "" VALUE 0x0025BE48 Scalar_FLOAT64_IEEE 0 Arizona_base_GOAT_CM_double -1.7E+308 1.7E+308 /end CHARACTERISTIC
/begin CHARACTERISTIC Arizona_base_GOAT_cal_impl.DILimitCarriage_P3 "" VALUE 0x0025BE60 Scalar_FLOAT64_IEEE 0 Arizona_base_GOAT_CM_double -1.7E+308 1.7E+308 /end CHARACTERISTIC
/begin CHARACTERISTIC Arizona_base_GOAT_cal_impl.DILimitCarriage_P4 "" VALUE 0x0025BE78 Scalar_FLOAT64_IEEE 0 Arizona_base_GOAT_CM_double -1.7E+308 1.7E+308 /end CHARACTERISTIC
/begin CHARACTERISTIC Arizona_base_GOAT_cal_impl.DILimitCarriage_P5 "" VALUE 0x0025BE90 Scalar_FLOAT64_IEEE 0 Arizona_base_GOAT_CM_double -1.7E+308 1.7E+308 /end CHARACTERISTIC
/begin CHARACTERISTIC Arizona_base_GOAT_cal_impl.DILimitCarriage_P6 "" VALUE 0x0025BEA8 Scalar_FLOAT64_IEEE 0 Arizona_base_GOAT_CM_double -1.7E+308 1.7E+308 /end CHARACTERISTIC
/begin CHARACTERISTIC Arizona_base_GOAT_cal_impl.DILimitCarriagesecundairwerk_ix "" VALUE 0x0025D7C8 Scalar_FLOAT64_IEEE 0 Arizona_base_GOAT_CM_double -1.7E+308 1.7E+308 /end CHARACTERISTIC
/begin CHARACTERISTIC Arizona_base_GOAT_cal_impl.DILimitCarriagesecundairwerk_nn "" VALUE 0x0025D7E0 Scalar_FLOAT64_IEEE 0 Arizona_base_GOAT_CM_double -1.7E+308 1.7E+308 /end CHARACTERISTIC
/begin CHARACTERISTIC Arizona_base_GOAT_cal_impl.DILimitCarriagesecundairwerkt_a "" VALUE 0x0025D798 Scalar_FLOAT64_IEEE 0 Arizona_base_GOAT_CM_double -1.7E+308 1.7E+308 /end CHARACTERISTIC
/begin CHARACTERISTIC Arizona_base_GOAT_cal_impl.DILimitCarriagesecundairwerkt_g "" VALUE 0x0025D7F8 Scalar_FLOAT64_IEEE 0 Arizona_base_GOAT_CM_double -1.7E+308 1.7E+308 /end CHARACTERISTIC
/begin CHARACTERISTIC Arizona_base_GOAT_cal_impl.DILimitCarriagesecundairwerkt_l "" VALUE 0x0025D810 Scalar_FLOAT64_IEEE 0 Arizona_base_GOAT_CM_double -1.7E+308 1.7E+308 /end CHARACTERISTIC
/begin CHARACTERISTIC Arizona_base_GOAT_cal_impl.DILimitCarriagesecundairwerkt_n "" VALUE 0x0025D7B0 Scalar_FLOAT64_IEEE 0 Arizona_base_GOAT_CM_double -1.7E+308 1.7E+308 /end CHARACTERISTIC
/begin CHARACTERISTIC Arizona_base_GOAT_cal_impl.DILimitGantryx1GantryxR_P1 "" VALUE 0x0025BEC0 Scalar_FLOAT64_IEEE 0 Arizona_base_GOAT_CM_double -1.7E+308 1.7E+308 /end CHARACTERISTIC
/begin CHARACTERISTIC Arizona_base_GOAT_cal_impl.DILimitGantryx1GantryxR_P2 "" VALUE 0x0025BED8 Scalar_FLOAT64_IEEE 0 Arizona_base_GOAT_CM_double -1.7E+308 1.7E+308 /end CHARACTERISTIC
/begin CHARACTERISTIC Arizona_base_GOAT_cal_impl.DILimitGantryx1GantryxR_P3 "" VALUE 0x0025BEF0 Scalar_FLOAT64_IEEE 0 Arizona_base_GOAT_CM_double -1.7E+308 1.7E+308 /end CHARACTERISTIC
/begin CHARACTERISTIC Arizona_base_GOAT_cal_impl.DILimitGantryx1GantryxR_P4 "" VALUE 0x0025BF08 Scalar_FLOAT64_IEEE 0 Arizona_base_GOAT_CM_double -1.7E+308 1.7E+308 /end CHARACTERISTIC
/begin CHARACTERISTIC Arizona_base_GOAT_cal_impl.DILimitGantryx1GantryxR_P5 "" VALUE 0x0025BF20 Scalar_FLOAT64_IEEE 0 Arizona_base_GOAT_CM_double -1.7E+308 1.7E+308 /end CHARACTERISTIC
/begin CHARACTERISTIC Arizona_base_GOAT_cal_impl.DILimitGantryx1GantryxR_P6 "" VALUE 0x0025BF38 Scalar_FLOAT64_IEEE 0 Arizona_base_GOAT_CM_double -1.7E+308 1.7E+308 /end CHARACTERISTIC
/begin CHARACTERISTIC Arizona_base_GOAT_cal_impl.DILimitGantryx1secundairGant_du "" VALUE 0x0025D888 Scalar_FLOAT64_IEEE 0 Arizona_base_GOAT_CM_double -1.7E+308 1.7E+308 /end CHARACTERISTIC
/begin CHARACTERISTIC Arizona_base_GOAT_cal_impl.DILimitGantryx1secundairGant_ir "" VALUE 0x0025D8A0 Scalar_FLOAT64_IEEE 0 Arizona_base_GOAT_CM_double -1.7E+308 1.7E+308 /end CHARACTERISTIC
/begin CHARACTERISTIC Arizona_base_GOAT_cal_impl.DILimitGantryx1secundairGant_ns "" VALUE 0x0025D870 Scalar_FLOAT64_IEEE 0 Arizona_base_GOAT_CM_double -1.7E+308 1.7E+308 /end CHARACTERISTIC
/begin CHARACTERISTIC Arizona_base_GOAT_cal_impl.DILimitGantryx1secundairGantr_b "" VALUE 0x0025D858 Scalar_FLOAT64_IEEE 0 Arizona_base_GOAT_CM_double -1.7E+308 1.7E+308 /end CHARACTERISTIC
/begin CHARACTERISTIC Arizona_base_GOAT_cal_impl.DILimitGantryx1secundairGantr_d "" VALUE 0x0025D828 Scalar_FLOAT64_IEEE 0 Arizona_base_GOAT_CM_double -1.7E+308 1.7E+308 /end CHARACTERISTIC
/begin CHARACTERISTIC Arizona_base_GOAT_cal_impl.DILimitGantryx1secundairGantr_n "" VALUE 0x0025D840 Scalar_FLOAT64_IEEE 0 Arizona_base_GOAT_CM_double -1.7E+308 1.7E+308 /end CHARACTERISTIC
/begin CHARACTERISTIC Arizona_base_GOAT_cal_impl.DILimitGantryx2GantryxL_P1 "" VALUE 0x0025BF50 Scalar_FLOAT64_IEEE 0 Arizona_base_GOAT_CM_double -1.7E+308 1.7E+308 /end CHARACTERISTIC
/begin CHARACTERISTIC Arizona_base_GOAT_cal_impl.DILimitGantryx2GantryxL_P2 "" VALUE 0x0025BF68 Scalar_FLOAT64_IEEE 0 Arizona_base_GOAT_CM_double -1.7E+308 1.7E+308 /end CHARACTERISTIC
/begin CHARACTERISTIC Arizona_base_GOAT_cal_impl.DILimitGantryx2GantryxL_P3 "" VALUE 0x0025BF80 Scalar_FLOAT64_IEEE 0 Arizona_base_GOAT_CM_double -1.7E+308 1.7E+308 /end CHARACTERISTIC
/begin CHARACTERISTIC Arizona_base_GOAT_cal_impl.DILimitGantryx2GantryxL_P4 "" VALUE 0x0025BF98 Scalar_FLOAT64_IEEE 0 Arizona_base_GOAT_CM_double -1.7E+308 1.7E+308 /end CHARACTERISTIC
/begin CHARACTERISTIC Arizona_base_GOAT_cal_impl.DILimitGantryx2GantryxL_P5 "" VALUE 0x0025BFB0 Scalar_FLOAT64_IEEE 0 Arizona_base_GOAT_CM_double -1.7E+308 1.7E+308 /end CHARACTERISTIC
/begin CHARACTERISTIC Arizona_base_GOAT_cal_impl.DILimitGantryx2GantryxL_P6 "" VALUE 0x0025BFC8 Scalar_FLOAT64_IEEE 0 Arizona_base_GOAT_CM_double -1.7E+308 1.7E+308 /end CHARACTERISTIC
/begin CHARACTERISTIC Arizona_base_GOAT_cal_impl.DILimitGantryx2secundairGant_dj "" VALUE 0x0025D930 Scalar_FLOAT64_IEEE 0 Arizona_base_GOAT_CM_double -1.7E+308 1.7E+308 /end CHARACTERISTIC
/begin CHARACTERISTIC Arizona_base_GOAT_cal_impl.DILimitGantryx2secundairGantr_a "" VALUE 0x0025D900 Scalar_FLOAT64_IEEE 0 Arizona_base_GOAT_CM_double -1.7E+308 1.7E+308 /end CHARACTERISTIC
/begin CHARACTERISTIC Arizona_base_GOAT_cal_impl.DILimitGantryx2secundairGantr_d "" VALUE 0x0025D8B8 Scalar_FLOAT64_IEEE 0 Arizona_base_GOAT_CM_double -1.7E+308 1.7E+308 /end CHARACTERISTIC
/begin CHARACTERISTIC Arizona_base_GOAT_cal_impl.DILimitGantryx2secundairGantr_f "" VALUE 0x0025D8D0 Scalar_FLOAT64_IEEE 0 Arizona_base_GOAT_CM_double -1.7E+308 1.7E+308 /end CHARACTERISTIC
/begin CHARACTERISTIC Arizona_base_GOAT_cal_impl.DILimitGantryx2secundairGantr_l "" VALUE 0x0025D918 Scalar_FLOAT64_IEEE 0 Arizona_base_GOAT_CM_double -1.7E+308 1.7E+308 /end CHARACTERISTIC
/begin CHARACTERISTIC Arizona_base_GOAT_cal_impl.DILimitGantryx2secundairGantr_o "" VALUE 0x0025D8E8 Scalar_FLOAT64_IEEE 0 Arizona_base_GOAT_CM_double -1.7E+308 1.7E+308 /end CHARACTERISTIC
/begin CHARACTERISTIC Arizona_base_GOAT_cal_impl.DIblacksoftwarebutton_P1 "" VALUE 0x0025BFE0 Scalar_FLOAT64_IEEE 0 Arizona_base_GOAT_CM_double -1.7E+308 1.7E+308 /end CHARACTERISTIC
/begin CHARACTERISTIC Arizona_base_GOAT_cal_impl.DIblacksoftwarebutton_P2 "" VALUE 0x0025BFF8 Scalar_FLOAT64_IEEE 0 Arizona_base_GOAT_CM_double -1.7E+308 1.7E+308 /end CHARACTERISTIC
/begin CHARACTERISTIC Arizona_base_GOAT_cal_impl.DIblacksoftwarebutton_P3 "" VALUE 0x0025C010 Scalar_FLOAT64_IEEE 0 Arizona_base_GOAT_CM_double -1.7E+308 1.7E+308 /end CHARACTERISTIC
/begin CHARACTERISTIC Arizona_base_GOAT_cal_impl.DIblacksoftwarebutton_P4 "" VALUE 0x0025C028 Scalar_FLOAT64_IEEE 0 Arizona_base_GOAT_CM_double -1.7E+308 1.7E+308 /end CHARACTERISTIC
/begin CHARACTERISTIC Arizona_base_GOAT_cal_impl.DIblacksoftwarebutton_P5 "" VALUE 0x0025C040 Scalar_FLOAT64_IEEE 0 Arizona_base_GOAT_CM_double -1.7E+308 1.7E+308 /end CHARACTERISTIC
/begin CHARACTERISTIC Arizona_base_GOAT_cal_impl.DIblacksoftwarebutton_P6 "" VALUE 0x0025C058 Scalar_FLOAT64_IEEE 0 Arizona_base_GOAT_CM_double -1.7E+308 1.7E+308 /end CHARACTERISTIC
/begin CHARACTERISTIC Arizona_base_GOAT_cal_impl.DIcarriageampfaultstatus_P1 "" VALUE 0x0025C070 Scalar_FLOAT64_IEEE 0 Arizona_base_GOAT_CM_double -1.7E+308 1.7E+308 /end CHARACTERISTIC
/begin CHARACTERISTIC Arizona_base_GOAT_cal_impl.DIcarriageampfaultstatus_P2 "" VALUE 0x0025C088 Scalar_FLOAT64_IEEE 0 Arizona_base_GOAT_CM_double -1.7E+308 1.7E+308 /end CHARACTERISTIC
/begin CHARACTERISTIC Arizona_base_GOAT_cal_impl.DIcarriageampfaultstatus_P3 "" VALUE 0x0025C0A0 Scalar_FLOAT64_IEEE 0 Arizona_base_GOAT_CM_double -1.7E+308 1.7E+308 /end CHARACTERISTIC
/begin CHARACTERISTIC Arizona_base_GOAT_cal_impl.DIcarriageampfaultstatus_P4 "" VALUE 0x0025C0B8 Scalar_FLOAT64_IEEE 0 Arizona_base_GOAT_CM_double -1.7E+308 1.7E+308 /end CHARACTERISTIC
/begin CHARACTERISTIC Arizona_base_GOAT_cal_impl.DIcarriageampfaultstatus_P5 "" VALUE 0x0025C0D0 Scalar_FLOAT64_IEEE 0 Arizona_base_GOAT_CM_double -1.7E+308 1.7E+308 /end CHARACTERISTIC
/begin CHARACTERISTIC Arizona_base_GOAT_cal_impl.DIcarriageampfaultstatus_P6 "" VALUE 0x0025C0E8 Scalar_FLOAT64_IEEE 0 Arizona_base_GOAT_CM_double -1.7E+308 1.7E+308 /end CHARACTERISTIC
/begin CHARACTERISTIC Arizona_base_GOAT_cal_impl.DIgantryx1faultstatus_P1 "" VALUE 0x0025C100 Scalar_FLOAT64_IEEE 0 Arizona_base_GOAT_CM_double -1.7E+308 1.7E+308 /end CHARACTERISTIC
/begin CHARACTERISTIC Arizona_base_GOAT_cal_impl.DIgantryx1faultstatus_P2 "" VALUE 0x0025C118 Scalar_FLOAT64_IEEE 0 Arizona_base_GOAT_CM_double -1.7E+308 1.7E+308 /end CHARACTERISTIC
/begin CHARACTERISTIC Arizona_base_GOAT_cal_impl.DIgantryx1faultstatus_P3 "" VALUE 0x0025C130 Scalar_FLOAT64_IEEE 0 Arizona_base_GOAT_CM_double -1.7E+308 1.7E+308 /end CHARACTERISTIC
/begin CHARACTERISTIC Arizona_base_GOAT_cal_impl.DIgantryx1faultstatus_P4 "" VALUE 0x0025C148 Scalar_FLOAT64_IEEE 0 Arizona_base_GOAT_CM_double -1.7E+308 1.7E+308 /end CHARACTERISTIC
/begin CHARACTERISTIC Arizona_base_GOAT_cal_impl.DIgantryx1faultstatus_P5 "" VALUE 0x0025C160 Scalar_FLOAT64_IEEE 0 Arizona_base_GOAT_CM_double -1.7E+308 1.7E+308 /end CHARACTERISTIC
/begin CHARACTERISTIC Arizona_base_GOAT_cal_impl.DIgantryx1faultstatus_P6 "" VALUE 0x0025C178 Scalar_FLOAT64_IEEE 0 Arizona_base_GOAT_CM_double -1.7E+308 1.7E+308 /end CHARACTERISTIC
/begin CHARACTERISTIC Arizona_base_GOAT_cal_impl.DIgantryx2faultstatus_P1 "" VALUE 0x0025C190 Scalar_FLOAT64_IEEE 0 Arizona_base_GOAT_CM_double -1.7E+308 1.7E+308 /end CHARACTERISTIC
/begin CHARACTERISTIC Arizona_base_GOAT_cal_impl.DIgantryx2faultstatus_P2 "" VALUE 0x0025C1A8 Scalar_FLOAT64_IEEE 0 Arizona_base_GOAT_CM_double -1.7E+308 1.7E+308 /end CHARACTERISTIC
/begin CHARACTERISTIC Arizona_base_GOAT_cal_impl.DIgantryx2faultstatus_P3 "" VALUE 0x0025C1C0 Scalar_FLOAT64_IEEE 0 Arizona_base_GOAT_CM_double -1.7E+308 1.7E+308 /end CHARACTERISTIC
/begin CHARACTERISTIC Arizona_base_GOAT_cal_impl.DIgantryx2faultstatus_P4 "" VALUE 0x0025C1D8 Scalar_FLOAT64_IEEE 0 Arizona_base_GOAT_CM_double -1.7E+308 1.7E+308 /end CHARACTERISTIC
/begin CHARACTERISTIC Arizona_base_GOAT_cal_impl.DIgantryx2faultstatus_P5 "" VALUE 0x0025C1F0 Scalar_FLOAT64_IEEE 0 Arizona_base_GOAT_CM_double -1.7E+308 1.7E+308 /end CHARACTERISTIC
/begin CHARACTERISTIC Arizona_base_GOAT_cal_impl.DIgantryx2faultstatus_P6 "" VALUE 0x0025C208 Scalar_FLOAT64_IEEE 0 Arizona_base_GOAT_CM_double -1.7E+308 1.7E+308 /end CHARACTERISTIC
/begin CHARACTERISTIC Arizona_base_GOAT_cal_impl.DIredsoftwarebutton_P1 "" VALUE 0x0025C220 Scalar_FLOAT64_IEEE 0 Arizona_base_GOAT_CM_double -1.7E+308 1.7E+308 /end CHARACTERISTIC
/begin CHARACTERISTIC Arizona_base_GOAT_cal_impl.DIredsoftwarebutton_P2 "" VALUE 0x0025C238 Scalar_FLOAT64_IEEE 0 Arizona_base_GOAT_CM_double -1.7E+308 1.7E+308 /end CHARACTERISTIC
/begin CHARACTERISTIC Arizona_base_GOAT_cal_impl.DIredsoftwarebutton_P3 "" VALUE 0x0025C250 Scalar_FLOAT64_IEEE 0 Arizona_base_GOAT_CM_double -1.7E+308 1.7E+308 /end CHARACTERISTIC
/begin CHARACTERISTIC Arizona_base_GOAT_cal_impl.DIredsoftwarebutton_P4 "" VALUE 0x0025C268 Scalar_FLOAT64_IEEE 0 Arizona_base_GOAT_CM_double -1.7E+308 1.7E+308 /end CHARACTERISTIC
/begin CHARACTERISTIC Arizona_base_GOAT_cal_impl.DIredsoftwarebutton_P5 "" VALUE 0x0025C280 Scalar_FLOAT64_IEEE 0 Arizona_base_GOAT_CM_double -1.7E+308 1.7E+308 /end CHARACTERISTIC
/begin CHARACTERISTIC Arizona_base_GOAT_cal_impl.DIredsoftwarebutton_P6 "" VALUE 0x0025C298 Scalar_FLOAT64_IEEE 0 Arizona_base_GOAT_CM_double -1.7E+308 1.7E+308 /end CHARACTERISTIC
/begin CHARACTERISTIC Arizona_base_GOAT_cal_impl.DOInhibitCarriage_P1 "" VALUE 0x0025CE58 Scalar_FLOAT64_IEEE 0 Arizona_base_GOAT_CM_double -1.7E+308 1.7E+308 /end CHARACTERISTIC
/begin CHARACTERISTIC Arizona_base_GOAT_cal_impl.DOInhibitCarriage_P2 "" VALUE 0x0025CE70 Scalar_FLOAT64_IEEE 0 Arizona_base_GOAT_CM_double -1.7E+308 1.7E+308 /end CHARACTERISTIC
/begin CHARACTERISTIC Arizona_base_GOAT_cal_impl.DOInhibitCarriage_P3 "" VALUE 0x0025CE88 Scalar_FLOAT64_IEEE 0 Arizona_base_GOAT_CM_double -1.7E+308 1.7E+308 /end CHARACTERISTIC
/begin CHARACTERISTIC Arizona_base_GOAT_cal_impl.DOInhibitCarriage_P4 "" VALUE 0x0025CEA0 Scalar_FLOAT64_IEEE 0 Arizona_base_GOAT_CM_double -1.7E+308 1.7E+308 /end CHARACTERISTIC
/begin CHARACTERISTIC Arizona_base_GOAT_cal_impl.DOInhibitCarriage_P5 "" VALUE 0x0025CEB8 Scalar_FLOAT64_IEEE 0 Arizona_base_GOAT_CM_double -1.7E+308 1.7E+308 /end CHARACTERISTIC
/begin CHARACTERISTIC Arizona_base_GOAT_cal_impl.DOInhibitCarriage_P6 "" VALUE 0x0025CED0 Scalar_FLOAT64_IEEE 0 Arizona_base_GOAT_CM_double -1.7E+308 1.7E+308 /end CHARACTERISTIC
/begin CHARACTERISTIC Arizona_base_GOAT_cal_impl.DOInhibitCarriage_P7 "" VALUE 0x0025CEE8 Scalar_FLOAT64_IEEE 0 Arizona_base_GOAT_CM_double -1.7E+308 1.7E+308 /end CHARACTERISTIC
/begin CHARACTERISTIC Arizona_base_GOAT_cal_impl.DOInhibitCarriage_P8 "" VALUE 0x0025CF00 Scalar_FLOAT64_IEEE 0 Arizona_base_GOAT_CM_double -1.7E+308 1.7E+308 /end CHARACTERISTIC
/begin CHARACTERISTIC Arizona_base_GOAT_cal_impl.DOInhibitGantryx1GantryxR_P1 "" VALUE 0x0025CF20 Scalar_FLOAT64_IEEE 0 Arizona_base_GOAT_CM_double -1.7E+308 1.7E+308 /end CHARACTERISTIC
/begin CHARACTERISTIC Arizona_base_GOAT_cal_impl.DOInhibitGantryx1GantryxR_P2 "" VALUE 0x0025CF38 Scalar_FLOAT64_IEEE 0 Arizona_base_GOAT_CM_double -1.7E+308 1.7E+308 /end CHARACTERISTIC
/begin CHARACTERISTIC Arizona_base_GOAT_cal_impl.DOInhibitGantryx1GantryxR_P3 "" VALUE 0x0025CF50 Scalar_FLOAT64_IEEE 0 Arizona_base_GOAT_CM_double -1.7E+308 1.7E+308 /end CHARACTERISTIC
/begin CHARACTERISTIC Arizona_base_GOAT_cal_impl.DOInhibitGantryx1GantryxR_P4 "" VALUE 0x0025CF68 Scalar_FLOAT64_IEEE 0 Arizona_base_GOAT_CM_double -1.7E+308 1.7E+308 /end CHARACTERISTIC
/begin CHARACTERISTIC Arizona_base_GOAT_cal_impl.DOInhibitGantryx1GantryxR_P5 "" VALUE 0x0025CF80 Scalar_FLOAT64_IEEE 0 Arizona_base_GOAT_CM_double -1.7E+308 1.7E+308 /end CHARACTERISTIC
/begin CHARACTERISTIC Arizona_base_GOAT_cal_impl.DOInhibitGantryx1GantryxR_P6 "" VALUE 0x0025CF98 Scalar_FLOAT64_IEEE 0 Arizona_base_GOAT_CM_double -1.7E+308 1.7E+308 /end CHARACTERISTIC
/begin CHARACTERISTIC Arizona_base_GOAT_cal_impl.DOInhibitGantryx1GantryxR_P7 "" VALUE 0x0025CFB0 Scalar_FLOAT64_IEEE 0 Arizona_base_GOAT_CM_double -1.7E+308 1.7E+308 /end CHARACTERISTIC
/begin CHARACTERISTIC Arizona_base_GOAT_cal_impl.DOInhibitGantryx1GantryxR_P8 "" VALUE 0x0025CFC8 Scalar_FLOAT64_IEEE 0 Arizona_base_GOAT_CM_double -1.7E+308 1.7E+308 /end CHARACTERISTIC
/begin CHARACTERISTIC Arizona_base_GOAT_cal_impl.DOInhibitGantryx2DOGantryxL_P1 "" VALUE 0x0025CFE8 Scalar_FLOAT64_IEEE 0 Arizona_base_GOAT_CM_double -1.7E+308 1.7E+308 /end CHARACTERISTIC
/begin CHARACTERISTIC Arizona_base_GOAT_cal_impl.DOInhibitGantryx2DOGantryxL_P2 "" VALUE 0x0025D000 Scalar_FLOAT64_IEEE 0 Arizona_base_GOAT_CM_double -1.7E+308 1.7E+308 /end CHARACTERISTIC
/begin CHARACTERISTIC Arizona_base_GOAT_cal_impl.DOInhibitGantryx2DOGantryxL_P3 "" VALUE 0x0025D018 Scalar_FLOAT64_IEEE 0 Arizona_base_GOAT_CM_double -1.7E+308 1.7E+308 /end CHARACTERISTIC
/begin CHARACTERISTIC Arizona_base_GOAT_cal_impl.DOInhibitGantryx2DOGantryxL_P4 "" VALUE 0x0025D030 Scalar_FLOAT64_IEEE 0 Arizona_base_GOAT_CM_double -1.7E+308 1.7E+308 /end CHARACTERISTIC
/begin CHARACTERISTIC Arizona_base_GOAT_cal_impl.DOInhibitGantryx2DOGantryxL_P5 "" VALUE 0x0025D048 Scalar_FLOAT64_IEEE 0 Arizona_base_GOAT_CM_double -1.7E+308 1.7E+308 /end CHARACTERISTIC
/begin CHARACTERISTIC Arizona_base_GOAT_cal_impl.DOInhibitGantryx2DOGantryxL_P6 "" VALUE 0x0025D060 Scalar_FLOAT64_IEEE 0 Arizona_base_GOAT_CM_double -1.7E+308 1.7E+308 /end CHARACTERISTIC
/begin CHARACTERISTIC Arizona_base_GOAT_cal_impl.DOInhibitGantryx2DOGantryxL_P7 "" VALUE 0x0025D078 Scalar_FLOAT64_IEEE 0 Arizona_base_GOAT_CM_double -1.7E+308 1.7E+308 /end CHARACTERISTIC
/begin CHARACTERISTIC Arizona_base_GOAT_cal_impl.DOInhibitGantryx2DOGantryxL_P8 "" VALUE 0x0025D090 Scalar_FLOAT64_IEEE 0 Arizona_base_GOAT_CM_double -1.7E+308 1.7E+308 /end CHARACTERISTIC
/begin CHARACTERISTIC Arizona_base_GOAT_cal_impl.Dct2lowpasscurrent_carriageAi_c "" VALUE 0x0025CBF0 Scalar_FLOAT64_IEEE 0 Arizona_base_GOAT_CM_double -1.7E+308 1.7E+308 /end CHARACTERISTIC
/begin CHARACTERISTIC Arizona_base_GOAT_cal_impl.Dct2lowpasscurrent_carriageAi_l "" VALUE 0x0025CC08 Scalar_FLOAT64_IEEE 0 Arizona_base_GOAT_CM_double -1.7E+308 1.7E+308 /end CHARACTERISTIC
/begin CHARACTERISTIC Arizona_base_GOAT_cal_impl.Dct2lowpasscurrent_carriageAi_n "" VALUE 0x0025CC20 Scalar_FLOAT64_IEEE 0 Arizona_base_GOAT_CM_double -1.7E+308 1.7E+308 /end CHARACTERISTIC
/begin CHARACTERISTIC Arizona_base_GOAT_cal_impl.Dct2lowpasscurrent_gantryAirb_a "" VALUE 0x0025CB08 Scalar_FLOAT64_IEEE 0 Arizona_base_GOAT_CM_double -1.7E+308 1.7E+308 /end CHARACTERISTIC
/begin CHARACTERISTIC Arizona_base_GOAT_cal_impl.Dct2lowpasscurrent_gantryAirb_e "" VALUE 0x0025CAD8 Scalar_FLOAT64_IEEE 0 Arizona_base_GOAT_CM_double -1.7E+308 1.7E+308 /end CHARACTERISTIC
/begin CHARACTERISTIC Arizona_base_GOAT_cal_impl.Dct2lowpasscurrent_gantryAirb_m "" VALUE 0x0025CAF0 Scalar_FLOAT64_IEEE 0 Arizona_base_GOAT_CM_double -1.7E+308 1.7E+308 /end CHARACTERISTIC
/begin CHARACTERISTIC Arizona_base_GOAT_cal_impl.Dct2lowpassoutput_x_P1 "" VALUE 0x0025CA60 Scalar_FLOAT64_IEEE 0 Arizona_base_GOAT_CM_double -1.7E+308 1.7E+308 /end CHARACTERISTIC
/begin CHARACTERISTIC Arizona_base_GOAT_cal_impl.Dct2lowpassoutput_x_P2 "" VALUE 0x0025CA78 Scalar_FLOAT64_IEEE 0 Arizona_base_GOAT_CM_double -1.7E+308 1.7E+308 /end CHARACTERISTIC
/begin CHARACTERISTIC Arizona_base_GOAT_cal_impl.Dct2lowpassoutput_x_P3 "" VALUE 0x0025CA90 Scalar_FLOAT64_IEEE 0 Arizona_base_GOAT_CM_double -1.7E+308 1.7E+308 /end CHARACTERISTIC
/begin CHARACTERISTIC Arizona_base_GOAT_cal_impl.Dct2lowpassoutput_y_P1 "" VALUE 0x0025C9E8 Scalar_FLOAT64_IEEE 0 Arizona_base_GOAT_CM_double -1.7E+308 1.7E+308 /end CHARACTERISTIC
/begin CHARACTERISTIC Arizona_base_GOAT_cal_impl.Dct2lowpassoutput_y_P2 "" VALUE 0x0025CA00 Scalar_FLOAT64_IEEE 0 Arizona_base_GOAT_CM_double -1.7E+308 1.7E+308 /end CHARACTERISTIC
/begin CHARACTERISTIC Arizona_base_GOAT_cal_impl.Dct2lowpassoutput_y_P3 "" VALUE 0x0025CA18 Scalar_FLOAT64_IEEE 0 Arizona_base_GOAT_CM_double -1.7E+308 1.7E+308 /end CHARACTERISTIC
/begin CHARACTERISTIC Arizona_base_GOAT_cal_impl.Dct2lowpassx1JogSpeed_P1 "" VALUE 0x0023AA58 Scalar_FLOAT64_IEEE 0 Arizona_base_GOAT_CM_double -1.7E+308 1.7E+308 /end CHARACTERISTIC
/begin CHARACTERISTIC Arizona_base_GOAT_cal_impl.Dct2lowpassx1JogSpeed_P2 "" VALUE 0x0023AA70 Scalar_FLOAT64_IEEE 0 Arizona_base_GOAT_CM_double -1.7E+308 1.7E+308 /end CHARACTERISTIC
/begin CHARACTERISTIC Arizona_base_GOAT_cal_impl.Dct2lowpassx1JogSpeed_P3 "" VALUE 0x0023AA88 Scalar_FLOAT64_IEEE 0 Arizona_base_GOAT_CM_double -1.7E+308 1.7E+308 /end CHARACTERISTIC
/begin CHARACTERISTIC Arizona_base_GOAT_cal_impl.Dct2lowpassx2JogSpeed_P1 "" VALUE 0x0023AAA0 Scalar_FLOAT64_IEEE 0 Arizona_base_GOAT_CM_double -1.7E+308 1.7E+308 /end CHARACTERISTIC
/begin CHARACTERISTIC Arizona_base_GOAT_cal_impl.Dct2lowpassx2JogSpeed_P2 "" VALUE 0x0023AAB8 Scalar_FLOAT64_IEEE 0 Arizona_base_GOAT_CM_double -1.7E+308 1.7E+308 /end CHARACTERISTIC
/begin CHARACTERISTIC Arizona_base_GOAT_cal_impl.Dct2lowpassx2JogSpeed_P3 "" VALUE 0x0023AAD0 Scalar_FLOAT64_IEEE 0 Arizona_base_GOAT_CM_double -1.7E+308 1.7E+308 /end CHARACTERISTIC
/begin CHARACTERISTIC Arizona_base_GOAT_cal_impl.Dct2lowpassyJogSpeed_P1 "" VALUE 0x0023AAE8 Scalar_FLOAT64_IEEE 0 Arizona_base_GOAT_CM_double -1.7E+308 1.7E+308 /end CHARACTERISTIC
/begin CHARACTERISTIC Arizona_base_GOAT_cal_impl.Dct2lowpassyJogSpeed_P2 "" VALUE 0x0023AB00 Scalar_FLOAT64_IEEE 0 Arizona_base_GOAT_CM_double -1.7E+308 1.7E+308 /end CHARACTERISTIC
/begin CHARACTERISTIC Arizona_base_GOAT_cal_impl.Dct2lowpassyJogSpeed_P3 "" VALUE 0x0023AB18 Scalar_FLOAT64_IEEE 0 Arizona_base_GOAT_CM_double -1.7E+308 1.7E+308 /end CHARACTERISTIC
/begin CHARACTERISTIC Arizona_base_GOAT_cal_impl.Delay1_InitialCondition "" VALUE 0x0025C9B0 Scalar_FLOAT64_IEEE 0 Arizona_base_GOAT_CM_double -1.7E+308 1.7E+308 /end CHARACTERISTIC
/begin CHARACTERISTIC Arizona_base_GOAT_cal_impl.Delay1_InitialCondition_l "" VALUE 0x0025CAA0 Scalar_FLOAT64_IEEE 0 Arizona_base_GOAT_CM_double -1.7E+308 1.7E+308 /end CHARACTERISTIC
/begin CHARACTERISTIC Arizona_base_GOAT_cal_impl.Delay1_InitialCondition_m "" VALUE 0x0025C9C8 Scalar_FLOAT64_IEEE 0 Arizona_base_GOAT_CM_double -1.7E+308 1.7E+308 /end CHARACTERISTIC
/begin CHARACTERISTIC Arizona_base_GOAT_cal_impl.Delay1_InitialCondition_mu "" VALUE 0x0025CA28 Scalar_FLOAT64_IEEE 0 Arizona_base_GOAT_CM_double -1.7E+308 1.7E+308 /end CHARACTERISTIC
/begin CHARACTERISTIC Arizona_base_GOAT_cal_impl.Delay2_InitialCondition "" VALUE 0x0025C9A8 Scalar_FLOAT64_IEEE 0 Arizona_base_GOAT_CM_double -1.7E+308 1.7E+308 /end CHARACTERISTIC
/begin CHARACTERISTIC Arizona_base_GOAT_cal_impl.Delay_InitialCondition "" VALUE 0x0023A9F8 Scalar_FLOAT64_IEEE 0 Arizona_base_GOAT_CM_double -1.7E+308 1.7E+308 /end CHARACTERISTIC
/begin CHARACTERISTIC Arizona_base_GOAT_cal_impl.Delay_InitialCondition_a "" VALUE 0x0025CAA8 Scalar_FLOAT64_IEEE 0 Arizona_base_GOAT_CM_double -1.7E+308 1.7E+308 /end CHARACTERISTIC
/begin CHARACTERISTIC Arizona_base_GOAT_cal_impl.Delay_InitialCondition_d "" VALUE 0x0025CA30 Scalar_FLOAT64_IEEE 0 Arizona_base_GOAT_CM_double -1.7E+308 1.7E+308 /end CHARACTERISTIC
/begin CHARACTERISTIC Arizona_base_GOAT_cal_impl.Delay_InitialCondition_g "" VALUE 0x0025DA09 Scalar_BOOLEAN 0 Arizona_base_GOAT_CM_logical 0 1 /end CHARACTERISTIC
/begin CHARACTERISTIC Arizona_base_GOAT_cal_impl.Delay_InitialCondition_o "" VALUE 0x0025C9B8 Scalar_FLOAT64_IEEE 0 Arizona_base_GOAT_CM_double -1.7E+308 1.7E+308 /end CHARACTERISTIC
/begin CHARACTERISTIC Arizona_base_GOAT_cal_impl.DiscreteDerivativeoutput_x_ICPr "" VALUE 0x00222068 Scalar_FLOAT64_IEEE 0 Arizona_base_GOAT_CM_double -1.7E+308 1.7E+308 /end CHARACTERISTIC
/begin CHARACTERISTIC Arizona_base_GOAT_cal_impl.DiscreteDerivativeoutput_y_ICPr "" VALUE 0x00222060 Scalar_FLOAT64_IEEE 0 Arizona_base_GOAT_CM_double -1.7E+308 1.7E+308 /end CHARACTERISTIC
/begin CHARACTERISTIC Arizona_base_GOAT_cal_impl.DiscreteTimeIntegratorx1JogSp_k "" VALUE 0x0023AA30 Scalar_FLOAT64_IEEE 0 Arizona_base_GOAT_CM_double -1.7E+308 1.7E+308 /end CHARACTERISTIC
/begin CHARACTERISTIC Arizona_base_GOAT_cal_impl.DiscreteTimeIntegratorx1JogSpee "" VALUE 0x0023AA28 Scalar_FLOAT64_IEEE 0 Arizona_base_GOAT_CM_double -1.7E+308 1.7E+308 /end CHARACTERISTIC
/begin CHARACTERISTIC Arizona_base_GOAT_cal_impl.DiscreteTimeIntegratorx2JogSp_e "" VALUE 0x0023AA20 Scalar_FLOAT64_IEEE 0 Arizona_base_GOAT_CM_double -1.7E+308 1.7E+308 /end CHARACTERISTIC
/begin CHARACTERISTIC Arizona_base_GOAT_cal_impl.DiscreteTimeIntegratorx2JogSp_m "" VALUE 0x0023AA10 Scalar_FLOAT64_IEEE 0 Arizona_base_GOAT_CM_double -1.7E+308 1.7E+308 /end CHARACTERISTIC
/begin CHARACTERISTIC Arizona_base_GOAT_cal_impl.DiscreteTimeIntegratorx2JogSp_n "" VALUE 0x0023AA18 Scalar_FLOAT64_IEEE 0 Arizona_base_GOAT_CM_double -1.7E+308 1.7E+308 /end CHARACTERISTIC
/begin CHARACTERISTIC Arizona_base_GOAT_cal_impl.DiscreteTimeIntegratorx2JogSpee "" VALUE 0x0023AA08 Scalar_FLOAT64_IEEE 0 Arizona_base_GOAT_CM_double -1.7E+308 1.7E+308 /end CHARACTERISTIC
/begin CHARACTERISTIC Arizona_base_GOAT_cal_impl.Enable_amplifier_xL_Value "" VALUE 0x0025CFD0 Scalar_FLOAT64_IEEE 0 Arizona_base_GOAT_CM_double -1.7E+308 1.7E+308 /end CHARACTERISTIC
/begin CHARACTERISTIC Arizona_base_GOAT_cal_impl.Enable_amplifier_xR_Value "" VALUE 0x0025CF08 Scalar_FLOAT64_IEEE 0 Arizona_base_GOAT_CM_double -1.7E+308 1.7E+308 /end CHARACTERISTIC
/begin CHARACTERISTIC Arizona_base_GOAT_cal_impl.Enable_amplifier_y_Value "" VALUE 0x0025CE40 Scalar_FLOAT64_IEEE 0 Arizona_base_GOAT_CM_double -1.7E+308 1.7E+308 /end CHARACTERISTIC
/begin CHARACTERISTIC Arizona_base_GOAT_cal_impl.Gain10_Gain "" VALUE 0x0025CAC0 Scalar_FLOAT64_IEEE 0 Arizona_base_GOAT_CM_double -1.7E+308 1.7E+308 /end CHARACTERISTIC
/begin CHARACTERISTIC Arizona_base_GOAT_cal_impl.Gain10_Gain_n "" VALUE 0x0025D780 Scalar_FLOAT64_IEEE 0 Arizona_base_GOAT_CM_double -1.7E+308 1.7E+308 /end CHARACTERISTIC
/begin CHARACTERISTIC Arizona_base_GOAT_cal_impl.Gain1_Gain "" VALUE 0x0025C2A0 Scalar_FLOAT64_IEEE 0 Arizona_base_GOAT_CM_double -1.7E+308 1.7E+308 /end CHARACTERISTIC
/begin CHARACTERISTIC Arizona_base_GOAT_cal_impl.Gain1_Gain_i "" VALUE 0x0025D9D0 Scalar_FLOAT64_IEEE 0 Arizona_base_GOAT_CM_double -1.7E+308 1.7E+308 /end CHARACTERISTIC
/begin CHARACTERISTIC Arizona_base_GOAT_cal_impl.Gain1_Gain_o "" VALUE 0x0025D988 Scalar_FLOAT64_IEEE 0 Arizona_base_GOAT_CM_double -1.7E+308 1.7E+308 /end CHARACTERISTIC
/begin CHARACTERISTIC Arizona_base_GOAT_cal_impl.Gain5_Gain "" VALUE 0x0025C4F0 Scalar_FLOAT64_IEEE 0 Arizona_base_GOAT_CM_double -1.7E+308 1.7E+308 /end CHARACTERISTIC
/begin CHARACTERISTIC Arizona_base_GOAT_cal_impl.Gain6_Gain "" VALUE 0x0025C740 Scalar_FLOAT64_IEEE 0 Arizona_base_GOAT_CM_double -1.7E+308 1.7E+308 /end CHARACTERISTIC
/begin CHARACTERISTIC Arizona_base_GOAT_cal_impl.Gain7_Gain "" VALUE 0x0025C990 Scalar_FLOAT64_IEEE 0 Arizona_base_GOAT_CM_double -1.7E+308 1.7E+308 /end CHARACTERISTIC
/begin CHARACTERISTIC Arizona_base_GOAT_cal_impl.Gain8_Gain "" VALUE 0x0025C9D0 Scalar_FLOAT64_IEEE 0 Arizona_base_GOAT_CM_double -1.7E+308 1.7E+308 /end CHARACTERISTIC
/begin CHARACTERISTIC Arizona_base_GOAT_cal_impl.Gain8_Gain_c "" VALUE 0x0025D9F0 Scalar_FLOAT64_IEEE 0 Arizona_base_GOAT_CM_double -1.7E+308 1.7E+308 /end CHARACTERISTIC
/begin CHARACTERISTIC Arizona_base_GOAT_cal_impl.Gain8_Gain_e "" VALUE 0x0025D9A8 Scalar_FLOAT64_IEEE 0 Arizona_base_GOAT_CM_double -1.7E+308 1.7E+308 /end CHARACTERISTIC
/begin CHARACTERISTIC Arizona_base_GOAT_cal_impl.Gain8_Gain_l "" VALUE 0x0025D2E0 Scalar_FLOAT64_IEEE 0 Arizona_base_GOAT_CM_double -1.7E+308 1.7E+308 /end CHARACTERISTIC
/begin CHARACTERISTIC Arizona_base_GOAT_cal_impl.Gain9_Gain "" VALUE 0x0025CA48 Scalar_FLOAT64_IEEE 0 Arizona_base_GOAT_CM_double -1.7E+308 1.7E+308 /end CHARACTERISTIC
/begin CHARACTERISTIC Arizona_base_GOAT_cal_impl.Gain9_Gain_j "" VALUE 0x0025D530 Scalar_FLOAT64_IEEE 0 Arizona_base_GOAT_CM_double -1.7E+308 1.7E+308 /end CHARACTERISTIC
/begin CHARACTERISTIC Arizona_base_GOAT_cal_impl.Gain_Gain "" VALUE 0x0025C998 Scalar_FLOAT64_IEEE 0 Arizona_base_GOAT_CM_double -1.7E+308 1.7E+308 /end CHARACTERISTIC
/begin CHARACTERISTIC Arizona_base_GOAT_cal_impl.Gain_Gain_c "" VALUE 0x0025D998 Scalar_FLOAT64_IEEE 0 Arizona_base_GOAT_CM_double -1.7E+308 1.7E+308 /end CHARACTERISTIC
/begin CHARACTERISTIC Arizona_base_GOAT_cal_impl.Gain_Gain_f "" VALUE 0x0025D9E0 Scalar_FLOAT64_IEEE 0 Arizona_base_GOAT_CM_double -1.7E+308 1.7E+308 /end CHARACTERISTIC
/begin CHARACTERISTIC Arizona_base_GOAT_cal_impl.Gaincarriagemotorcurrent_Gain "" VALUE 0x0025CC70 Scalar_FLOAT64_IEEE 0 Arizona_base_GOAT_CM_double -1.7E+308 1.7E+308 /end CHARACTERISTIC
/begin CHARACTERISTIC Arizona_base_GOAT_cal_impl.Gaingantryx2motorcurrent1_Gain "" VALUE 0x0025CBD0 Scalar_FLOAT64_IEEE 0 Arizona_base_GOAT_CM_double -1.7E+308 1.7E+308 /end CHARACTERISTIC
/begin CHARACTERISTIC Arizona_base_GOAT_cal_impl.Gaingantryx2motorcurrent_Gain "" VALUE 0x0025CBD8 Scalar_FLOAT64_IEEE 0 Arizona_base_GOAT_CM_double -1.7E+308 1.7E+308 /end CHARACTERISTIC
/begin CHARACTERISTIC Arizona_base_GOAT_cal_impl.Gainonphi2_Gain "" VALUE 0x0025D978 Scalar_FLOAT64_IEEE 0 Arizona_base_GOAT_CM_double -1.7E+308 1.7E+308 /end CHARACTERISTIC
/begin CHARACTERISTIC Arizona_base_GOAT_cal_impl.Gainonphi3_Gain "" VALUE 0x0025D9C0 Scalar_FLOAT64_IEEE 0 Arizona_base_GOAT_CM_double -1.7E+308 1.7E+308 /end CHARACTERISTIC
/begin CHARACTERISTIC Arizona_base_GOAT_cal_impl.Gainonu_phi_Gain "" VALUE 0x0025CBC8 Scalar_FLOAT64_IEEE 0 Arizona_base_GOAT_CM_double -1.7E+308 1.7E+308 /end CHARACTERISTIC
/begin CHARACTERISTIC Arizona_base_GOAT_cal_impl.Gainonu_x_Gain "" VALUE 0x0025CB58 Scalar_FLOAT64_IEEE 0 Arizona_base_GOAT_CM_double -1.7E+308 1.7E+308 /end CHARACTERISTIC
/begin CHARACTERISTIC Arizona_base_GOAT_cal_impl.Gainphi_Gain "" VALUE 0x0025CAB8 Scalar_FLOAT64_IEEE 0 Arizona_base_GOAT_CM_double -1.7E+308 1.7E+308 /end CHARACTERISTIC
/begin CHARACTERISTIC Arizona_base_GOAT_cal_impl.Gainx2_Gain "" VALUE 0x0023AA38 Scalar_FLOAT64_IEEE 0 Arizona_base_GOAT_CM_double -1.7E+308 1.7E+308 /end CHARACTERISTIC
/begin CHARACTERISTIC Arizona_base_GOAT_cal_impl.Gainx3_Gain "" VALUE 0x0023AA40 Scalar_FLOAT64_IEEE 0 Arizona_base_GOAT_CM_double -1.7E+308 1.7E+308 /end CHARACTERISTIC
/begin CHARACTERISTIC Arizona_base_GOAT_cal_impl.Gainx_Gain "" VALUE 0x0025CA40 Scalar_FLOAT64_IEEE 0 Arizona_base_GOAT_CM_double -1.7E+308 1.7E+308 /end CHARACTERISTIC
/begin CHARACTERISTIC Arizona_base_GOAT_cal_impl.GantryX1secundair_P1 "" VALUE 0x0025D2F8 Scalar_FLOAT64_IEEE 0 Arizona_base_GOAT_CM_double -1.7E+308 1.7E+308 /end CHARACTERISTIC
/begin CHARACTERISTIC Arizona_base_GOAT_cal_impl.GantryX1secundair_P10 "" VALUE 0x0025D3D0 Scalar_FLOAT64_IEEE 0 Arizona_base_GOAT_CM_double -1.7E+308 1.7E+308 /end CHARACTERISTIC
/begin CHARACTERISTIC Arizona_base_GOAT_cal_impl.GantryX1secundair_P11 "" VALUE 0x0025D3E8 Scalar_FLOAT64_IEEE 0 Arizona_base_GOAT_CM_double -1.7E+308 1.7E+308 /end CHARACTERISTIC
/begin CHARACTERISTIC Arizona_base_GOAT_cal_impl.GantryX1secundair_P12 "" VALUE 0x0025D400 Scalar_FLOAT64_IEEE 0 Arizona_base_GOAT_CM_double -1.7E+308 1.7E+308 /end CHARACTERISTIC
/begin CHARACTERISTIC Arizona_base_GOAT_cal_impl.GantryX1secundair_P13 "" VALUE 0x0025D418 Scalar_FLOAT64_IEEE 0 Arizona_base_GOAT_CM_double -1.7E+308 1.7E+308 /end CHARACTERISTIC
/begin CHARACTERISTIC Arizona_base_GOAT_cal_impl.GantryX1secundair_P14 "" VALUE 0x0025D430 Scalar_FLOAT64_IEEE 0 Arizona_base_GOAT_CM_double -1.7E+308 1.7E+308 /end CHARACTERISTIC
/begin CHARACTERISTIC Arizona_base_GOAT_cal_impl.GantryX1secundair_P15 "" VALUE 0x0025D448 Scalar_FLOAT64_IEEE 0 Arizona_base_GOAT_CM_double -1.7E+308 1.7E+308 /end CHARACTERISTIC
/begin CHARACTERISTIC Arizona_base_GOAT_cal_impl.GantryX1secundair_P16 "" VALUE 0x0025D460 Scalar_FLOAT64_IEEE 0 Arizona_base_GOAT_CM_double -1.7E+308 1.7E+308 /end CHARACTERISTIC
/begin CHARACTERISTIC Arizona_base_GOAT_cal_impl.GantryX1secundair_P17 "" VALUE 0x0025D478 Scalar_FLOAT64_IEEE 0 Arizona_base_GOAT_CM_double -1.7E+308 1.7E+308 /end CHARACTERISTIC
/begin CHARACTERISTIC Arizona_base_GOAT_cal_impl.GantryX1secundair_P18 "" VALUE 0x0025D490 Scalar_FLOAT64_IEEE 0 Arizona_base_GOAT_CM_double -1.7E+308 1.7E+308 /end CHARACTERISTIC
/begin CHARACTERISTIC Arizona_base_GOAT_cal_impl.GantryX1secundair_P19 "" VALUE 0x0025D4A8 Scalar_FLOAT64_IEEE 0 Arizona_base_GOAT_CM_double -1.7E+308 1.7E+308 /end CHARACTERISTIC
/begin CHARACTERISTIC Arizona_base_GOAT_cal_impl.GantryX1secundair_P2 "" VALUE 0x0025D310 Scalar_FLOAT64_IEEE 0 Arizona_base_GOAT_CM_double -1.7E+308 1.7E+308 /end CHARACTERISTIC
/begin CHARACTERISTIC Arizona_base_GOAT_cal_impl.GantryX1secundair_P20 "" VALUE 0x0025D4C0 Scalar_FLOAT64_IEEE 0 Arizona_base_GOAT_CM_double -1.7E+308 1.7E+308 /end CHARACTERISTIC
/begin CHARACTERISTIC Arizona_base_GOAT_cal_impl.GantryX1secundair_P21 "" VALUE 0x0025D4D8 Scalar_FLOAT64_IEEE 0 Arizona_base_GOAT_CM_double -1.7E+308 1.7E+308 /end CHARACTERISTIC
/begin CHARACTERISTIC Arizona_base_GOAT_cal_impl.GantryX1secundair_P22 "" VALUE 0x0025D4F0 Scalar_FLOAT64_IEEE 0 Arizona_base_GOAT_CM_double -1.7E+308 1.7E+308 /end CHARACTERISTIC
/begin CHARACTERISTIC Arizona_base_GOAT_cal_impl.GantryX1secundair_P23 "" VALUE 0x0025D508 Scalar_FLOAT64_IEEE 0 Arizona_base_GOAT_CM_double -1.7E+308 1.7E+308 /end CHARACTERISTIC
/begin CHARACTERISTIC Arizona_base_GOAT_cal_impl.GantryX1secundair_P24 "" VALUE 0x0025D520 Scalar_FLOAT64_IEEE 0 Arizona_base_GOAT_CM_double -1.7E+308 1.7E+308 /end CHARACTERISTIC
/begin CHARACTERISTIC Arizona_base_GOAT_cal_impl.GantryX1secundair_P3 "" VALUE 0x0025D328 Scalar_FLOAT64_IEEE 0 Arizona_base_GOAT_CM_double -1.7E+308 1.7E+308 /end CHARACTERISTIC
/begin CHARACTERISTIC Arizona_base_GOAT_cal_impl.GantryX1secundair_P4 "" VALUE 0x0025D340 Scalar_FLOAT64_IEEE 0 Arizona_base_GOAT_CM_double -1.7E+308 1.7E+308 /end CHARACTERISTIC
/begin CHARACTERISTIC Arizona_base_GOAT_cal_impl.GantryX1secundair_P5 "" VALUE 0x0025D358 Scalar_FLOAT64_IEEE 0 Arizona_base_GOAT_CM_double -1.7E+308 1.7E+308 /end CHARACTERISTIC
/begin CHARACTERISTIC Arizona_base_GOAT_cal_impl.GantryX1secundair_P6 "" VALUE 0x0025D370 Scalar_FLOAT64_IEEE 0 Arizona_base_GOAT_CM_double -1.7E+308 1.7E+308 /end CHARACTERISTIC
/begin CHARACTERISTIC Arizona_base_GOAT_cal_impl.GantryX1secundair_P7 "" VALUE 0x0025D388 Scalar_FLOAT64_IEEE 0 Arizona_base_GOAT_CM_double -1.7E+308 1.7E+308 /end CHARACTERISTIC
/begin CHARACTERISTIC Arizona_base_GOAT_cal_impl.GantryX1secundair_P8 "" VALUE 0x0025D3A0 Scalar_FLOAT64_IEEE 0 Arizona_base_GOAT_CM_double -1.7E+308 1.7E+308 /end CHARACTERISTIC
/begin CHARACTERISTIC Arizona_base_GOAT_cal_impl.GantryX1secundair_P9 "" VALUE 0x0025D3B8 Scalar_FLOAT64_IEEE 0 Arizona_base_GOAT_CM_double -1.7E+308 1.7E+308 /end CHARACTERISTIC
/begin CHARACTERISTIC Arizona_base_GOAT_cal_impl.Gantryx1GantryxR_P1 "" VALUE 0x0025C508 Scalar_FLOAT64_IEEE 0 Arizona_base_GOAT_CM_double -1.7E+308 1.7E+308 /end CHARACTERISTIC
/begin CHARACTERISTIC Arizona_base_GOAT_cal_impl.Gantryx1GantryxR_P10 "" VALUE 0x0025C5E0 Scalar_FLOAT64_IEEE 0 Arizona_base_GOAT_CM_double -1.7E+308 1.7E+308 /end CHARACTERISTIC
/begin CHARACTERISTIC Arizona_base_GOAT_cal_impl.Gantryx1GantryxR_P11 "" VALUE 0x0025C5F8 Scalar_FLOAT64_IEEE 0 Arizona_base_GOAT_CM_double -1.7E+308 1.7E+308 /end CHARACTERISTIC
/begin CHARACTERISTIC Arizona_base_GOAT_cal_impl.Gantryx1GantryxR_P12 "" VALUE 0x0025C610 Scalar_FLOAT64_IEEE 0 Arizona_base_GOAT_CM_double -1.7E+308 1.7E+308 /end CHARACTERISTIC
/begin CHARACTERISTIC Arizona_base_GOAT_cal_impl.Gantryx1GantryxR_P13 "" VALUE 0x0025C628 Scalar_FLOAT64_IEEE 0 Arizona_base_GOAT_CM_double -1.7E+308 1.7E+308 /end CHARACTERISTIC
/begin CHARACTERISTIC Arizona_base_GOAT_cal_impl.Gantryx1GantryxR_P14 "" VALUE 0x0025C640 Scalar_FLOAT64_IEEE 0 Arizona_base_GOAT_CM_double -1.7E+308 1.7E+308 /end CHARACTERISTIC
/begin CHARACTERISTIC Arizona_base_GOAT_cal_impl.Gantryx1GantryxR_P15 "" VALUE 0x0025C658 Scalar_FLOAT64_IEEE 0 Arizona_base_GOAT_CM_double -1.7E+308 1.7E+308 /end CHARACTERISTIC
/begin CHARACTERISTIC Arizona_base_GOAT_cal_impl.Gantryx1GantryxR_P16 "" VALUE 0x0025C670 Scalar_FLOAT64_IEEE 0 Arizona_base_GOAT_CM_double -1.7E+308 1.7E+308 /end CHARACTERISTIC
/begin CHARACTERISTIC Arizona_base_GOAT_cal_impl.Gantryx1GantryxR_P17 "" VALUE 0x0025C688 Scalar_FLOAT64_IEEE 0 Arizona_base_GOAT_CM_double -1.7E+308 1.7E+308 /end CHARACTERISTIC
/begin CHARACTERISTIC Arizona_base_GOAT_cal_impl.Gantryx1GantryxR_P18 "" VALUE 0x0025C6A0 Scalar_FLOAT64_IEEE 0 Arizona_base_GOAT_CM_double -1.7E+308 1.7E+308 /end CHARACTERISTIC
/begin CHARACTERISTIC Arizona_base_GOAT_cal_impl.Gantryx1GantryxR_P19 "" VALUE 0x0025C6B8 Scalar_FLOAT64_IEEE 0 Arizona_base_GOAT_CM_double -1.7E+308 1.7E+308 /end CHARACTERISTIC
/begin CHARACTERISTIC Arizona_base_GOAT_cal_impl.Gantryx1GantryxR_P2 "" VALUE 0x0025C520 Scalar_FLOAT64_IEEE 0 Arizona_base_GOAT_CM_double -1.7E+308 1.7E+308 /end CHARACTERISTIC
/begin CHARACTERISTIC Arizona_base_GOAT_cal_impl.Gantryx1GantryxR_P20 "" VALUE 0x0025C6D0 Scalar_FLOAT64_IEEE 0 Arizona_base_GOAT_CM_double -1.7E+308 1.7E+308 /end CHARACTERISTIC
/begin CHARACTERISTIC Arizona_base_GOAT_cal_impl.Gantryx1GantryxR_P21 "" VALUE 0x0025C6E8 Scalar_FLOAT64_IEEE 0 Arizona_base_GOAT_CM_double -1.7E+308 1.7E+308 /end CHARACTERISTIC
/begin CHARACTERISTIC Arizona_base_GOAT_cal_impl.Gantryx1GantryxR_P22 "" VALUE 0x0025C700 Scalar_FLOAT64_IEEE 0 Arizona_base_GOAT_CM_double -1.7E+308 1.7E+308 /end CHARACTERISTIC
/begin CHARACTERISTIC Arizona_base_GOAT_cal_impl.Gantryx1GantryxR_P23 "" VALUE 0x0025C718 Scalar_FLOAT64_IEEE 0 Arizona_base_GOAT_CM_double -1.7E+308 1.7E+308 /end CHARACTERISTIC
/begin CHARACTERISTIC Arizona_base_GOAT_cal_impl.Gantryx1GantryxR_P24 "" VALUE 0x0025C730 Scalar_FLOAT64_IEEE 0 Arizona_base_GOAT_CM_double -1.7E+308 1.7E+308 /end CHARACTERISTIC
/begin CHARACTERISTIC Arizona_base_GOAT_cal_impl.Gantryx1GantryxR_P3 "" VALUE 0x0025C538 Scalar_FLOAT64_IEEE 0 Arizona_base_GOAT_CM_double -1.7E+308 1.7E+308 /end CHARACTERISTIC
/begin CHARACTERISTIC Arizona_base_GOAT_cal_impl.Gantryx1GantryxR_P4 "" VALUE 0x0025C550 Scalar_FLOAT64_IEEE 0 Arizona_base_GOAT_CM_double -1.7E+308 1.7E+308 /end CHARACTERISTIC
/begin CHARACTERISTIC Arizona_base_GOAT_cal_impl.Gantryx1GantryxR_P5 "" VALUE 0x0025C568 Scalar_FLOAT64_IEEE 0 Arizona_base_GOAT_CM_double -1.7E+308 1.7E+308 /end CHARACTERISTIC
/begin CHARACTERISTIC Arizona_base_GOAT_cal_impl.Gantryx1GantryxR_P6 "" VALUE 0x0025C580 Scalar_FLOAT64_IEEE 0 Arizona_base_GOAT_CM_double -1.7E+308 1.7E+308 /end CHARACTERISTIC
/begin CHARACTERISTIC Arizona_base_GOAT_cal_impl.Gantryx1GantryxR_P7 "" VALUE 0x0025C598 Scalar_FLOAT64_IEEE 0 Arizona_base_GOAT_CM_double -1.7E+308 1.7E+308 /end CHARACTERISTIC
/begin CHARACTERISTIC Arizona_base_GOAT_cal_impl.Gantryx1GantryxR_P8 "" VALUE 0x0025C5B0 Scalar_FLOAT64_IEEE 0 Arizona_base_GOAT_CM_double -1.7E+308 1.7E+308 /end CHARACTERISTIC
/begin CHARACTERISTIC Arizona_base_GOAT_cal_impl.Gantryx1GantryxR_P9 "" VALUE 0x0025C5C8 Scalar_FLOAT64_IEEE 0 Arizona_base_GOAT_CM_double -1.7E+308 1.7E+308 /end CHARACTERISTIC
/begin CHARACTERISTIC Arizona_base_GOAT_cal_impl.Gantryx2GantryxL_P1 "" VALUE 0x0025C758 Scalar_FLOAT64_IEEE 0 Arizona_base_GOAT_CM_double -1.7E+308 1.7E+308 /end CHARACTERISTIC
/begin CHARACTERISTIC Arizona_base_GOAT_cal_impl.Gantryx2GantryxL_P10 "" VALUE 0x0025C830 Scalar_FLOAT64_IEEE 0 Arizona_base_GOAT_CM_double -1.7E+308 1.7E+308 /end CHARACTERISTIC
/begin CHARACTERISTIC Arizona_base_GOAT_cal_impl.Gantryx2GantryxL_P11 "" VALUE 0x0025C848 Scalar_FLOAT64_IEEE 0 Arizona_base_GOAT_CM_double -1.7E+308 1.7E+308 /end CHARACTERISTIC
/begin CHARACTERISTIC Arizona_base_GOAT_cal_impl.Gantryx2GantryxL_P12 "" VALUE 0x0025C860 Scalar_FLOAT64_IEEE 0 Arizona_base_GOAT_CM_double -1.7E+308 1.7E+308 /end CHARACTERISTIC
/begin CHARACTERISTIC Arizona_base_GOAT_cal_impl.Gantryx2GantryxL_P13 "" VALUE 0x0025C878 Scalar_FLOAT64_IEEE 0 Arizona_base_GOAT_CM_double -1.7E+308 1.7E+308 /end CHARACTERISTIC
/begin CHARACTERISTIC Arizona_base_GOAT_cal_impl.Gantryx2GantryxL_P14 "" VALUE 0x0025C890 Scalar_FLOAT64_IEEE 0 Arizona_base_GOAT_CM_double -1.7E+308 1.7E+308 /end CHARACTERISTIC
/begin CHARACTERISTIC Arizona_base_GOAT_cal_impl.Gantryx2GantryxL_P15 "" VALUE 0x0025C8A8 Scalar_FLOAT64_IEEE 0 Arizona_base_GOAT_CM_double -1.7E+308 1.7E+308 /end CHARACTERISTIC
/begin CHARACTERISTIC Arizona_base_GOAT_cal_impl.Gantryx2GantryxL_P16 "" VALUE 0x0025C8C0 Scalar_FLOAT64_IEEE 0 Arizona_base_GOAT_CM_double -1.7E+308 1.7E+308 /end CHARACTERISTIC
/begin CHARACTERISTIC Arizona_base_GOAT_cal_impl.Gantryx2GantryxL_P17 "" VALUE 0x0025C8D8 Scalar_FLOAT64_IEEE 0 Arizona_base_GOAT_CM_double -1.7E+308 1.7E+308 /end CHARACTERISTIC
/begin CHARACTERISTIC Arizona_base_GOAT_cal_impl.Gantryx2GantryxL_P18 "" VALUE 0x0025C8F0 Scalar_FLOAT64_IEEE 0 Arizona_base_GOAT_CM_double -1.7E+308 1.7E+308 /end CHARACTERISTIC
/begin CHARACTERISTIC Arizona_base_GOAT_cal_impl.Gantryx2GantryxL_P19 "" VALUE 0x0025C908 Scalar_FLOAT64_IEEE 0 Arizona_base_GOAT_CM_double -1.7E+308 1.7E+308 /end CHARACTERISTIC
/begin CHARACTERISTIC Arizona_base_GOAT_cal_impl.Gantryx2GantryxL_P2 "" VALUE 0x0025C770 Scalar_FLOAT64_IEEE 0 Arizona_base_GOAT_CM_double -1.7E+308 1.7E+308 /end CHARACTERISTIC
/begin CHARACTERISTIC Arizona_base_GOAT_cal_impl.Gantryx2GantryxL_P20 "" VALUE 0x0025C920 Scalar_FLOAT64_IEEE 0 Arizona_base_GOAT_CM_double -1.7E+308 1.7E+308 /end CHARACTERISTIC
/begin CHARACTERISTIC Arizona_base_GOAT_cal_impl.Gantryx2GantryxL_P21 "" VALUE 0x0025C938 Scalar_FLOAT64_IEEE 0 Arizona_base_GOAT_CM_double -1.7E+308 1.7E+308 /end CHARACTERISTIC
/begin CHARACTERISTIC Arizona_base_GOAT_cal_impl.Gantryx2GantryxL_P22 "" VALUE 0x0025C950 Scalar_FLOAT64_IEEE 0 Arizona_base_GOAT_CM_double -1.7E+308 1.7E+308 /end CHARACTERISTIC
/begin CHARACTERISTIC Arizona_base_GOAT_cal_impl.Gantryx2GantryxL_P23 "" VALUE 0x0025C968 Scalar_FLOAT64_IEEE 0 Arizona_base_GOAT_CM_double -1.7E+308 1.7E+308 /end CHARACTERISTIC
/begin CHARACTERISTIC Arizona_base_GOAT_cal_impl.Gantryx2GantryxL_P24 "" VALUE 0x0025C980 Scalar_FLOAT64_IEEE 0 Arizona_base_GOAT_CM_double -1.7E+308 1.7E+308 /end CHARACTERISTIC
/begin CHARACTERISTIC Arizona_base_GOAT_cal_impl.Gantryx2GantryxL_P3 "" VALUE 0x0025C788 Scalar_FLOAT64_IEEE 0 Arizona_base_GOAT_CM_double -1.7E+308 1.7E+308 /end CHARACTERISTIC
/begin CHARACTERISTIC Arizona_base_GOAT_cal_impl.Gantryx2GantryxL_P4 "" VALUE 0x0025C7A0 Scalar_FLOAT64_IEEE 0 Arizona_base_GOAT_CM_double -1.7E+308 1.7E+308 /end CHARACTERISTIC
/begin CHARACTERISTIC Arizona_base_GOAT_cal_impl.Gantryx2GantryxL_P5 "" VALUE 0x0025C7B8 Scalar_FLOAT64_IEEE 0 Arizona_base_GOAT_CM_double -1.7E+308 1.7E+308 /end CHARACTERISTIC
/begin CHARACTERISTIC Arizona_base_GOAT_cal_impl.Gantryx2GantryxL_P6 "" VALUE 0x0025C7D0 Scalar_FLOAT64_IEEE 0 Arizona_base_GOAT_CM_double -1.7E+308 1.7E+308 /end CHARACTERISTIC
/begin CHARACTERISTIC Arizona_base_GOAT_cal_impl.Gantryx2GantryxL_P7 "" VALUE 0x0025C7E8 Scalar_FLOAT64_IEEE 0 Arizona_base_GOAT_CM_double -1.7E+308 1.7E+308 /end CHARACTERISTIC
/begin CHARACTERISTIC Arizona_base_GOAT_cal_impl.Gantryx2GantryxL_P8 "" VALUE 0x0025C800 Scalar_FLOAT64_IEEE 0 Arizona_base_GOAT_CM_double -1.7E+308 1.7E+308 /end CHARACTERISTIC
/begin CHARACTERISTIC Arizona_base_GOAT_cal_impl.Gantryx2GantryxL_P9 "" VALUE 0x0025C818 Scalar_FLOAT64_IEEE 0 Arizona_base_GOAT_CM_double -1.7E+308 1.7E+308 /end CHARACTERISTIC
/begin CHARACTERISTIC Arizona_base_GOAT_cal_impl.GentryX2secundair_P1 "" VALUE 0x0025D548 Scalar_FLOAT64_IEEE 0 Arizona_base_GOAT_CM_double -1.7E+308 1.7E+308 /end CHARACTERISTIC
/begin CHARACTERISTIC Arizona_base_GOAT_cal_impl.GentryX2secundair_P10 "" VALUE 0x0025D620 Scalar_FLOAT64_IEEE 0 Arizona_base_GOAT_CM_double -1.7E+308 1.7E+308 /end CHARACTERISTIC
/begin CHARACTERISTIC Arizona_base_GOAT_cal_impl.GentryX2secundair_P11 "" VALUE 0x0025D638 Scalar_FLOAT64_IEEE 0 Arizona_base_GOAT_CM_double -1.7E+308 1.7E+308 /end CHARACTERISTIC
/begin CHARACTERISTIC Arizona_base_GOAT_cal_impl.GentryX2secundair_P12 "" VALUE 0x0025D650 Scalar_FLOAT64_IEEE 0 Arizona_base_GOAT_CM_double -1.7E+308 1.7E+308 /end CHARACTERISTIC
/begin CHARACTERISTIC Arizona_base_GOAT_cal_impl.GentryX2secundair_P13 "" VALUE 0x0025D668 Scalar_FLOAT64_IEEE 0 Arizona_base_GOAT_CM_double -1.7E+308 1.7E+308 /end CHARACTERISTIC
/begin CHARACTERISTIC Arizona_base_GOAT_cal_impl.GentryX2secundair_P14 "" VALUE 0x0025D680 Scalar_FLOAT64_IEEE 0 Arizona_base_GOAT_CM_double -1.7E+308 1.7E+308 /end CHARACTERISTIC
/begin CHARACTERISTIC Arizona_base_GOAT_cal_impl.GentryX2secundair_P15 "" VALUE 0x0025D698 Scalar_FLOAT64_IEEE 0 Arizona_base_GOAT_CM_double -1.7E+308 1.7E+308 /end CHARACTERISTIC
/begin CHARACTERISTIC Arizona_base_GOAT_cal_impl.GentryX2secundair_P16 "" VALUE 0x0025D6B0 Scalar_FLOAT64_IEEE 0 Arizona_base_GOAT_CM_double -1.7E+308 1.7E+308 /end CHARACTERISTIC
/begin CHARACTERISTIC Arizona_base_GOAT_cal_impl.GentryX2secundair_P17 "" VALUE 0x0025D6C8 Scalar_FLOAT64_IEEE 0 Arizona_base_GOAT_CM_double -1.7E+308 1.7E+308 /end CHARACTERISTIC
/begin CHARACTERISTIC Arizona_base_GOAT_cal_impl.GentryX2secundair_P18 "" VALUE 0x0025D6E0 Scalar_FLOAT64_IEEE 0 Arizona_base_GOAT_CM_double -1.7E+308 1.7E+308 /end CHARACTERISTIC
/begin CHARACTERISTIC Arizona_base_GOAT_cal_impl.GentryX2secundair_P19 "" VALUE 0x0025D6F8 Scalar_FLOAT64_IEEE 0 Arizona_base_GOAT_CM_double -1.7E+308 1.7E+308 /end CHARACTERISTIC
/begin CHARACTERISTIC Arizona_base_GOAT_cal_impl.GentryX2secundair_P2 "" VALUE 0x0025D560 Scalar_FLOAT64_IEEE 0 Arizona_base_GOAT_CM_double -1.7E+308 1.7E+308 /end CHARACTERISTIC
/begin CHARACTERISTIC Arizona_base_GOAT_cal_impl.GentryX2secundair_P20 "" VALUE 0x0025D710 Scalar_FLOAT64_IEEE 0 Arizona_base_GOAT_CM_double -1.7E+308 1.7E+308 /end CHARACTERISTIC
/begin CHARACTERISTIC Arizona_base_GOAT_cal_impl.GentryX2secundair_P21 "" VALUE 0x0025D728 Scalar_FLOAT64_IEEE 0 Arizona_base_GOAT_CM_double -1.7E+308 1.7E+308 /end CHARACTERISTIC
/begin CHARACTERISTIC Arizona_base_GOAT_cal_impl.GentryX2secundair_P22 "" VALUE 0x0025D740 Scalar_FLOAT64_IEEE 0 Arizona_base_GOAT_CM_double -1.7E+308 1.7E+308 /end CHARACTERISTIC
/begin CHARACTERISTIC Arizona_base_GOAT_cal_impl.GentryX2secundair_P23 "" VALUE 0x0025D758 Scalar_FLOAT64_IEEE 0 Arizona_base_GOAT_CM_double -1.7E+308 1.7E+308 /end CHARACTERISTIC
/begin CHARACTERISTIC Arizona_base_GOAT_cal_impl.GentryX2secundair_P24 "" VALUE 0x0025D770 Scalar_FLOAT64_IEEE 0 Arizona_base_GOAT_CM_double -1.7E+308 1.7E+308 /end CHARACTERISTIC
/begin CHARACTERISTIC Arizona_base_GOAT_cal_impl.GentryX2secundair_P3 "" VALUE 0x0025D578 Scalar_FLOAT64_IEEE 0 Arizona_base_GOAT_CM_double -1.7E+308 1.7E+308 /end CHARACTERISTIC
/begin CHARACTERISTIC Arizona_base_GOAT_cal_impl.GentryX2secundair_P4 "" VALUE 0x0025D590 Scalar_FLOAT64_IEEE 0 Arizona_base_GOAT_CM_double -1.7E+308 1.7E+308 /end CHARACTERISTIC
/begin CHARACTERISTIC Arizona_base_GOAT_cal_impl.GentryX2secundair_P5 "" VALUE 0x0025D5A8 Scalar_FLOAT64_IEEE 0 Arizona_base_GOAT_CM_double -1.7E+308 1.7E+308 /end CHARACTERISTIC
/begin CHARACTERISTIC Arizona_base_GOAT_cal_impl.GentryX2secundair_P6 "" VALUE 0x0025D5C0 Scalar_FLOAT64_IEEE 0 Arizona_base_GOAT_CM_double -1.7E+308 1.7E+308 /end CHARACTERISTIC
/begin CHARACTERISTIC Arizona_base_GOAT_cal_impl.GentryX2secundair_P7 "" VALUE 0x0025D5D8 Scalar_FLOAT64_IEEE 0 Arizona_base_GOAT_CM_double -1.7E+308 1.7E+308 /end CHARACTERISTIC
/begin CHARACTERISTIC Arizona_base_GOAT_cal_impl.GentryX2secundair_P8 "" VALUE 0x0025D5F0 Scalar_FLOAT64_IEEE 0 Arizona_base_GOAT_CM_double -1.7E+308 1.7E+308 /end CHARACTERISTIC
/begin CHARACTERISTIC Arizona_base_GOAT_cal_impl.GentryX2secundair_P9 "" VALUE 0x0025D608 Scalar_FLOAT64_IEEE 0 Arizona_base_GOAT_CM_double -1.7E+308 1.7E+308 /end CHARACTERISTIC
/begin CHARACTERISTIC Arizona_base_GOAT_cal_impl.Internal_A "" VAL_BLK 0x0025CB10 Scalar_FLOAT64_IEEE 0 Arizona_base_GOAT_CM_double -1.7E+308 1.7E+308 MATRIX_DIM 1 3 /end CHARACTERISTIC
/begin CHARACTERISTIC Arizona_base_GOAT_cal_impl.Internal_A_g "" VAL_BLK 0x0025CC28 Scalar_FLOAT64_IEEE 0 Arizona_base_GOAT_CM_double -1.7E+308 1.7E+308 MATRIX_DIM 1 3 /end CHARACTERISTIC
/begin CHARACTERISTIC Arizona_base_GOAT_cal_impl.Internal_A_p "" VAL_BLK 0x0025CB60 Scalar_FLOAT64_IEEE 0 Arizona_base_GOAT_CM_double -1.7E+308 1.7E+308 MATRIX_DIM 1 6 /end CHARACTERISTIC
/begin CHARACTERISTIC Arizona_base_GOAT_cal_impl.Internal_B "" VAL_BLK 0x0025CB28 Scalar_FLOAT64_IEEE 0 Arizona_base_GOAT_CM_double -1.7E+308 1.7E+308 MATRIX_DIM 1 2 /end CHARACTERISTIC
/begin CHARACTERISTIC Arizona_base_GOAT_cal_impl.Internal_B_g "" VAL_BLK 0x0025CB90 Scalar_FLOAT64_IEEE 0 Arizona_base_GOAT_CM_double -1.7E+308 1.7E+308 MATRIX_DIM 1 2 /end CHARACTERISTIC
/begin CHARACTERISTIC Arizona_base_GOAT_cal_impl.Internal_B_j "" VAL_BLK 0x0025CC40 Scalar_FLOAT64_IEEE 0 Arizona_base_GOAT_CM_double -1.7E+308 1.7E+308 MATRIX_DIM 1 2 /end CHARACTERISTIC
/begin CHARACTERISTIC Arizona_base_GOAT_cal_impl.Internal_C "" VAL_BLK 0x0025CB38 Scalar_FLOAT64_IEEE 0 Arizona_base_GOAT_CM_double -1.7E+308 1.7E+308 MATRIX_DIM 1 2 /end CHARACTERISTIC
/begin CHARACTERISTIC Arizona_base_GOAT_cal_impl.Internal_C_i "" VAL_BLK 0x0025CBA0 Scalar_FLOAT64_IEEE 0 Arizona_base_GOAT_CM_double -1.7E+308 1.7E+308 MATRIX_DIM 1 3 /end CHARACTERISTIC
/begin CHARACTERISTIC Arizona_base_GOAT_cal_impl.Internal_C_l "" VAL_BLK 0x0025CC50 Scalar_FLOAT64_IEEE 0 Arizona_base_GOAT_CM_double -1.7E+308 1.7E+308 MATRIX_DIM 1 2 /end CHARACTERISTIC
/begin CHARACTERISTIC Arizona_base_GOAT_cal_impl.Internal_D "" VALUE 0x0025CB48 Scalar_FLOAT64_IEEE 0 Arizona_base_GOAT_CM_double -1.7E+308 1.7E+308 /end CHARACTERISTIC
/begin CHARACTERISTIC Arizona_base_GOAT_cal_impl.Internal_D_f "" VALUE 0x0025CC60 Scalar_FLOAT64_IEEE 0 Arizona_base_GOAT_CM_double -1.7E+308 1.7E+308 /end CHARACTERISTIC
/begin CHARACTERISTIC Arizona_base_GOAT_cal_impl.Internal_D_g "" VALUE 0x0025CBB8 Scalar_FLOAT64_IEEE 0 Arizona_base_GOAT_CM_double -1.7E+308 1.7E+308 /end CHARACTERISTIC
/begin CHARACTERISTIC Arizona_base_GOAT_cal_impl.Internal_InitialCondition "" VALUE 0x0025CB50 Scalar_FLOAT64_IEEE 0 Arizona_base_GOAT_CM_double -1.7E+308 1.7E+308 /end CHARACTERISTIC
/begin CHARACTERISTIC Arizona_base_GOAT_cal_impl.Internal_InitialCondition_e "" VALUE 0x0025CBC0 Scalar_FLOAT64_IEEE 0 Arizona_base_GOAT_CM_double -1.7E+308 1.7E+308 /end CHARACTERISTIC
/begin CHARACTERISTIC Arizona_base_GOAT_cal_impl.Internal_InitialCondition_o "" VALUE 0x0025CC68 Scalar_FLOAT64_IEEE 0 Arizona_base_GOAT_CM_double -1.7E+308 1.7E+308 /end CHARACTERISTIC
/begin CHARACTERISTIC Arizona_base_GOAT_cal_impl.Memory_InitialCondition "" VALUE 0x0023AB30 Scalar_FLOAT64_IEEE 0 Arizona_base_GOAT_CM_double -1.7E+308 1.7E+308 /end CHARACTERISTIC
/begin CHARACTERISTIC Arizona_base_GOAT_cal_impl.PWM1_Value "" VALUE 0x0025D9A0 Scalar_FLOAT64_IEEE 0 Arizona_base_GOAT_CM_double -1.7E+308 1.7E+308 /end CHARACTERISTIC
/begin CHARACTERISTIC Arizona_base_GOAT_cal_impl.PWM1_Value_l "" VALUE 0x0025D9E8 Scalar_FLOAT64_IEEE 0 Arizona_base_GOAT_CM_double -1.7E+308 1.7E+308 /end CHARACTERISTIC
/begin CHARACTERISTIC Arizona_base_GOAT_cal_impl.PenColor_Value "" VALUE 0x0025D950 Scalar_FLOAT64_IEEE 0 Arizona_base_GOAT_CM_double -1.7E+308 1.7E+308 /end CHARACTERISTIC
/begin CHARACTERISTIC Arizona_base_GOAT_cal_impl.Saturation2_LowerSat "" VALUE 0x0025D9B8 Scalar_FLOAT64_IEEE 0 Arizona_base_GOAT_CM_double -1.7E+308 1.7E+308 /end CHARACTERISTIC
/begin CHARACTERISTIC Arizona_base_GOAT_cal_impl.Saturation2_LowerSat_e "" VALUE 0x0025DA00 Scalar_FLOAT64_IEEE 0 Arizona_base_GOAT_CM_double -1.7E+308 1.7E+308 /end CHARACTERISTIC
/begin CHARACTERISTIC Arizona_base_GOAT_cal_impl.Saturation2_UpperSat "" VALUE 0x0025D9B0 Scalar_FLOAT64_IEEE 0 Arizona_base_GOAT_CM_double -1.7E+308 1.7E+308 /end CHARACTERISTIC
/begin CHARACTERISTIC Arizona_base_GOAT_cal_impl.Saturation2_UpperSat_m "" VALUE 0x0025D9F8 Scalar_FLOAT64_IEEE 0 Arizona_base_GOAT_CM_double -1.7E+308 1.7E+308 /end CHARACTERISTIC
/begin CHARACTERISTIC Arizona_base_GOAT_cal_impl.Setup1_P1 "" VALUE 0x0025B7C8 Scalar_FLOAT64_IEEE 0 Arizona_base_GOAT_CM_double -1.7E+308 1.7E+308 /end CHARACTERISTIC
/begin CHARACTERISTIC Arizona_base_GOAT_cal_impl.Setup1_P10 "" VALUE 0x0025B930 Scalar_FLOAT64_IEEE 0 Arizona_base_GOAT_CM_double -1.7E+308 1.7E+308 /end CHARACTERISTIC
/begin CHARACTERISTIC Arizona_base_GOAT_cal_impl.Setup1_P11 "" VALUE 0x0025B948 Scalar_FLOAT64_IEEE 0 Arizona_base_GOAT_CM_double -1.7E+308 1.7E+308 /end CHARACTERISTIC
/begin CHARACTERISTIC Arizona_base_GOAT_cal_impl.Setup1_P12 "" VAL_BLK 0x0025B960 Scalar_FLOAT64_IEEE 0 Arizona_base_GOAT_CM_double -1.7E+308 1.7E+308 MATRIX_DIM 4 1 /end CHARACTERISTIC
/begin CHARACTERISTIC Arizona_base_GOAT_cal_impl.Setup1_P13 "" VALUE 0x0025B990 Scalar_FLOAT64_IEEE 0 Arizona_base_GOAT_CM_double -1.7E+308 1.7E+308 /end CHARACTERISTIC
/begin CHARACTERISTIC Arizona_base_GOAT_cal_impl.Setup1_P14 "" VALUE 0x0025B9A8 Scalar_FLOAT64_IEEE 0 Arizona_base_GOAT_CM_double -1.7E+308 1.7E+308 /end CHARACTERISTIC
/begin CHARACTERISTIC Arizona_base_GOAT_cal_impl.Setup1_P15 "" VALUE 0x0025B9C0 Scalar_FLOAT64_IEEE 0 Arizona_base_GOAT_CM_double -1.7E+308 1.7E+308 /end CHARACTERISTIC
/begin CHARACTERISTIC Arizona_base_GOAT_cal_impl.Setup1_P16 "" VAL_BLK 0x0025B9D8 Scalar_FLOAT64_IEEE 0 Arizona_base_GOAT_CM_double -1.7E+308 1.7E+308 MATRIX_DIM 2 1 /end CHARACTERISTIC
/begin CHARACTERISTIC Arizona_base_GOAT_cal_impl.Setup1_P17 "" VAL_BLK 0x0025B9F8 Scalar_FLOAT64_IEEE 0 Arizona_base_GOAT_CM_double -1.7E+308 1.7E+308 MATRIX_DIM 4 1 /end CHARACTERISTIC
/begin CHARACTERISTIC Arizona_base_GOAT_cal_impl.Setup1_P18 "" VAL_BLK 0x0025BA28 Scalar_FLOAT64_IEEE 0 Arizona_base_GOAT_CM_double -1.7E+308 1.7E+308 MATRIX_DIM 4 1 /end CHARACTERISTIC
/begin CHARACTERISTIC Arizona_base_GOAT_cal_impl.Setup1_P19 "" VALUE 0x0025BA58 Scalar_FLOAT64_IEEE 0 Arizona_base_GOAT_CM_double -1.7E+308 1.7E+308 /end CHARACTERISTIC
/begin CHARACTERISTIC Arizona_base_GOAT_cal_impl.Setup1_P2 "" VALUE 0x0025B7E0 Scalar_FLOAT64_IEEE 0 Arizona_base_GOAT_CM_double -1.7E+308 1.7E+308 /end CHARACTERISTIC
/begin CHARACTERISTIC Arizona_base_GOAT_cal_impl.Setup1_P20 "" VALUE 0x0025BA70 Scalar_FLOAT64_IEEE 0 Arizona_base_GOAT_CM_double -1.7E+308 1.7E+308 /end CHARACTERISTIC
/begin CHARACTERISTIC Arizona_base_GOAT_cal_impl.Setup1_P21 "" VALUE 0x0025BA88 Scalar_FLOAT64_IEEE 0 Arizona_base_GOAT_CM_double -1.7E+308 1.7E+308 /end CHARACTERISTIC
/begin CHARACTERISTIC Arizona_base_GOAT_cal_impl.Setup1_P22 "" VAL_BLK 0x0025BAA0 Scalar_FLOAT64_IEEE 0 Arizona_base_GOAT_CM_double -1.7E+308 1.7E+308 MATRIX_DIM 4 1 /end CHARACTERISTIC
/begin CHARACTERISTIC Arizona_base_GOAT_cal_impl.Setup1_P23 "" VALUE 0x0025BAD0 Scalar_FLOAT64_IEEE 0 Arizona_base_GOAT_CM_double -1.7E+308 1.7E+308 /end CHARACTERISTIC
/begin CHARACTERISTIC Arizona_base_GOAT_cal_impl.Setup1_P24 "" VALUE 0x0025BAE8 Scalar_FLOAT64_IEEE 0 Arizona_base_GOAT_CM_double -1.7E+308 1.7E+308 /end CHARACTERISTIC
/begin CHARACTERISTIC Arizona_base_GOAT_cal_impl.Setup1_P25 "" VALUE 0x0025BB00 Scalar_FLOAT64_IEEE 0 Arizona_base_GOAT_CM_double -1.7E+308 1.7E+308 /end CHARACTERISTIC
/begin CHARACTERISTIC Arizona_base_GOAT_cal_impl.Setup1_P26 "" VALUE 0x0025BB18 Scalar_FLOAT64_IEEE 0 Arizona_base_GOAT_CM_double -1.7E+308 1.7E+308 /end CHARACTERISTIC
/begin CHARACTERISTIC Arizona_base_GOAT_cal_impl.Setup1_P27 "" VALUE 0x0025BB30 Scalar_FLOAT64_IEEE 0 Arizona_base_GOAT_CM_double -1.7E+308 1.7E+308 /end CHARACTERISTIC
/begin CHARACTERISTIC Arizona_base_GOAT_cal_impl.Setup1_P28 "" VALUE 0x0025BB48 Scalar_FLOAT64_IEEE 0 Arizona_base_GOAT_CM_double -1.7E+308 1.7E+308 /end CHARACTERISTIC
/begin CHARACTERISTIC Arizona_base_GOAT_cal_impl.Setup1_P29 "" VALUE 0x0025BB60 Scalar_FLOAT64_IEEE 0 Arizona_base_GOAT_CM_double -1.7E+308 1.7E+308 /end CHARACTERISTIC
/begin CHARACTERISTIC Arizona_base_GOAT_cal_impl.Setup1_P3 "" VALUE 0x0025B7F8 Scalar_FLOAT64_IEEE 0 Arizona_base_GOAT_CM_double -1.7E+308 1.7E+308 /end CHARACTERISTIC
/begin CHARACTERISTIC Arizona_base_GOAT_cal_impl.Setup1_P30 "" VALUE 0x0025BB78 Scalar_FLOAT64_IEEE 0 Arizona_base_GOAT_CM_double -1.7E+308 1.7E+308 /end CHARACTERISTIC
/begin CHARACTERISTIC Arizona_base_GOAT_cal_impl.Setup1_P31 "" VALUE 0x0025BB90 Scalar_FLOAT64_IEEE 0 Arizona_base_GOAT_CM_double -1.7E+308 1.7E+308 /end CHARACTERISTIC
/begin CHARACTERISTIC Arizona_base_GOAT_cal_impl.Setup1_P32 "" VALUE 0x0025BBA8 Scalar_FLOAT64_IEEE 0 Arizona_base_GOAT_CM_double -1.7E+308 1.7E+308 /end CHARACTERISTIC
/begin CHARACTERISTIC Arizona_base_GOAT_cal_impl.Setup1_P33 "" VAL_BLK 0x0025BBC0 Scalar_FLOAT64_IEEE 0 Arizona_base_GOAT_CM_double -1.7E+308 1.7E+308 MATRIX_DIM 3 1 /end CHARACTERISTIC
/begin CHARACTERISTIC Arizona_base_GOAT_cal_impl.Setup1_P34 "" VAL_BLK 0x0025BBE8 Scalar_FLOAT64_IEEE 0 Arizona_base_GOAT_CM_double -1.7E+308 1.7E+308 MATRIX_DIM 5 1 /end CHARACTERISTIC
/begin CHARACTERISTIC Arizona_base_GOAT_cal_impl.Setup1_P35 "" VALUE 0x0025BC20 Scalar_FLOAT64_IEEE 0 Arizona_base_GOAT_CM_double -1.7E+308 1.7E+308 /end CHARACTERISTIC
/begin CHARACTERISTIC Arizona_base_GOAT_cal_impl.Setup1_P36 "" VALUE 0x0025BC38 Scalar_FLOAT64_IEEE 0 Arizona_base_GOAT_CM_double -1.7E+308 1.7E+308 /end CHARACTERISTIC
/begin CHARACTERISTIC Arizona_base_GOAT_cal_impl.Setup1_P37 "" VALUE 0x0025BC50 Scalar_FLOAT64_IEEE 0 Arizona_base_GOAT_CM_double -1.7E+308 1.7E+308 /end CHARACTERISTIC
/begin CHARACTERISTIC Arizona_base_GOAT_cal_impl.Setup1_P4 "" VALUE 0x0025B810 Scalar_FLOAT64_IEEE 0 Arizona_base_GOAT_CM_double -1.7E+308 1.7E+308 /end CHARACTERISTIC
/begin CHARACTERISTIC Arizona_base_GOAT_cal_impl.Setup1_P5 "" VAL_BLK 0x0025B828 Scalar_FLOAT64_IEEE 0 Arizona_base_GOAT_CM_double -1.7E+308 1.7E+308 MATRIX_DIM 2 1 /end CHARACTERISTIC
/begin CHARACTERISTIC Arizona_base_GOAT_cal_impl.Setup1_P6 "" VAL_BLK 0x0025B848 Scalar_FLOAT64_IEEE 0 Arizona_base_GOAT_CM_double -1.7E+308 1.7E+308 MATRIX_DIM 2 1 /end CHARACTERISTIC
/begin CHARACTERISTIC Arizona_base_GOAT_cal_impl.Setup1_P7 "" VAL_BLK 0x0025B868 Scalar_FLOAT64_IEEE 0 Arizona_base_GOAT_CM_double -1.7E+308 1.7E+308 MATRIX_DIM 16 1 /end CHARACTERISTIC
/begin CHARACTERISTIC Arizona_base_GOAT_cal_impl.Setup1_P8 "" VAL_BLK 0x0025B8F8 Scalar_FLOAT64_IEEE 0 Arizona_base_GOAT_CM_double -1.7E+308 1.7E+308 MATRIX_DIM 2 1 /end CHARACTERISTIC
/begin CHARACTERISTIC Arizona_base_GOAT_cal_impl.Setup1_P9 "" VALUE 0x0025B918 Scalar_FLOAT64_IEEE 0 Arizona_base_GOAT_CM_double -1.7E+308 1.7E+308 /end CHARACTERISTIC
/begin CHARACTERISTIC Arizona_base_GOAT_cal_impl.Switch1_Threshold "" VALUE 0x0025C9C0 Scalar_FLOAT64_IEEE 0 Arizona_base_GOAT_CM_double -1.7E+308 1.7E+308 /end CHARACTERISTIC
/begin CHARACTERISTIC Arizona_base_GOAT_cal_impl.Switch1_Threshold_e "" VALUE 0x0025CAB0 Scalar_FLOAT64_IEEE 0 Arizona_base_GOAT_CM_double -1.7E+308 1.7E+308 /end CHARACTERISTIC
/begin CHARACTERISTIC Arizona_base_GOAT_cal_impl.Switch1_Threshold_m "" VALUE 0x0025CA38 Scalar_FLOAT64_IEEE 0 Arizona_base_GOAT_CM_double -1.7E+308 1.7E+308 /end CHARACTERISTIC
/begin CHARACTERISTIC Arizona_base_GOAT_cal_impl.Switch_Threshold "" VALUE 0x0023AA00 Scalar_FLOAT64_IEEE 0 Arizona_base_GOAT_CM_double -1.7E+308 1.7E+308 /end CHARACTERISTIC
/begin CHARACTERISTIC Arizona_base_GOAT_cal_impl.Switch_Threshold_b "" VALUE 0x0025D960 Scalar_FLOAT64_IEEE 0 Arizona_base_GOAT_CM_double -1.7E+308 1.7E+308 /end CHARACTERISTIC
/begin CHARACTERISTIC Arizona_base_GOAT_cal_impl.Switch_Threshold_l "" VALUE 0x0025D958 Scalar_FLOAT64_IEEE 0 Arizona_base_GOAT_CM_double -1.7E+308 1.7E+308 /end CHARACTERISTIC
/begin CHARACTERISTIC Arizona_base_GOAT_cal_impl.Switch_Threshold_o "" VALUE 0x0025D968 Scalar_FLOAT64_IEEE 0 Arizona_base_GOAT_CM_double -1.7E+308 1.7E+308 /end CHARACTERISTIC
/begin CHARACTERISTIC Arizona_base_GOAT_cal_impl.TSamp_WtEt "" VALUE 0x0025CA20 Scalar_FLOAT64_IEEE 0 Arizona_base_GOAT_CM_double -1.7E+308 1.7E+308 /end CHARACTERISTIC
/begin CHARACTERISTIC Arizona_base_GOAT_cal_impl.TSamp_WtEt_p "" VALUE 0x0025CA98 Scalar_FLOAT64_IEEE 0 Arizona_base_GOAT_CM_double -1.7E+308 1.7E+308 /end CHARACTERISTIC
/begin CHARACTERISTIC Arizona_base_GOAT_cal_impl.basefreq_Value "" VALUE 0x0025D990 Scalar_FLOAT64_IEEE 0 Arizona_base_GOAT_CM_double -1.7E+308 1.7E+308 /end CHARACTERISTIC
/begin CHARACTERISTIC Arizona_base_GOAT_cal_impl.basefreq_Value_i "" VALUE 0x0025D9D8 Scalar_FLOAT64_IEEE 0 Arizona_base_GOAT_CM_double -1.7E+308 1.7E+308 /end CHARACTERISTIC
/begin CHARACTERISTIC Arizona_base_GOAT_cal_impl.change_color_Y0 "" VALUE 0x0023AB58 Scalar_FLOAT64_IEEE 0 Arizona_base_GOAT_CM_double -1.7E+308 1.7E+308 /end CHARACTERISTIC
/begin CHARACTERISTIC Arizona_base_GOAT_cal_impl.dutycycleblockwave1_Value "" VALUE 0x0023AB20 Scalar_FLOAT64_IEEE 0 Arizona_base_GOAT_CM_double -1.7E+308 1.7E+308 /end CHARACTERISTIC
/begin CHARACTERISTIC Arizona_base_GOAT_cal_impl.dutycycleblockwave1_Value_k "" VALUE 0x0023AB28 Scalar_FLOAT64_IEEE 0 Arizona_base_GOAT_CM_double -1.7E+308 1.7E+308 /end CHARACTERISTIC
/begin CHARACTERISTIC Arizona_base_GOAT_cal_impl.dutycycleblockwave_Value "" VALUE 0x0025D980 Scalar_FLOAT64_IEEE 0 Arizona_base_GOAT_CM_double -1.7E+308 1.7E+308 /end CHARACTERISTIC
/begin CHARACTERISTIC Arizona_base_GOAT_cal_impl.dutycycleblockwave_Value_h "" VALUE 0x0025D9C8 Scalar_FLOAT64_IEEE 0 Arizona_base_GOAT_CM_double -1.7E+308 1.7E+308 /end CHARACTERISTIC
/begin CHARACTERISTIC Arizona_base_GOAT_cal_impl.homingDone_Y0 "" VALUE 0x0023A9F0 Scalar_FLOAT64_IEEE 0 Arizona_base_GOAT_CM_double -1.7E+308 1.7E+308 /end CHARACTERISTIC
/begin CHARACTERISTIC Arizona_base_GOAT_cal_impl.log_jogspeed_Gain "" VALUE 0x0025D970 Scalar_FLOAT64_IEEE 0 Arizona_base_GOAT_CM_double -1.7E+308 1.7E+308 /end CHARACTERISTIC
/begin CHARACTERISTIC Arizona_base_GOAT_cal_impl.log_penholder_active_InitialCon "" VALUE 0x0025C9A0 Scalar_FLOAT64_IEEE 0 Arizona_base_GOAT_CM_double -1.7E+308 1.7E+308 /end CHARACTERISTIC
/begin CHARACTERISTIC Arizona_base_GOAT_cal_impl.phiFF_Y0 "" VALUE 0x00222090 Scalar_FLOAT64_IEEE 0 Arizona_base_GOAT_CM_double -1.7E+308 1.7E+308 /end CHARACTERISTIC
/begin CHARACTERISTIC Arizona_base_GOAT_cal_impl.phiHome_Y0 "" VALUE 0x0023A9E8 Scalar_FLOAT64_IEEE 0 Arizona_base_GOAT_CM_double -1.7E+308 1.7E+308 /end CHARACTERISTIC
/begin CHARACTERISTIC Arizona_base_GOAT_cal_impl.phiRef_Y0 "" VALUE 0x0023AB50 Scalar_FLOAT64_IEEE 0 Arizona_base_GOAT_CM_double -1.7E+308 1.7E+308 /end CHARACTERISTIC
/begin CHARACTERISTIC Arizona_base_GOAT_cal_impl.set_cRef_Value "" CURVE 0x00242E78 FixLookup_FLOAT64_IEEE 0 Arizona_base_GOAT_CM_double -1.7E+308 1.7E+308
 /begin AXIS_DESCR FIX_AXIS NO_INPUT_QUANTITY Arizona_base_GOAT_CM_double 4194 0.000000 4193.000000 FIX_AXIS_PAR_DIST 0 1 4194 /end AXIS_DESCR
/end CHARACTERISTIC
/begin CHARACTERISTIC Arizona_base_GOAT_cal_impl.set_phiFF_Value "" CURVE 0x00222098 FixLookup_FLOAT64_IEEE 0 Arizona_base_GOAT_CM_double -1.7E+308 1.7E+308
 /begin AXIS_DESCR FIX_AXIS NO_INPUT_QUANTITY Arizona_base_GOAT_CM_double 4194 0.000000 4193.000000 FIX_AXIS_PAR_DIST 0 1 4194 /end AXIS_DESCR
/end CHARACTERISTIC
/begin CHARACTERISTIC Arizona_base_GOAT_cal_impl.set_phiRef_Value "" CURVE 0x0024B188 FixLookup_FLOAT64_IEEE 0 Arizona_base_GOAT_CM_double -1.7E+308 1.7E+308
 /begin AXIS_DESCR FIX_AXIS NO_INPUT_QUANTITY Arizona_base_GOAT_CM_double 4194 0.000000 4193.000000 FIX_AXIS_PAR_DIST 0 1 4194 /end AXIS_DESCR
/end CHARACTERISTIC
/begin CHARACTERISTIC Arizona_base_GOAT_cal_impl.set_xFF_Value "" CURVE 0x0022A3A8 FixLookup_FLOAT64_IEEE 0 Arizona_base_GOAT_CM_double -1.7E+308 1.7E+308
 /begin AXIS_DESCR FIX_AXIS NO_INPUT_QUANTITY Arizona_base_GOAT_CM_double 4194 0.000000 4193.000000 FIX_AXIS_PAR_DIST 0 1 4194 /end AXIS_DESCR
/end CHARACTERISTIC
/begin CHARACTERISTIC Arizona_base_GOAT_cal_impl.set_xRef_Value "" CURVE 0x00253498 FixLookup_FLOAT64_IEEE 0 Arizona_base_GOAT_CM_double -1.7E+308 1.7E+308
 /begin AXIS_DESCR FIX_AXIS NO_INPUT_QUANTITY Arizona_base_GOAT_CM_double 4194 0.000000 4193.000000 FIX_AXIS_PAR_DIST 0 1 4194 /end AXIS_DESCR
/end CHARACTERISTIC
/begin CHARACTERISTIC Arizona_base_GOAT_cal_impl.set_yFF_Value "" CURVE 0x002326B8 FixLookup_FLOAT64_IEEE 0 Arizona_base_GOAT_CM_double -1.7E+308 1.7E+308
 /begin AXIS_DESCR FIX_AXIS NO_INPUT_QUANTITY Arizona_base_GOAT_CM_double 4194 0.000000 4193.000000 FIX_AXIS_PAR_DIST 0 1 4194 /end AXIS_DESCR
/end CHARACTERISTIC
/begin CHARACTERISTIC Arizona_base_GOAT_cal_impl.set_yRef_Value "" CURVE 0x0023AB68 FixLookup_FLOAT64_IEEE 0 Arizona_base_GOAT_CM_double -1.7E+308 1.7E+308
 /begin AXIS_DESCR FIX_AXIS NO_INPUT_QUANTITY Arizona_base_GOAT_CM_double 4194 0.000000 4193.000000 FIX_AXIS_PAR_DIST 0 1 4194 /end AXIS_DESCR
/end CHARACTERISTIC
/begin CHARACTERISTIC Arizona_base_GOAT_cal_impl.startHoming_Value "" VALUE 0x0025D938 Scalar_FLOAT64_IEEE 0 Arizona_base_GOAT_CM_double -1.7E+308 1.7E+308 /end CHARACTERISTIC
/begin CHARACTERISTIC Arizona_base_GOAT_cal_impl.startPenholder_Value "" VALUE 0x0025D948 Scalar_FLOAT64_IEEE 0 Arizona_base_GOAT_CM_double -1.7E+308 1.7E+308 /end CHARACTERISTIC
/begin CHARACTERISTIC Arizona_base_GOAT_cal_impl.startTrial_Value "" VALUE 0x0025D940 Scalar_FLOAT64_IEEE 0 Arizona_base_GOAT_CM_double -1.7E+308 1.7E+308 /end CHARACTERISTIC
/begin CHARACTERISTIC Arizona_base_GOAT_cal_impl.time_Y0 "" VALUE 0x0023AB38 Scalar_FLOAT64_IEEE 0 Arizona_base_GOAT_CM_double -1.7E+308 1.7E+308 /end CHARACTERISTIC
/begin CHARACTERISTIC Arizona_base_GOAT_cal_impl.trialDone_Y0 "" VALUE 0x0025DA08 Scalar_BOOLEAN 0 Arizona_base_GOAT_CM_logical 0 1 /end CHARACTERISTIC
/begin CHARACTERISTIC Arizona_base_GOAT_cal_impl.xFF_Y0 "" VALUE 0x00222088 Scalar_FLOAT64_IEEE 0 Arizona_base_GOAT_CM_double -1.7E+308 1.7E+308 /end CHARACTERISTIC
/begin CHARACTERISTIC Arizona_base_GOAT_cal_impl.xHome_Y0 "" VALUE 0x0023A9E0 Scalar_FLOAT64_IEEE 0 Arizona_base_GOAT_CM_double -1.7E+308 1.7E+308 /end CHARACTERISTIC
/begin CHARACTERISTIC Arizona_base_GOAT_cal_impl.xRef_Y0 "" VALUE 0x0023AB48 Scalar_FLOAT64_IEEE 0 Arizona_base_GOAT_CM_double -1.7E+308 1.7E+308 /end CHARACTERISTIC
/begin CHARACTERISTIC Arizona_base_GOAT_cal_impl.yFF_Y0 "" VALUE 0x00222080 Scalar_FLOAT64_IEEE 0 Arizona_base_GOAT_CM_double -1.7E+308 1.7E+308 /end CHARACTERISTIC
/begin CHARACTERISTIC Arizona_base_GOAT_cal_impl.yHome_Y0 "" VALUE 0x0023A9D8 Scalar_FLOAT64_IEEE 0 Arizona_base_GOAT_CM_double -1.7E+308 1.7E+308 /end CHARACTERISTIC
/begin CHARACTERISTIC Arizona_base_GOAT_cal_impl.yRef_Y0 "" VALUE 0x0023AB40 Scalar_FLOAT64_IEEE 0 Arizona_base_GOAT_CM_double -1.7E+308 1.7E+308 /end CHARACTERISTIC
/begin CHARACTERISTIC RTE_Param_Service.N_Init "" VALUE 0x0025DA60 Scalar_FLOAT64_IEEE 0 Arizona_base_GOAT_CM_double -1.7E+308 1.7E+308 /end CHARACTERISTIC
/begin CHARACTERISTIC RTE_Param_Service.Nref "" VALUE 0x0025DA68 Scalar_FLOAT64_IEEE 0 Arizona_base_GOAT_CM_double -1.7E+308 1.7E+308 /end CHARACTERISTIC
/begin CHARACTERISTIC RTE_Param_Service.Ts "" VALUE 0x0025DA70 Scalar_FLOAT64_IEEE 0 Arizona_base_GOAT_CM_double -1.7E+308 1.7E+308 /end CHARACTERISTIC
/begin CHARACTERISTIC RTE_Param_Service.phi_Init "" CURVE 0x0025DA78 FixLookup_FLOAT64_IEEE 0 Arizona_base_GOAT_CM_double -1.7E+308 1.7E+308
 /begin AXIS_DESCR FIX_AXIS NO_INPUT_QUANTITY Arizona_base_GOAT_CM_double 1571 0.000000 1570.000000 FIX_AXIS_PAR_DIST 0 1 1571 /end AXIS_DESCR
/end CHARACTERISTIC
/begin CHARACTERISTIC RTE_Param_Service.x_Init "" CURVE 0x00260B90 FixLookup_FLOAT64_IEEE 0 Arizona_base_GOAT_CM_double -1.7E+308 1.7E+308
 /begin AXIS_DESCR FIX_AXIS NO_INPUT_QUANTITY Arizona_base_GOAT_CM_double 1807 0.000000 1806.000000 FIX_AXIS_PAR_DIST 0 1 1807 /end AXIS_DESCR
/end CHARACTERISTIC
/begin CHARACTERISTIC RTE_Param_Service.y_Init "" CURVE 0x00264408 FixLookup_FLOAT64_IEEE 0 Arizona_base_GOAT_CM_double -1.7E+308 1.7E+308
 /begin AXIS_DESCR FIX_AXIS NO_INPUT_QUANTITY Arizona_base_GOAT_CM_double 1571 0.000000 1570.000000 FIX_AXIS_PAR_DIST 0 1 1571 /end AXIS_DESCR
/end CHARACTERISTIC
/begin MEASUREMENT Arizona_base_GOAT_B.AIcarriagevelocitymonitor "" FLOAT64_IEEE Arizona_base_GOAT_CM_double 0 0 -1.7E+308 1.7E+308 ECU_ADDRESS 0x00277F90 /end MEASUREMENT
/begin MEASUREMENT Arizona_base_GOAT_B.Abs "" FLOAT64_IEEE Arizona_base_GOAT_CM_double 0 0 -1.7E+308 1.7E+308 ECU_ADDRESS 0x00278280 /end MEASUREMENT
/begin MEASUREMENT Arizona_base_GOAT_B.Abs1 "" FLOAT64_IEEE Arizona_base_GOAT_CM_double 0 0 -1.7E+308 1.7E+308 ECU_ADDRESS 0x00278298 /end MEASUREMENT
/begin MEASUREMENT Arizona_base_GOAT_B.Abs1_l "" FLOAT64_IEEE Arizona_base_GOAT_CM_double 0 0 -1.7E+308 1.7E+308 ECU_ADDRESS 0x002782F8 /end MEASUREMENT
/begin MEASUREMENT Arizona_base_GOAT_B.Abs1_m "" FLOAT64_IEEE Arizona_base_GOAT_CM_double 0 0 -1.7E+308 1.7E+308 ECU_ADDRESS 0x00278310 /end MEASUREMENT
/begin MEASUREMENT Arizona_base_GOAT_B.Abs_d "" FLOAT64_IEEE Arizona_base_GOAT_CM_double 0 0 -1.7E+308 1.7E+308 ECU_ADDRESS 0x00278288 /end MEASUREMENT
/begin MEASUREMENT Arizona_base_GOAT_B.Abs_dw "" FLOAT64_IEEE Arizona_base_GOAT_CM_double 0 0 -1.7E+308 1.7E+308 ECU_ADDRESS 0x00278300 /end MEASUREMENT
/begin MEASUREMENT Arizona_base_GOAT_B.AddphiHome "" FLOAT64_IEEE Arizona_base_GOAT_CM_double 0 0 -1.7E+308 1.7E+308 ECU_ADDRESS 0x00278488 /end MEASUREMENT
/begin MEASUREMENT Arizona_base_GOAT_B.AddxHome "" FLOAT64_IEEE Arizona_base_GOAT_CM_double 0 0 -1.7E+308 1.7E+308 ECU_ADDRESS 0x00278490 /end MEASUREMENT
/begin MEASUREMENT Arizona_base_GOAT_B.AddyHome "" FLOAT64_IEEE Arizona_base_GOAT_CM_double 0 0 -1.7E+308 1.7E+308 ECU_ADDRESS 0x00278498 /end MEASUREMENT
/begin MEASUREMENT Arizona_base_GOAT_B.Analoginput1_o2 "" FLOAT64_IEEE Arizona_base_GOAT_CM_double 0 0 -1.7E+308 1.7E+308 ECU_ADDRESS 0x00277F48 /end MEASUREMENT
/begin MEASUREMENT Arizona_base_GOAT_B.Calibration1 "" FLOAT64_IEEE Arizona_base_GOAT_CM_double 0 0 -1.7E+308 1.7E+308 ECU_ADDRESS 0x00277FA0 /end MEASUREMENT
/begin MEASUREMENT Arizona_base_GOAT_B.Calibration2 "" FLOAT64_IEEE Arizona_base_GOAT_CM_double 0 0 -1.7E+308 1.7E+308 ECU_ADDRESS 0x00277FB8 /end MEASUREMENT
/begin MEASUREMENT Arizona_base_GOAT_B.Calibration3 "" FLOAT64_IEEE Arizona_base_GOAT_CM_double 0 0 -1.7E+308 1.7E+308 ECU_ADDRESS 0x00277FD0 /end MEASUREMENT
/begin MEASUREMENT Arizona_base_GOAT_B.Calibration4 "" FLOAT64_IEEE Arizona_base_GOAT_CM_double 0 0 -1.7E+308 1.7E+308 ECU_ADDRESS 0x002781C0 /end MEASUREMENT
/begin MEASUREMENT Arizona_base_GOAT_B.Calibration5 "" FLOAT64_IEEE Arizona_base_GOAT_CM_double 0 0 -1.7E+308 1.7E+308 ECU_ADDRESS 0x002781D8 /end MEASUREMENT
/begin MEASUREMENT Arizona_base_GOAT_B.Calibration6 "" FLOAT64_IEEE Arizona_base_GOAT_CM_double 0 0 -1.7E+308 1.7E+308 ECU_ADDRESS 0x002781F0 /end MEASUREMENT
/begin MEASUREMENT Arizona_base_GOAT_B.Cariagesecundair "" FLOAT64_IEEE Arizona_base_GOAT_CM_double 0 0 -1.7E+308 1.7E+308 ECU_ADDRESS 0x002781B8 /end MEASUREMENT
/begin MEASUREMENT Arizona_base_GOAT_B.Carriageencoder "" FLOAT64_IEEE Arizona_base_GOAT_CM_double 0 0 -1.7E+308 1.7E+308 ECU_ADDRESS 0x00277F98 /end MEASUREMENT
/begin MEASUREMENT Arizona_base_GOAT_B.Compare "" UBYTE Arizona_base_GOAT_CM_logical 0 0 0 1 ECU_ADDRESS 0x00278501 /end MEASUREMENT
/begin MEASUREMENT Arizona_base_GOAT_B.Compare_b "" UBYTE Arizona_base_GOAT_CM_logical 0 0 0 1 ECU_ADDRESS 0x0027850A /end MEASUREMENT
/begin MEASUREMENT Arizona_base_GOAT_B.Compare_h "" UBYTE Arizona_base_GOAT_CM_logical 0 0 0 1 ECU_ADDRESS 0x00278506 /end MEASUREMENT
/begin MEASUREMENT Arizona_base_GOAT_B.Compare_h2 "" UBYTE Arizona_base_GOAT_CM_logical 0 0 0 1 ECU_ADDRESS 0x00278509 /end MEASUREMENT
/begin MEASUREMENT Arizona_base_GOAT_B.Compare_l "" UBYTE Arizona_base_GOAT_CM_logical 0 0 0 1 ECU_ADDRESS 0x00278504 /end MEASUREMENT
/begin MEASUREMENT Arizona_base_GOAT_B.Compare_p "" UBYTE Arizona_base_GOAT_CM_logical 0 0 0 1 ECU_ADDRESS 0x00278503 /end MEASUREMENT
/begin MEASUREMENT Arizona_base_GOAT_B.DIblacksoftwarebutton "" FLOAT64_IEEE Arizona_base_GOAT_CM_double 0 0 -1.7E+308 1.7E+308 ECU_ADDRESS 0x00277F68 /end MEASUREMENT
/begin MEASUREMENT Arizona_base_GOAT_B.DIblacksofwarefunctionbutton "" UBYTE Arizona_base_GOAT_CM_logical 0 0 0 1 ECU_ADDRESS 0x00278500 /end MEASUREMENT
/begin MEASUREMENT Arizona_base_GOAT_B.DIcarriageamplifyerstatus "" FLOAT64_IEEE Arizona_base_GOAT_CM_double 0 0 -1.7E+308 1.7E+308 ECU_ADDRESS 0x00277F70 /end MEASUREMENT
/begin MEASUREMENT Arizona_base_GOAT_B.DIcarriagelimitswitch "" FLOAT64_IEEE Arizona_base_GOAT_CM_double 0 0 -1.7E+308 1.7E+308 ECU_ADDRESS 0x00277F50 /end MEASUREMENT
/begin MEASUREMENT Arizona_base_GOAT_B.DIcarriagelimitswitchsecundaird "" FLOAT64_IEEE Arizona_base_GOAT_CM_double 0 0 -1.7E+308 1.7E+308 ECU_ADDRESS 0x00278200 /end MEASUREMENT
/begin MEASUREMENT Arizona_base_GOAT_B.DIgantryx1amplifyerstatus "" FLOAT64_IEEE Arizona_base_GOAT_CM_double 0 0 -1.7E+308 1.7E+308 ECU_ADDRESS 0x00277F78 /end MEASUREMENT
/begin MEASUREMENT Arizona_base_GOAT_B.DIgantryx1limitswitch "" FLOAT64_IEEE Arizona_base_GOAT_CM_double 0 0 -1.7E+308 1.7E+308 ECU_ADDRESS 0x00277F58 /end MEASUREMENT
/begin MEASUREMENT Arizona_base_GOAT_B.DIgantryx1limitswitchsecundaird "" FLOAT64_IEEE Arizona_base_GOAT_CM_double 0 0 -1.7E+308 1.7E+308 ECU_ADDRESS 0x00278208 /end MEASUREMENT
/begin MEASUREMENT Arizona_base_GOAT_B.DIgantryx2amplifyerstatus "" FLOAT64_IEEE Arizona_base_GOAT_CM_double 0 0 -1.7E+308 1.7E+308 ECU_ADDRESS 0x00277F80 /end MEASUREMENT
/begin MEASUREMENT Arizona_base_GOAT_B.DIgantryx2limitswitch "" FLOAT64_IEEE Arizona_base_GOAT_CM_double 0 0 -1.7E+308 1.7E+308 ECU_ADDRESS 0x00277F60 /end MEASUREMENT
/begin MEASUREMENT Arizona_base_GOAT_B.DIgantryx2limitswitchsecundaird "" FLOAT64_IEEE Arizona_base_GOAT_CM_double 0 0 -1.7E+308 1.7E+308 ECU_ADDRESS 0x00278210 /end MEASUREMENT
/begin MEASUREMENT Arizona_base_GOAT_B.DIredsoftwarefunctionbutton "" FLOAT64_IEEE Arizona_base_GOAT_CM_double 0 0 -1.7E+308 1.7E+308 ECU_ADDRESS 0x00277F88 /end MEASUREMENT
/begin MEASUREMENT Arizona_base_GOAT_B.DataTypeConversion "" UBYTE Arizona_base_GOAT_CM_logical 0 0 0 1 ECU_ADDRESS 0x00278502 /end MEASUREMENT
/begin MEASUREMENT Arizona_base_GOAT_B.DataTypeConversion1 "" FLOAT64_IEEE Arizona_base_GOAT_CM_double 0 0 -1.7E+308 1.7E+308 ECU_ADDRESS 0x00278260 /end MEASUREMENT
/begin MEASUREMENT Arizona_base_GOAT_B.DataTypeConversion1_n "" UBYTE Arizona_base_GOAT_CM_logical 0 0 0 1 ECU_ADDRESS 0x00278505 /end MEASUREMENT
/begin MEASUREMENT Arizona_base_GOAT_B.DataTypeConversion2 "" FLOAT64_IEEE Arizona_base_GOAT_CM_double 0 0 -1.7E+308 1.7E+308 ECU_ADDRESS 0x00278258 /end MEASUREMENT
/begin MEASUREMENT Arizona_base_GOAT_B.DataTypeConversion3 "" FLOAT64_IEEE Arizona_base_GOAT_CM_double 0 0 -1.7E+308 1.7E+308 ECU_ADDRESS 0x00278268 /end MEASUREMENT
/begin MEASUREMENT Arizona_base_GOAT_B.DataTypeConversionendtrial "" FLOAT64_IEEE Arizona_base_GOAT_CM_double 0 0 -1.7E+308 1.7E+308 ECU_ADDRESS 0x002784A0 /end MEASUREMENT
/begin MEASUREMENT Arizona_base_GOAT_B.Dct2lowpasscurrent_carriageAirb "" FLOAT64_IEEE Arizona_base_GOAT_CM_double 0 0 -1.7E+308 1.7E+308 ECU_ADDRESS 0x00278178 /end MEASUREMENT
/begin MEASUREMENT Arizona_base_GOAT_B.Dct2lowpasscurrent_gantryAirbag "" FLOAT64_IEEE Arizona_base_GOAT_CM_double 0 0 -1.7E+308 1.7E+308 ECU_ADDRESS 0x00278110 /end MEASUREMENT
/begin MEASUREMENT Arizona_base_GOAT_B.Dct2lowpassoutput_x "" FLOAT64_IEEE Arizona_base_GOAT_CM_double 0 0 -1.7E+308 1.7E+308 ECU_ADDRESS 0x002780A0 /end MEASUREMENT
/begin MEASUREMENT Arizona_base_GOAT_B.Dct2lowpassoutput_y "" FLOAT64_IEEE Arizona_base_GOAT_CM_double 0 0 -1.7E+308 1.7E+308 ECU_ADDRESS 0x00278038 /end MEASUREMENT
/begin MEASUREMENT Arizona_base_GOAT_B.Delay "" FLOAT64_IEEE Arizona_base_GOAT_CM_double 0 0 -1.7E+308 1.7E+308 ECU_ADDRESS 0x00278000 /end MEASUREMENT
/begin MEASUREMENT Arizona_base_GOAT_B.Delay1 "" FLOAT64_IEEE Arizona_base_GOAT_CM_double 0 0 -1.7E+308 1.7E+308 ECU_ADDRESS 0x00277FF8 /end MEASUREMENT
/begin MEASUREMENT Arizona_base_GOAT_B.Delay1_b "" FLOAT64_IEEE Arizona_base_GOAT_CM_double 0 0 -1.7E+308 1.7E+308 ECU_ADDRESS 0x002780C0 /end MEASUREMENT
/begin MEASUREMENT Arizona_base_GOAT_B.Delay1_g "" FLOAT64_IEEE Arizona_base_GOAT_CM_double 0 0 -1.7E+308 1.7E+308 ECU_ADDRESS 0x00278058 /end MEASUREMENT
/begin MEASUREMENT Arizona_base_GOAT_B.Delay2 "" FLOAT64_IEEE Arizona_base_GOAT_CM_double 0 0 -1.7E+308 1.7E+308 ECU_ADDRESS 0x00277FF0 /end MEASUREMENT
/begin MEASUREMENT Arizona_base_GOAT_B.Delay_c "" UBYTE Arizona_base_GOAT_CM_logical 0 0 0 1 ECU_ADDRESS 0x00278507 /end MEASUREMENT
/begin MEASUREMENT Arizona_base_GOAT_B.Delay_j "" FLOAT64_IEEE Arizona_base_GOAT_CM_double 0 0 -1.7E+308 1.7E+308 ECU_ADDRESS 0x002780D0 /end MEASUREMENT
/begin MEASUREMENT Arizona_base_GOAT_B.Delay_l "" FLOAT64_IEEE Arizona_base_GOAT_CM_double 0 0 -1.7E+308 1.7E+308 ECU_ADDRESS 0x00278418 /end MEASUREMENT
/begin MEASUREMENT Arizona_base_GOAT_B.Delay_m "" FLOAT64_IEEE Arizona_base_GOAT_CM_double 0 0 -1.7E+308 1.7E+308 ECU_ADDRESS 0x00278060 /end MEASUREMENT
/begin MEASUREMENT Arizona_base_GOAT_B.Diff "" FLOAT64_IEEE Arizona_base_GOAT_CM_double 0 0 -1.7E+308 1.7E+308 ECU_ADDRESS 0x00278050 /end MEASUREMENT
/begin MEASUREMENT Arizona_base_GOAT_B.Diff_n "" FLOAT64_IEEE Arizona_base_GOAT_CM_double 0 0 -1.7E+308 1.7E+308 ECU_ADDRESS 0x002780B8 /end MEASUREMENT
/begin MEASUREMENT Arizona_base_GOAT_B.DirectLookupTablechange_color "" FLOAT64_IEEE Arizona_base_GOAT_CM_double 0 0 -1.7E+308 1.7E+308 ECU_ADDRESS 0x002783A8 /end MEASUREMENT
/begin MEASUREMENT Arizona_base_GOAT_B.DirectLookupTablephiFF "" FLOAT64_IEEE Arizona_base_GOAT_CM_double 0 0 -1.7E+308 1.7E+308 ECU_ADDRESS 0x00278448 /end MEASUREMENT
/begin MEASUREMENT Arizona_base_GOAT_B.DirectLookupTablephiRef "" FLOAT64_IEEE Arizona_base_GOAT_CM_double 0 0 -1.7E+308 1.7E+308 ECU_ADDRESS 0x002783B0 /end MEASUREMENT
/begin MEASUREMENT Arizona_base_GOAT_B.DirectLookupTablexFF "" FLOAT64_IEEE Arizona_base_GOAT_CM_double 0 0 -1.7E+308 1.7E+308 ECU_ADDRESS 0x00278440 /end MEASUREMENT
/begin MEASUREMENT Arizona_base_GOAT_B.DirectLookupTablexRef "" FLOAT64_IEEE Arizona_base_GOAT_CM_double 0 0 -1.7E+308 1.7E+308 ECU_ADDRESS 0x002783B8 /end MEASUREMENT
/begin MEASUREMENT Arizona_base_GOAT_B.DirectLookupTableyFF "" FLOAT64_IEEE Arizona_base_GOAT_CM_double 0 0 -1.7E+308 1.7E+308 ECU_ADDRESS 0x00278438 /end MEASUREMENT
/begin MEASUREMENT Arizona_base_GOAT_B.DiscreteTimeIntegratorx1JogSpee "" FLOAT64_IEEE Arizona_base_GOAT_CM_double 0 0 -1.7E+308 1.7E+308 ECU_ADDRESS 0x00278460 /end MEASUREMENT
/begin MEASUREMENT Arizona_base_GOAT_B.DiscreteTimeIntegratorx2JogSpee "" FLOAT64_IEEE Arizona_base_GOAT_CM_double 0 0 -1.7E+308 1.7E+308 ECU_ADDRESS 0x00278458 /end MEASUREMENT
/begin MEASUREMENT Arizona_base_GOAT_B.Divide "" FLOAT64_IEEE Arizona_base_GOAT_CM_double 0 0 -1.7E+308 1.7E+308 ECU_ADDRESS 0x002782A8 /end MEASUREMENT
/begin MEASUREMENT Arizona_base_GOAT_B.Divide1 "" FLOAT64_IEEE Arizona_base_GOAT_CM_double 0 0 -1.7E+308 1.7E+308 ECU_ADDRESS 0x002782C0 /end MEASUREMENT
/begin MEASUREMENT Arizona_base_GOAT_B.Divide1_c "" FLOAT64_IEEE Arizona_base_GOAT_CM_double 0 0 -1.7E+308 1.7E+308 ECU_ADDRESS 0x00278338 /end MEASUREMENT
/begin MEASUREMENT Arizona_base_GOAT_B.Divide2 "" FLOAT64_IEEE Arizona_base_GOAT_CM_double 0 0 -1.7E+308 1.7E+308 ECU_ADDRESS 0x002782C8 /end MEASUREMENT
/begin MEASUREMENT Arizona_base_GOAT_B.Divide2_c "" FLOAT64_IEEE Arizona_base_GOAT_CM_double 0 0 -1.7E+308 1.7E+308 ECU_ADDRESS 0x00278340 /end MEASUREMENT
/begin MEASUREMENT Arizona_base_GOAT_B.Divide3 "" FLOAT64_IEEE Arizona_base_GOAT_CM_double 0 0 -1.7E+308 1.7E+308 ECU_ADDRESS 0x002782D0 /end MEASUREMENT
/begin MEASUREMENT Arizona_base_GOAT_B.Divide3_g "" FLOAT64_IEEE Arizona_base_GOAT_CM_double 0 0 -1.7E+308 1.7E+308 ECU_ADDRESS 0x00278348 /end MEASUREMENT
/begin MEASUREMENT Arizona_base_GOAT_B.Divide_b "" FLOAT64_IEEE Arizona_base_GOAT_CM_double 0 0 -1.7E+308 1.7E+308 ECU_ADDRESS 0x00278320 /end MEASUREMENT
/begin MEASUREMENT Arizona_base_GOAT_B.Gain "" FLOAT64_IEEE Arizona_base_GOAT_CM_double 0 0 -1.7E+308 1.7E+308 ECU_ADDRESS 0x002782B0 /end MEASUREMENT
/begin MEASUREMENT Arizona_base_GOAT_B.Gain1 "" FLOAT64_IEEE Arizona_base_GOAT_CM_double 0 0 -1.7E+308 1.7E+308 ECU_ADDRESS 0x00278290 /end MEASUREMENT
/begin MEASUREMENT Arizona_base_GOAT_B.Gain1_d "" FLOAT64_IEEE Arizona_base_GOAT_CM_double 0 0 -1.7E+308 1.7E+308 ECU_ADDRESS 0x00278308 /end MEASUREMENT
/begin MEASUREMENT Arizona_base_GOAT_B.Gain8 "" FLOAT64_IEEE Arizona_base_GOAT_CM_double 0 0 -1.7E+308 1.7E+308 ECU_ADDRESS 0x002782D8 /end MEASUREMENT
/begin MEASUREMENT Arizona_base_GOAT_B.Gain8_o "" FLOAT64_IEEE Arizona_base_GOAT_CM_double 0 0 -1.7E+308 1.7E+308 ECU_ADDRESS 0x00278350 /end MEASUREMENT
/begin MEASUREMENT Arizona_base_GOAT_B.Gain_b "" FLOAT64_IEEE Arizona_base_GOAT_CM_double 0 0 -1.7E+308 1.7E+308 ECU_ADDRESS 0x00278328 /end MEASUREMENT
/begin MEASUREMENT Arizona_base_GOAT_B.Gainonphi2 "" FLOAT64_IEEE Arizona_base_GOAT_CM_double 0 0 -1.7E+308 1.7E+308 ECU_ADDRESS 0x00278278 /end MEASUREMENT
/begin MEASUREMENT Arizona_base_GOAT_B.Gainonphi3 "" FLOAT64_IEEE Arizona_base_GOAT_CM_double 0 0 -1.7E+308 1.7E+308 ECU_ADDRESS 0x002782F0 /end MEASUREMENT
/begin MEASUREMENT Arizona_base_GOAT_B.Gainonu_phi "" FLOAT64_IEEE Arizona_base_GOAT_CM_double 0 0 -1.7E+308 1.7E+308 ECU_ADDRESS 0x00278140 /end MEASUREMENT
/begin MEASUREMENT Arizona_base_GOAT_B.Gainonu_x "" FLOAT64_IEEE Arizona_base_GOAT_CM_double 0 0 -1.7E+308 1.7E+308 ECU_ADDRESS 0x00278128 /end MEASUREMENT
/begin MEASUREMENT Arizona_base_GOAT_B.Gainphi "" FLOAT64_IEEE Arizona_base_GOAT_CM_double 0 0 -1.7E+308 1.7E+308 ECU_ADDRESS 0x002780F0 /end MEASUREMENT
/begin MEASUREMENT Arizona_base_GOAT_B.Gainx "" FLOAT64_IEEE Arizona_base_GOAT_CM_double 0 0 -1.7E+308 1.7E+308 ECU_ADDRESS 0x00278080 /end MEASUREMENT
/begin MEASUREMENT Arizona_base_GOAT_B.GantryX1secundair "" FLOAT64_IEEE Arizona_base_GOAT_CM_double 0 0 -1.7E+308 1.7E+308 ECU_ADDRESS 0x002781D0 /end MEASUREMENT
/begin MEASUREMENT Arizona_base_GOAT_B.Gantryx1GantryxR "" FLOAT64_IEEE Arizona_base_GOAT_CM_double 0 0 -1.7E+308 1.7E+308 ECU_ADDRESS 0x00277FB0 /end MEASUREMENT
/begin MEASUREMENT Arizona_base_GOAT_B.Gantryx2GantryxL "" FLOAT64_IEEE Arizona_base_GOAT_CM_double 0 0 -1.7E+308 1.7E+308 ECU_ADDRESS 0x00277FC8 /end MEASUREMENT
/begin MEASUREMENT Arizona_base_GOAT_B.GentryX2secundair "" FLOAT64_IEEE Arizona_base_GOAT_CM_double 0 0 -1.7E+308 1.7E+308 ECU_ADDRESS 0x002781E8 /end MEASUREMENT
/begin MEASUREMENT Arizona_base_GOAT_B.Internal "" FLOAT64_IEEE Arizona_base_GOAT_CM_double 0 0 -1.7E+308 1.7E+308 ECU_ADDRESS 0x00278118 /end MEASUREMENT
/begin MEASUREMENT Arizona_base_GOAT_B.Internal_g "" FLOAT64_IEEE Arizona_base_GOAT_CM_double 0 0 -1.7E+308 1.7E+308 ECU_ADDRESS 0x00278180 /end MEASUREMENT
/begin MEASUREMENT Arizona_base_GOAT_B.Internal_j "" FLOAT64_IEEE Arizona_base_GOAT_CM_double 0 0 -1.7E+308 1.7E+308 ECU_ADDRESS 0x00278130 /end MEASUREMENT
/begin MEASUREMENT Arizona_base_GOAT_B.LogicalOperator "" UBYTE Arizona_base_GOAT_CM_logical 0 0 0 1 ECU_ADDRESS 0x00278508 /end MEASUREMENT
/begin MEASUREMENT Arizona_base_GOAT_B.Memory "" FLOAT64_IEEE Arizona_base_GOAT_CM_double 0 0 -1.7E+308 1.7E+308 ECU_ADDRESS 0x002783C0 /end MEASUREMENT
/begin MEASUREMENT Arizona_base_GOAT_B.Memory_loop_phi "" FLOAT64_IEEE Arizona_base_GOAT_CM_double 0 0 -1.7E+308 1.7E+308 ECU_ADDRESS 0x00278238 /end MEASUREMENT
/begin MEASUREMENT Arizona_base_GOAT_B.Memory_loop_x "" FLOAT64_IEEE Arizona_base_GOAT_CM_double 0 0 -1.7E+308 1.7E+308 ECU_ADDRESS 0x00278240 /end MEASUREMENT
/begin MEASUREMENT Arizona_base_GOAT_B.Memory_loop_y "" FLOAT64_IEEE Arizona_base_GOAT_CM_double 0 0 -1.7E+308 1.7E+308 ECU_ADDRESS 0x00278248 /end MEASUREMENT
/begin MEASUREMENT Arizona_base_GOAT_B.PenColor "" FLOAT64_IEEE Arizona_base_GOAT_CM_double 0 0 -1.7E+308 1.7E+308 ECU_ADDRESS 0x00278230 /end MEASUREMENT
/begin MEASUREMENT Arizona_base_GOAT_B.Product "" FLOAT64_IEEE Arizona_base_GOAT_CM_double 0 0 -1.7E+308 1.7E+308 ECU_ADDRESS 0x00278388 /end MEASUREMENT
/begin MEASUREMENT Arizona_base_GOAT_B.Sign2 "" FLOAT64_IEEE Arizona_base_GOAT_CM_double 0 0 -1.7E+308 1.7E+308 ECU_ADDRESS 0x002782E0 /end MEASUREMENT
/begin MEASUREMENT Arizona_base_GOAT_B.Sign2_g "" FLOAT64_IEEE Arizona_base_GOAT_CM_double 0 0 -1.7E+308 1.7E+308 ECU_ADDRESS 0x00278358 /end MEASUREMENT
/begin MEASUREMENT Arizona_base_GOAT_B.Subtract "" FLOAT64_IEEE Arizona_base_GOAT_CM_double 0 0 -1.7E+308 1.7E+308 ECU_ADDRESS 0x002782B8 /end MEASUREMENT
/begin MEASUREMENT Arizona_base_GOAT_B.Subtract_g "" FLOAT64_IEEE Arizona_base_GOAT_CM_double 0 0 -1.7E+308 1.7E+308 ECU_ADDRESS 0x00278330 /end MEASUREMENT
/begin MEASUREMENT Arizona_base_GOAT_B.Sum "" FLOAT64_IEEE Arizona_base_GOAT_CM_double 0 0 -1.7E+308 1.7E+308 ECU_ADDRESS 0x00278390 /end MEASUREMENT
/begin MEASUREMENT Arizona_base_GOAT_B.Sum_b "" FLOAT64_IEEE Arizona_base_GOAT_CM_double 0 0 -1.7E+308 1.7E+308 ECU_ADDRESS 0x00278428 /end MEASUREMENT
/begin MEASUREMENT Arizona_base_GOAT_B.Sum_k "" FLOAT64_IEEE Arizona_base_GOAT_CM_double 0 0 -1.7E+308 1.7E+308 ECU_ADDRESS 0x00278410 /end MEASUREMENT
/begin MEASUREMENT Arizona_base_GOAT_B.Sum_o "" FLOAT64_IEEE Arizona_base_GOAT_CM_double 0 0 -1.7E+308 1.7E+308 ECU_ADDRESS 0x00278408 /end MEASUREMENT
/begin MEASUREMENT Arizona_base_GOAT_B.Sumcurrentx_L "" FLOAT64_IEEE Arizona_base_GOAT_CM_double 0 0 -1.7E+308 1.7E+308 ECU_ADDRESS 0x00278160 /end MEASUREMENT
/begin MEASUREMENT Arizona_base_GOAT_B.Sumcurrentx_R "" FLOAT64_IEEE Arizona_base_GOAT_CM_double 0 0 -1.7E+308 1.7E+308 ECU_ADDRESS 0x00278148 /end MEASUREMENT
/begin MEASUREMENT Arizona_base_GOAT_B.Sumx_Lx_R "" FLOAT64_IEEE Arizona_base_GOAT_CM_double 0 0 -1.7E+308 1.7E+308 ECU_ADDRESS 0x00278078 /end MEASUREMENT
/begin MEASUREMENT Arizona_base_GOAT_B.Sumx_Rx_L "" FLOAT64_IEEE Arizona_base_GOAT_CM_double 0 0 -1.7E+308 1.7E+308 ECU_ADDRESS 0x002780E8 /end MEASUREMENT
/begin MEASUREMENT Arizona_base_GOAT_B.Switch "" FLOAT64_IEEE Arizona_base_GOAT_CM_double 0 0 -1.7E+308 1.7E+308 ECU_ADDRESS 0x002782A0 /end MEASUREMENT
/begin MEASUREMENT Arizona_base_GOAT_B.Switch1 "" FLOAT64_IEEE Arizona_base_GOAT_CM_double 0 0 -1.7E+308 1.7E+308 ECU_ADDRESS 0x00278008 /end MEASUREMENT
/begin MEASUREMENT Arizona_base_GOAT_B.Switch1_c "" FLOAT64_IEEE Arizona_base_GOAT_CM_double 0 0 -1.7E+308 1.7E+308 ECU_ADDRESS 0x002780D8 /end MEASUREMENT
/begin MEASUREMENT Arizona_base_GOAT_B.Switch1_h "" FLOAT64_IEEE Arizona_base_GOAT_CM_double 0 0 -1.7E+308 1.7E+308 ECU_ADDRESS 0x00278068 /end MEASUREMENT
/begin MEASUREMENT Arizona_base_GOAT_B.Switch1_hm "" FLOAT64_IEEE Arizona_base_GOAT_CM_double 0 0 -1.7E+308 1.7E+308 ECU_ADDRESS 0x00278250 /end MEASUREMENT
/begin MEASUREMENT Arizona_base_GOAT_B.Switch_b "" FLOAT64_IEEE Arizona_base_GOAT_CM_double 0 0 -1.7E+308 1.7E+308 ECU_ADDRESS 0x002783C8 /end MEASUREMENT
/begin MEASUREMENT Arizona_base_GOAT_B.Switch_bb "" FLOAT64_IEEE Arizona_base_GOAT_CM_double 0 0 -1.7E+308 1.7E+308 ECU_ADDRESS 0x00278420 /end MEASUREMENT
/begin MEASUREMENT Arizona_base_GOAT_B.Switch_i "" FLOAT64_IEEE Arizona_base_GOAT_CM_double 0 0 -1.7E+308 1.7E+308 ECU_ADDRESS 0x00278318 /end MEASUREMENT
/begin MEASUREMENT Arizona_base_GOAT_B.TSamp "" FLOAT64_IEEE Arizona_base_GOAT_CM_double 0 0 -1.7E+308 1.7E+308 ECU_ADDRESS 0x00278040 /end MEASUREMENT
/begin MEASUREMENT Arizona_base_GOAT_B.TSamp_n "" FLOAT64_IEEE Arizona_base_GOAT_CM_double 0 0 -1.7E+308 1.7E+308 ECU_ADDRESS 0x002780A8 /end MEASUREMENT
/begin MEASUREMENT Arizona_base_GOAT_B.Uk1 "" FLOAT64_IEEE Arizona_base_GOAT_CM_double 0 0 -1.7E+308 1.7E+308 ECU_ADDRESS 0x00278048 /end MEASUREMENT
/begin MEASUREMENT Arizona_base_GOAT_B.Uk1_o "" FLOAT64_IEEE Arizona_base_GOAT_CM_double 0 0 -1.7E+308 1.7E+308 ECU_ADDRESS 0x002780B0 /end MEASUREMENT
/begin MEASUREMENT Arizona_base_GOAT_B.XtranMo_DIR "" FLOAT64_IEEE Arizona_base_GOAT_CM_double 0 0 -1.7E+308 1.7E+308 ECU_ADDRESS 0x002782E8 /end MEASUREMENT
/begin MEASUREMENT Arizona_base_GOAT_B.XtranMo_DIR_k "" FLOAT64_IEEE Arizona_base_GOAT_CM_double 0 0 -1.7E+308 1.7E+308 ECU_ADDRESS 0x00278360 /end MEASUREMENT
/begin MEASUREMENT Arizona_base_GOAT_B.active "" FLOAT64_IEEE Arizona_base_GOAT_CM_double 0 0 -1.7E+308 1.7E+308 ECU_ADDRESS 0x00278400 /end MEASUREMENT
/begin MEASUREMENT Arizona_base_GOAT_B.analogvelin "" FLOAT64_IEEE Arizona_base_GOAT_CM_double 0 0 -1.7E+308 1.7E+308 ECU_ADDRESS 0x00277F40 /end MEASUREMENT
/begin MEASUREMENT Arizona_base_GOAT_B.carriageamplifierenable "" FLOAT64_IEEE Arizona_base_GOAT_CM_double 0 0 -1.7E+308 1.7E+308 ECU_ADDRESS 0x002781A0 /end MEASUREMENT
/begin MEASUREMENT Arizona_base_GOAT_B.carriagemotorvoltage "" FLOAT64_IEEE Arizona_base_GOAT_CM_double 0 0 -1.7E+308 1.7E+308 ECU_ADDRESS 0x00278190 /end MEASUREMENT
/begin MEASUREMENT Arizona_base_GOAT_B.carriagemotorvoltage_o "" FLOAT64_IEEE Arizona_base_GOAT_CM_double 0 0 -1.7E+308 1.7E+308 ECU_ADDRESS 0x00278198 /end MEASUREMENT
/begin MEASUREMENT Arizona_base_GOAT_B.change_color "" FLOAT64_IEEE Arizona_base_GOAT_CM_double 0 0 -1.7E+308 1.7E+308 ECU_ADDRESS 0x00278380 /end MEASUREMENT
/begin MEASUREMENT Arizona_base_GOAT_B.change_color_j "" FLOAT64_IEEE Arizona_base_GOAT_CM_double 0 0 -1.7E+308 1.7E+308 ECU_ADDRESS 0x002784E0 /end MEASUREMENT
/begin MEASUREMENT Arizona_base_GOAT_B.current_carriageAirbag "" FLOAT64_IEEE Arizona_base_GOAT_CM_double 0 0 -1.7E+308 1.7E+308 ECU_ADDRESS 0x002783D0 /end MEASUREMENT
/begin MEASUREMENT Arizona_base_GOAT_B.current_gantryAirbag "" FLOAT64_IEEE Arizona_base_GOAT_CM_double 0 0 -1.7E+308 1.7E+308 ECU_ADDRESS 0x002783E0 /end MEASUREMENT
/begin MEASUREMENT Arizona_base_GOAT_B.current_x3 "" FLOAT64_IEEE Arizona_base_GOAT_CM_double 0 0 -1.7E+308 1.7E+308 ECU_ADDRESS 0x00278478 /end MEASUREMENT
/begin MEASUREMENT Arizona_base_GOAT_B.current_x4 "" FLOAT64_IEEE Arizona_base_GOAT_CM_double 0 0 -1.7E+308 1.7E+308 ECU_ADDRESS 0x00278468 /end MEASUREMENT
/begin MEASUREMENT Arizona_base_GOAT_B.e_phirad "" FLOAT64_IEEE Arizona_base_GOAT_CM_double 0 0 -1.7E+308 1.7E+308 ECU_ADDRESS 0x00278100 /end MEASUREMENT
/begin MEASUREMENT Arizona_base_GOAT_B.e_xm "" FLOAT64_IEEE Arizona_base_GOAT_CM_double 0 0 -1.7E+308 1.7E+308 ECU_ADDRESS 0x00278090 /end MEASUREMENT
/begin MEASUREMENT Arizona_base_GOAT_B.e_ym "" FLOAT64_IEEE Arizona_base_GOAT_CM_double 0 0 -1.7E+308 1.7E+308 ECU_ADDRESS 0x00278028 /end MEASUREMENT
/begin MEASUREMENT Arizona_base_GOAT_B.enableAirbags "" FLOAT64_IEEE Arizona_base_GOAT_CM_double 0 0 -1.7E+308 1.7E+308 ECU_ADDRESS 0x002783D8 /end MEASUREMENT
/begin MEASUREMENT Arizona_base_GOAT_B.encodercarriage "" FLOAT64_IEEE Arizona_base_GOAT_CM_double 0 0 -1.7E+308 1.7E+308 ECU_ADDRESS 0x00277FA8 /end MEASUREMENT
/begin MEASUREMENT Arizona_base_GOAT_B.encodergantryx1 "" FLOAT64_IEEE Arizona_base_GOAT_CM_double 0 0 -1.7E+308 1.7E+308 ECU_ADDRESS 0x00277FC0 /end MEASUREMENT
/begin MEASUREMENT Arizona_base_GOAT_B.encodergantryx2 "" FLOAT64_IEEE Arizona_base_GOAT_CM_double 0 0 -1.7E+308 1.7E+308 ECU_ADDRESS 0x00277FD8 /end MEASUREMENT
/begin MEASUREMENT Arizona_base_GOAT_B.errorphi "" FLOAT64_IEEE Arizona_base_GOAT_CM_double 0 0 -1.7E+308 1.7E+308 ECU_ADDRESS 0x002780F8 /end MEASUREMENT
/begin MEASUREMENT Arizona_base_GOAT_B.errorx "" FLOAT64_IEEE Arizona_base_GOAT_CM_double 0 0 -1.7E+308 1.7E+308 ECU_ADDRESS 0x00278088 /end MEASUREMENT
/begin MEASUREMENT Arizona_base_GOAT_B.errory "" FLOAT64_IEEE Arizona_base_GOAT_CM_double 0 0 -1.7E+308 1.7E+308 ECU_ADDRESS 0x00278020 /end MEASUREMENT
/begin MEASUREMENT Arizona_base_GOAT_B.f_phi "" FLOAT64_IEEE Arizona_base_GOAT_CM_double 0 0 -1.7E+308 1.7E+308 ECU_ADDRESS 0x002784E8 /end MEASUREMENT
/begin MEASUREMENT Arizona_base_GOAT_B.f_x "" FLOAT64_IEEE Arizona_base_GOAT_CM_double 0 0 -1.7E+308 1.7E+308 ECU_ADDRESS 0x002784F0 /end MEASUREMENT
/begin MEASUREMENT Arizona_base_GOAT_B.f_y "" FLOAT64_IEEE Arizona_base_GOAT_CM_double 0 0 -1.7E+308 1.7E+308 ECU_ADDRESS 0x002784F8 /end MEASUREMENT
/begin MEASUREMENT Arizona_base_GOAT_B.gantryx1motorvoltage "" FLOAT64_IEEE Arizona_base_GOAT_CM_double 0 0 -1.7E+308 1.7E+308 ECU_ADDRESS 0x00278158 /end MEASUREMENT
/begin MEASUREMENT Arizona_base_GOAT_B.gantryx2motorvoltage "" FLOAT64_IEEE Arizona_base_GOAT_CM_double 0 0 -1.7E+308 1.7E+308 ECU_ADDRESS 0x00278170 /end MEASUREMENT
/begin MEASUREMENT Arizona_base_GOAT_B.gantryx_Lamplifierenable "" FLOAT64_IEEE Arizona_base_GOAT_CM_double 0 0 -1.7E+308 1.7E+308 ECU_ADDRESS 0x002781B0 /end MEASUREMENT
/begin MEASUREMENT Arizona_base_GOAT_B.gantryx_Lmotorvoltage "" FLOAT64_IEEE Arizona_base_GOAT_CM_double 0 0 -1.7E+308 1.7E+308 ECU_ADDRESS 0x00278168 /end MEASUREMENT
/begin MEASUREMENT Arizona_base_GOAT_B.gantryx_Ramplifierenable "" FLOAT64_IEEE Arizona_base_GOAT_CM_double 0 0 -1.7E+308 1.7E+308 ECU_ADDRESS 0x002781A8 /end MEASUREMENT
/begin MEASUREMENT Arizona_base_GOAT_B.gantryx_Rmotorvoltage "" FLOAT64_IEEE Arizona_base_GOAT_CM_double 0 0 -1.7E+308 1.7E+308 ECU_ADDRESS 0x00278150 /end MEASUREMENT
/begin MEASUREMENT Arizona_base_GOAT_B.homeTrigger "" FLOAT64_IEEE Arizona_base_GOAT_CM_double 0 0 -1.7E+308 1.7E+308 ECU_ADDRESS 0x00278368 /end MEASUREMENT
/begin MEASUREMENT Arizona_base_GOAT_B.home_time "" FLOAT64_IEEE Arizona_base_GOAT_CM_double 0 0 -1.7E+308 1.7E+308 ECU_ADDRESS 0x00278430 /end MEASUREMENT
/begin MEASUREMENT Arizona_base_GOAT_B.jogSpeed "" FLOAT64_IEEE Arizona_base_GOAT_CM_double 0 0 -1.7E+308 1.7E+308 ECU_ADDRESS 0x00278270 /end MEASUREMENT
/begin MEASUREMENT Arizona_base_GOAT_B.jogdistance_phi_reset "" FLOAT64_IEEE Arizona_base_GOAT_CM_double 0 0 -1.7E+308 1.7E+308 ECU_ADDRESS 0x00278480 /end MEASUREMENT
/begin MEASUREMENT Arizona_base_GOAT_B.jogdistance_x_reset "" FLOAT64_IEEE Arizona_base_GOAT_CM_double 0 0 -1.7E+308 1.7E+308 ECU_ADDRESS 0x00278470 /end MEASUREMENT
/begin MEASUREMENT Arizona_base_GOAT_B.jogdistance_y_reset "" FLOAT64_IEEE Arizona_base_GOAT_CM_double 0 0 -1.7E+308 1.7E+308 ECU_ADDRESS 0x00278450 /end MEASUREMENT
/begin MEASUREMENT Arizona_base_GOAT_B.jogspeed_Theta "" FLOAT64_IEEE Arizona_base_GOAT_CM_double 0 0 -1.7E+308 1.7E+308 ECU_ADDRESS 0x002783F8 /end MEASUREMENT
/begin MEASUREMENT Arizona_base_GOAT_B.jogspeed_Z "" FLOAT64_IEEE Arizona_base_GOAT_CM_double 0 0 -1.7E+308 1.7E+308 ECU_ADDRESS 0x002783F0 /end MEASUREMENT
/begin MEASUREMENT Arizona_base_GOAT_B.jogspeed_xL_reset "" FLOAT64_IEEE Arizona_base_GOAT_CM_double 0 0 -1.7E+308 1.7E+308 ECU_ADDRESS 0x002784B0 /end MEASUREMENT
/begin MEASUREMENT Arizona_base_GOAT_B.jogspeed_xL_reset_j "" FLOAT64_IEEE Arizona_base_GOAT_CM_double 0 0 -1.7E+308 1.7E+308 ECU_ADDRESS 0x002784C8 /end MEASUREMENT
/begin MEASUREMENT Arizona_base_GOAT_B.jogspeed_xR_reset "" FLOAT64_IEEE Arizona_base_GOAT_CM_double 0 0 -1.7E+308 1.7E+308 ECU_ADDRESS 0x002784A8 /end MEASUREMENT
/begin MEASUREMENT Arizona_base_GOAT_B.jogspeed_xR_reset_f "" FLOAT64_IEEE Arizona_base_GOAT_CM_double 0 0 -1.7E+308 1.7E+308 ECU_ADDRESS 0x002784D0 /end MEASUREMENT
/begin MEASUREMENT Arizona_base_GOAT_B.jogspeed_y_reset "" FLOAT64_IEEE Arizona_base_GOAT_CM_double 0 0 -1.7E+308 1.7E+308 ECU_ADDRESS 0x002784B8 /end MEASUREMENT
/begin MEASUREMENT Arizona_base_GOAT_B.jogspeed_y_reset_d "" FLOAT64_IEEE Arizona_base_GOAT_CM_double 0 0 -1.7E+308 1.7E+308 ECU_ADDRESS 0x002784C0 /end MEASUREMENT
/begin MEASUREMENT Arizona_base_GOAT_B.main "" FLOAT64_IEEE Arizona_base_GOAT_CM_double 0 0 -1.7E+308 1.7E+308 ECU_ADDRESS 0x002780C8 /end MEASUREMENT
/begin MEASUREMENT Arizona_base_GOAT_B.penholderActive "" FLOAT64_IEEE Arizona_base_GOAT_CM_double 0 0 -1.7E+308 1.7E+308 ECU_ADDRESS 0x00277FE8 /end MEASUREMENT
/begin MEASUREMENT Arizona_base_GOAT_B.phiNomrad "" FLOAT64_IEEE Arizona_base_GOAT_CM_double 0 0 -1.7E+308 1.7E+308 ECU_ADDRESS 0x00278108 /end MEASUREMENT
/begin MEASUREMENT Arizona_base_GOAT_B.r_phirad "" FLOAT64_IEEE Arizona_base_GOAT_CM_double 0 0 -1.7E+308 1.7E+308 ECU_ADDRESS 0x002780E0 /end MEASUREMENT
/begin MEASUREMENT Arizona_base_GOAT_B.r_xm "" FLOAT64_IEEE Arizona_base_GOAT_CM_double 0 0 -1.7E+308 1.7E+308 ECU_ADDRESS 0x00278070 /end MEASUREMENT
/begin MEASUREMENT Arizona_base_GOAT_B.r_ym "" FLOAT64_IEEE Arizona_base_GOAT_CM_double 0 0 -1.7E+308 1.7E+308 ECU_ADDRESS 0x00278018 /end MEASUREMENT
/begin MEASUREMENT Arizona_base_GOAT_B.resetDone "" FLOAT64_IEEE Arizona_base_GOAT_CM_double 0 0 -1.7E+308 1.7E+308 ECU_ADDRESS 0x002784D8 /end MEASUREMENT
/begin MEASUREMENT Arizona_base_GOAT_B.startHoming "" FLOAT64_IEEE Arizona_base_GOAT_CM_double 0 0 -1.7E+308 1.7E+308 ECU_ADDRESS 0x00278218 /end MEASUREMENT
/begin MEASUREMENT Arizona_base_GOAT_B.startPenholder "" FLOAT64_IEEE Arizona_base_GOAT_CM_double 0 0 -1.7E+308 1.7E+308 ECU_ADDRESS 0x00278228 /end MEASUREMENT
/begin MEASUREMENT Arizona_base_GOAT_B.startTrial "" FLOAT64_IEEE Arizona_base_GOAT_CM_double 0 0 -1.7E+308 1.7E+308 ECU_ADDRESS 0x00278220 /end MEASUREMENT
/begin MEASUREMENT Arizona_base_GOAT_B.stopSimulation "" FLOAT64_IEEE Arizona_base_GOAT_CM_double 0 0 -1.7E+308 1.7E+308 ECU_ADDRESS 0x002783E8 /end MEASUREMENT
/begin MEASUREMENT Arizona_base_GOAT_B.time "" FLOAT64_IEEE Arizona_base_GOAT_CM_double 0 0 -1.7E+308 1.7E+308 ECU_ADDRESS 0x00278398 /end MEASUREMENT
/begin MEASUREMENT Arizona_base_GOAT_B.trialIndex "" FLOAT64_IEEE Arizona_base_GOAT_CM_double 0 0 -1.7E+308 1.7E+308 ECU_ADDRESS 0x00278378 /end MEASUREMENT
/begin MEASUREMENT Arizona_base_GOAT_B.trialTrigger "" FLOAT64_IEEE Arizona_base_GOAT_CM_double 0 0 -1.7E+308 1.7E+308 ECU_ADDRESS 0x00278010 /end MEASUREMENT
/begin MEASUREMENT Arizona_base_GOAT_B.trialTrigger_e "" FLOAT64_IEEE Arizona_base_GOAT_CM_double 0 0 -1.7E+308 1.7E+308 ECU_ADDRESS 0x00278370 /end MEASUREMENT
/begin MEASUREMENT Arizona_base_GOAT_B.u_loopback_yV "" FLOAT64_IEEE Arizona_base_GOAT_CM_double 0 0 -1.7E+308 1.7E+308 ECU_ADDRESS 0x00277FE0 /end MEASUREMENT
/begin MEASUREMENT Arizona_base_GOAT_B.u_phiV "" FLOAT64_IEEE Arizona_base_GOAT_CM_double 0 0 -1.7E+308 1.7E+308 ECU_ADDRESS 0x00278138 /end MEASUREMENT
/begin MEASUREMENT Arizona_base_GOAT_B.u_xV "" FLOAT64_IEEE Arizona_base_GOAT_CM_double 0 0 -1.7E+308 1.7E+308 ECU_ADDRESS 0x00278120 /end MEASUREMENT
/begin MEASUREMENT Arizona_base_GOAT_B.u_yV "" FLOAT64_IEEE Arizona_base_GOAT_CM_double 0 0 -1.7E+308 1.7E+308 ECU_ADDRESS 0x00278188 /end MEASUREMENT
/begin MEASUREMENT Arizona_base_GOAT_B.xNomm "" FLOAT64_IEEE Arizona_base_GOAT_CM_double 0 0 -1.7E+308 1.7E+308 ECU_ADDRESS 0x00278098 /end MEASUREMENT
/begin MEASUREMENT Arizona_base_GOAT_B.x_L_secundairm "" FLOAT64_IEEE Arizona_base_GOAT_CM_double 0 0 -1.7E+308 1.7E+308 ECU_ADDRESS 0x002781F8 /end MEASUREMENT
/begin MEASUREMENT Arizona_base_GOAT_B.x_R_secundairm "" FLOAT64_IEEE Arizona_base_GOAT_CM_double 0 0 -1.7E+308 1.7E+308 ECU_ADDRESS 0x002781E0 /end MEASUREMENT
/begin MEASUREMENT Arizona_base_GOAT_B.yNomm "" FLOAT64_IEEE Arizona_base_GOAT_CM_double 0 0 -1.7E+308 1.7E+308 ECU_ADDRESS 0x00278030 /end MEASUREMENT
/begin MEASUREMENT Arizona_base_GOAT_B.y_secundairm "" FLOAT64_IEEE Arizona_base_GOAT_CM_double 0 0 -1.7E+308 1.7E+308 ECU_ADDRESS 0x002781C8 /end MEASUREMENT
/begin MEASUREMENT Arizona_base_GOAT_B.yref_check "" FLOAT64_IEEE Arizona_base_GOAT_CM_double 0 0 -1.7E+308 1.7E+308 ECU_ADDRESS 0x002783A0 /end MEASUREMENT
/begin MEASUREMENT Arizona_base_GOAT_DW.Delay1_DSTATE "" FLOAT64_IEEE Arizona_base_GOAT_CM_double 0 0 -1.7E+308 1.7E+308 ECU_ADDRESS 0x002777F0 /end MEASUREMENT
/begin MEASUREMENT Arizona_base_GOAT_DW.Delay1_DSTATE_g "" FLOAT64_IEEE Arizona_base_GOAT_CM_double 0 0 -1.7E+308 1.7E+308 ECU_ADDRESS 0x00277800 /end MEASUREMENT
/begin MEASUREMENT Arizona_base_GOAT_DW.Delay1_DSTATE_i "" FLOAT64_IEEE Arizona_base_GOAT_CM_double 0 0 -1.7E+308 1.7E+308 ECU_ADDRESS 0x00277810 /end MEASUREMENT
/begin MEASUREMENT Arizona_base_GOAT_DW.Delay1_DSTATE_o "" FLOAT64_IEEE Arizona_base_GOAT_CM_double 0 0 -1.7E+308 1.7E+308 ECU_ADDRESS 0x00277828 /end MEASUREMENT
/begin MEASUREMENT Arizona_base_GOAT_DW.Delay2_DSTATE "" FLOAT64_IEEE Arizona_base_GOAT_CM_double 0 0 -1.7E+308 1.7E+308 ECU_ADDRESS 0x002777E8 /end MEASUREMENT
/begin MEASUREMENT Arizona_base_GOAT_DW.Delay_DSTATE "" FLOAT64_IEEE Arizona_base_GOAT_CM_double 0 0 -1.7E+308 1.7E+308 ECU_ADDRESS 0x002777F8 /end MEASUREMENT
/begin MEASUREMENT Arizona_base_GOAT_DW.Delay_DSTATE_h "" FLOAT64_IEEE Arizona_base_GOAT_CM_double 0 0 -1.7E+308 1.7E+308 ECU_ADDRESS 0x00277830 /end MEASUREMENT
/begin MEASUREMENT Arizona_base_GOAT_DW.Delay_DSTATE_j "" FLOAT64_IEEE Arizona_base_GOAT_CM_double 0 0 -1.7E+308 1.7E+308 ECU_ADDRESS 0x00277818 /end MEASUREMENT
/begin MEASUREMENT Arizona_base_GOAT_DW.Delay_DSTATE_k "" UBYTE Arizona_base_GOAT_CM_logical 0 0 0 1 ECU_ADDRESS 0x00277F0C /end MEASUREMENT
/begin MEASUREMENT Arizona_base_GOAT_DW.Delay_DSTATE_m "" FLOAT64_IEEE Arizona_base_GOAT_CM_double 0 0 -1.7E+308 1.7E+308 ECU_ADDRESS 0x00277870 /end MEASUREMENT
/begin MEASUREMENT Arizona_base_GOAT_DW.DiscreteTimeIntegratorx1JogSpee "" FLOAT64_IEEE Arizona_base_GOAT_CM_double 0 0 -1.7E+308 1.7E+308 ECU_ADDRESS 0x00277888 /end MEASUREMENT
/begin MEASUREMENT Arizona_base_GOAT_DW.DiscreteTimeIntegratorx2JogSp_a "" FLOAT64_IEEE Arizona_base_GOAT_CM_double 0 0 -1.7E+308 1.7E+308 ECU_ADDRESS 0x00277880 /end MEASUREMENT
/begin MEASUREMENT Arizona_base_GOAT_DW.DiscreteTimeIntegratorx2JogSpee "" FLOAT64_IEEE Arizona_base_GOAT_CM_double 0 0 -1.7E+308 1.7E+308 ECU_ADDRESS 0x00277878 /end MEASUREMENT
/begin MEASUREMENT Arizona_base_GOAT_DW.Enabledsubsystem_MODE "" UBYTE Arizona_base_GOAT_CM_logical 0 0 0 1 ECU_ADDRESS 0x00277F21 /end MEASUREMENT
/begin MEASUREMENT Arizona_base_GOAT_DW.Enabledsubsystem_SubsysRanBC "" SBYTE Arizona_base_GOAT_CM_int8 0 0 -128 127 ECU_ADDRESS 0x00277F0E /end MEASUREMENT
/begin MEASUREMENT Arizona_base_GOAT_DW.Feedforward_SubsysRanBC "" SBYTE Arizona_base_GOAT_CM_int8 0 0 -128 127 ECU_ADDRESS 0x00277F0F /end MEASUREMENT
/begin MEASUREMENT Arizona_base_GOAT_DW.Internal_DSTATE "" FLOAT64_IEEE Arizona_base_GOAT_CM_double 0 0 -1.7E+308 1.7E+308 LAYOUT COLUMN_DIR MATRIX_DIM 2 ECU_ADDRESS 0x00277838 /end MEASUREMENT
/begin MEASUREMENT Arizona_base_GOAT_DW.Internal_DSTATE_h "" FLOAT64_IEEE Arizona_base_GOAT_CM_double 0 0 -1.7E+308 1.7E+308 LAYOUT COLUMN_DIR MATRIX_DIM 2 ECU_ADDRESS 0x00277860 /end MEASUREMENT
/begin MEASUREMENT Arizona_base_GOAT_DW.Internal_DSTATE_l "" FLOAT64_IEEE Arizona_base_GOAT_CM_double 0 0 -1.7E+308 1.7E+308 LAYOUT COLUMN_DIR MATRIX_DIM 3 ECU_ADDRESS 0x00277848 /end MEASUREMENT
/begin MEASUREMENT Arizona_base_GOAT_DW.Memory_PreviousInput "" FLOAT64_IEEE Arizona_base_GOAT_CM_double 0 0 -1.7E+308 1.7E+308 ECU_ADDRESS 0x00277898 /end MEASUREMENT
/begin MEASUREMENT Arizona_base_GOAT_DW.Trajectory_MODE "" UBYTE Arizona_base_GOAT_CM_logical 0 0 0 1 ECU_ADDRESS 0x00277F20 /end MEASUREMENT
/begin MEASUREMENT Arizona_base_GOAT_DW.Trajectory_SubsysRanBC "" SBYTE Arizona_base_GOAT_CM_int8 0 0 -128 127 ECU_ADDRESS 0x00277F0D /end MEASUREMENT
/begin MEASUREMENT Arizona_base_GOAT_DW.Ts_l "" FLOAT64_IEEE Arizona_base_GOAT_CM_double 0 0 -1.7E+308 1.7E+308 ECU_ADDRESS 0x002778C0 /end MEASUREMENT
/begin MEASUREMENT Arizona_base_GOAT_DW.UD_DSTATE "" FLOAT64_IEEE Arizona_base_GOAT_CM_double 0 0 -1.7E+308 1.7E+308 ECU_ADDRESS 0x00277808 /end MEASUREMENT
/begin MEASUREMENT Arizona_base_GOAT_DW.UD_DSTATE_a "" FLOAT64_IEEE Arizona_base_GOAT_CM_double 0 0 -1.7E+308 1.7E+308 ECU_ADDRESS 0x00277820 /end MEASUREMENT
/begin MEASUREMENT Arizona_base_GOAT_DW.color_pos "" FLOAT64_IEEE Arizona_base_GOAT_CM_double 0 0 -1.7E+308 1.7E+308 ECU_ADDRESS 0x002778B8 /end MEASUREMENT
/begin MEASUREMENT Arizona_base_GOAT_DW.counter "" FLOAT64_IEEE Arizona_base_GOAT_CM_double 0 0 -1.7E+308 1.7E+308 ECU_ADDRESS 0x002778A0 /end MEASUREMENT
/begin MEASUREMENT Arizona_base_GOAT_DW.durationCounter_1 "" SLONG Arizona_base_GOAT_CM_int32 0 0 -2147483648 2147483647 ECU_ADDRESS 0x00277EC0 /end MEASUREMENT
/begin MEASUREMENT Arizona_base_GOAT_DW.durationCounter_1_d "" SLONG Arizona_base_GOAT_CM_int32 0 0 -2147483648 2147483647 ECU_ADDRESS 0x00277EC8 /end MEASUREMENT
/begin MEASUREMENT Arizona_base_GOAT_DW.durationCounter_1_n "" SLONG Arizona_base_GOAT_CM_int32 0 0 -2147483648 2147483647 ECU_ADDRESS 0x00277EC4 /end MEASUREMENT
/begin MEASUREMENT Arizona_base_GOAT_DW.is_HOME "" ULONG Arizona_base_GOAT_CM_uint32 0 0 0 4294967295 ECU_ADDRESS 0x00277EF0 /end MEASUREMENT
/begin MEASUREMENT Arizona_base_GOAT_DW.is_MAIN "" ULONG Arizona_base_GOAT_CM_uint32 0 0 0 4294967295 ECU_ADDRESS 0x00277EE4 /end MEASUREMENT
/begin MEASUREMENT Arizona_base_GOAT_DW.is_ROTATION "" ULONG Arizona_base_GOAT_CM_uint32 0 0 0 4294967295 ECU_ADDRESS 0x00277EEC /end MEASUREMENT
/begin MEASUREMENT Arizona_base_GOAT_DW.is_VERTICAL "" ULONG Arizona_base_GOAT_CM_uint32 0 0 0 4294967295 ECU_ADDRESS 0x00277EE8 /end MEASUREMENT
/begin MEASUREMENT Arizona_base_GOAT_DW.is_active_HOME "" UBYTE Arizona_base_GOAT_CM_uint8 0 0 0 255 ECU_ADDRESS 0x00277F19 /end MEASUREMENT
/begin MEASUREMENT Arizona_base_GOAT_DW.is_active_MAIN "" UBYTE Arizona_base_GOAT_CM_uint8 0 0 0 255 ECU_ADDRESS 0x00277F16 /end MEASUREMENT
/begin MEASUREMENT Arizona_base_GOAT_DW.is_active_ROTATION "" UBYTE Arizona_base_GOAT_CM_uint8 0 0 0 255 ECU_ADDRESS 0x00277F18 /end MEASUREMENT
/begin MEASUREMENT Arizona_base_GOAT_DW.is_active_VERTICAL "" UBYTE Arizona_base_GOAT_CM_uint8 0 0 0 255 ECU_ADDRESS 0x00277F17 /end MEASUREMENT
/begin MEASUREMENT Arizona_base_GOAT_DW.is_active_c3_Arizona_base_GOAT "" UBYTE Arizona_base_GOAT_CM_uint8 0 0 0 255 ECU_ADDRESS 0x00277F11 /end MEASUREMENT
/begin MEASUREMENT Arizona_base_GOAT_DW.is_active_c4_Arizona_base_GOAT "" UBYTE Arizona_base_GOAT_CM_uint8 0 0 0 255 ECU_ADDRESS 0x00277F15 /end MEASUREMENT
/begin MEASUREMENT Arizona_base_GOAT_DW.is_active_c5_Arizona_base_GOAT "" UBYTE Arizona_base_GOAT_CM_uint8 0 0 0 255 ECU_ADDRESS 0x00277F10 /end MEASUREMENT
/begin MEASUREMENT Arizona_base_GOAT_DW.is_active_c7_Arizona_base_GOAT "" UBYTE Arizona_base_GOAT_CM_uint8 0 0 0 255 ECU_ADDRESS 0x00277F1C /end MEASUREMENT
/begin MEASUREMENT Arizona_base_GOAT_DW.is_active_carriageAirbag "" UBYTE Arizona_base_GOAT_CM_uint8 0 0 0 255 ECU_ADDRESS 0x00277F14 /end MEASUREMENT
/begin MEASUREMENT Arizona_base_GOAT_DW.is_active_errorAirbag "" UBYTE Arizona_base_GOAT_CM_uint8 0 0 0 255 ECU_ADDRESS 0x00277F13 /end MEASUREMENT
/begin MEASUREMENT Arizona_base_GOAT_DW.is_active_gantryAirbag "" UBYTE Arizona_base_GOAT_CM_uint8 0 0 0 255 ECU_ADDRESS 0x00277F12 /end MEASUREMENT
/begin MEASUREMENT Arizona_base_GOAT_DW.is_active_reset_carriage "" UBYTE Arizona_base_GOAT_CM_uint8 0 0 0 255 ECU_ADDRESS 0x00277F1F /end MEASUREMENT
/begin MEASUREMENT Arizona_base_GOAT_DW.is_active_reset_gantryLeft "" UBYTE Arizona_base_GOAT_CM_uint8 0 0 0 255 ECU_ADDRESS 0x00277F1D /end MEASUREMENT
/begin MEASUREMENT Arizona_base_GOAT_DW.is_active_reset_gantryright "" UBYTE Arizona_base_GOAT_CM_uint8 0 0 0 255 ECU_ADDRESS 0x00277F1E /end MEASUREMENT
/begin MEASUREMENT Arizona_base_GOAT_DW.is_c3_Arizona_base_GOAT "" ULONG Arizona_base_GOAT_CM_uint32 0 0 0 4294967295 ECU_ADDRESS 0x00277ED0 /end MEASUREMENT
/begin MEASUREMENT Arizona_base_GOAT_DW.is_c4_Arizona_base_GOAT "" ULONG Arizona_base_GOAT_CM_uint32 0 0 0 4294967295 ECU_ADDRESS 0x00277EE0 /end MEASUREMENT
/begin MEASUREMENT Arizona_base_GOAT_DW.is_c5_Arizona_base_GOAT "" ULONG Arizona_base_GOAT_CM_uint32 0 0 0 4294967295 ECU_ADDRESS 0x00277ECC /end MEASUREMENT
/begin MEASUREMENT Arizona_base_GOAT_DW.is_c7_Arizona_base_GOAT "" ULONG Arizona_base_GOAT_CM_uint32 0 0 0 4294967295 ECU_ADDRESS 0x00277EF4 /end MEASUREMENT
/begin MEASUREMENT Arizona_base_GOAT_DW.is_carriageAirbag "" ULONG Arizona_base_GOAT_CM_uint32 0 0 0 4294967295 ECU_ADDRESS 0x00277EDC /end MEASUREMENT
/begin MEASUREMENT Arizona_base_GOAT_DW.is_errorAirbag "" ULONG Arizona_base_GOAT_CM_uint32 0 0 0 4294967295 ECU_ADDRESS 0x00277ED8 /end MEASUREMENT
/begin MEASUREMENT Arizona_base_GOAT_DW.is_gantryAirbag "" ULONG Arizona_base_GOAT_CM_uint32 0 0 0 4294967295 ECU_ADDRESS 0x00277ED4 /end MEASUREMENT
/begin MEASUREMENT Arizona_base_GOAT_DW.is_reset_carriage "" ULONG Arizona_base_GOAT_CM_uint32 0 0 0 4294967295 ECU_ADDRESS 0x00277F00 /end MEASUREMENT
/begin MEASUREMENT Arizona_base_GOAT_DW.is_reset_gantryLeft "" ULONG Arizona_base_GOAT_CM_uint32 0 0 0 4294967295 ECU_ADDRESS 0x00277EF8 /end MEASUREMENT
/begin MEASUREMENT Arizona_base_GOAT_DW.is_reset_gantryright "" ULONG Arizona_base_GOAT_CM_uint32 0 0 0 4294967295 ECU_ADDRESS 0x00277EFC /end MEASUREMENT
/begin MEASUREMENT Arizona_base_GOAT_DW.job "" FLOAT64_IEEE Arizona_base_GOAT_CM_double 0 0 -1.7E+308 1.7E+308 ECU_ADDRESS 0x002778A8 /end MEASUREMENT
/begin MEASUREMENT Arizona_base_GOAT_DW.log_penholder_active_DSTATE "" FLOAT64_IEEE Arizona_base_GOAT_CM_double 0 0 -1.7E+308 1.7E+308 ECU_ADDRESS 0x002777E0 /end MEASUREMENT
/begin MEASUREMENT Arizona_base_GOAT_DW.rot_change "" FLOAT64_IEEE Arizona_base_GOAT_CM_double 0 0 -1.7E+308 1.7E+308 ECU_ADDRESS 0x002778B0 /end MEASUREMENT
/begin MEASUREMENT Arizona_base_GOAT_DW.sfEvent "" SLONG Arizona_base_GOAT_CM_int32 0 0 -2147483648 2147483647 ECU_ADDRESS 0x00277EB0 /end MEASUREMENT
/begin MEASUREMENT Arizona_base_GOAT_DW.sfEvent_h "" SLONG Arizona_base_GOAT_CM_int32 0 0 -2147483648 2147483647 ECU_ADDRESS 0x00277EBC /end MEASUREMENT
/begin MEASUREMENT Arizona_base_GOAT_DW.sfEvent_i "" SLONG Arizona_base_GOAT_CM_int32 0 0 -2147483648 2147483647 ECU_ADDRESS 0x00277EB4 /end MEASUREMENT
/begin MEASUREMENT Arizona_base_GOAT_DW.sfEvent_l "" SLONG Arizona_base_GOAT_CM_int32 0 0 -2147483648 2147483647 ECU_ADDRESS 0x00277EB8 /end MEASUREMENT
/begin MEASUREMENT Arizona_base_GOAT_DW.temporalCounter_i1 "" UWORD Arizona_base_GOAT_CM_uint16 0 0 0 65535 ECU_ADDRESS 0x00277F0A /end MEASUREMENT
/begin MEASUREMENT Arizona_base_GOAT_DW.temporalCounter_i1_b "" UBYTE Arizona_base_GOAT_CM_uint8 0 0 0 255 ECU_ADDRESS 0x00277F1A /end MEASUREMENT
/begin MEASUREMENT Arizona_base_GOAT_DW.temporalCounter_i2 "" UWORD Arizona_base_GOAT_CM_uint16 0 0 0 65535 ECU_ADDRESS 0x00277F08 /end MEASUREMENT
/begin MEASUREMENT Arizona_base_GOAT_DW.temporalCounter_i3 "" UBYTE Arizona_base_GOAT_CM_uint8 0 0 0 255 ECU_ADDRESS 0x00277F1B /end MEASUREMENT
/begin MEASUREMENT Arizona_base_GOAT_DW.timeIndex "" FLOAT64_IEEE Arizona_base_GOAT_CM_double 0 0 -1.7E+308 1.7E+308 ECU_ADDRESS 0x00277890 /end MEASUREMENT
/begin MEASUREMENT Arizona_base_GOAT_PrevZCX.ResettableSubsystemMemory_Reset "" UBYTE Arizona_base_GOAT_CM_ZCSigState 0 0 0 255 ECU_ADDRESS 0x002777D0 /end MEASUREMENT
/begin COMPU_METHOD Arizona_base_GOAT_CM_ZCSigState "" IDENTICAL "customformat" "" /end COMPU_METHOD
/begin COMPU_METHOD Arizona_base_GOAT_CM_double "" IDENTICAL "%15.10" "" /end COMPU_METHOD
/begin COMPU_METHOD Arizona_base_GOAT_CM_int32 "" IDENTICAL "%10.0" "" /end COMPU_METHOD
/begin COMPU_METHOD Arizona_base_GOAT_CM_int8 "" IDENTICAL "%3.0" "" /end COMPU_METHOD
/begin COMPU_METHOD Arizona_base_GOAT_CM_logical "" IDENTICAL "%1.0" "" /end COMPU_METHOD
/begin COMPU_METHOD Arizona_base_GOAT_CM_uint16 "" IDENTICAL "%5.0" "" /end COMPU_METHOD
/begin COMPU_METHOD Arizona_base_GOAT_CM_uint32 "" IDENTICAL "%10.0" "" /end COMPU_METHOD
/begin COMPU_METHOD Arizona_base_GOAT_CM_uint8 "" IDENTICAL "%3.0" "" /end COMPU_METHOD
/begin RECORD_LAYOUT FixLookup_FLOAT64_IEEE FNC_VALUES 1 FLOAT64_IEEE COLUMN_DIR DIRECT /end RECORD_LAYOUT
/begin RECORD_LAYOUT Scalar_BOOLEAN FNC_VALUES 1 UBYTE COLUMN_DIR DIRECT /end RECORD_LAYOUT
/begin RECORD_LAYOUT Scalar_FLOAT64_IEEE FNC_VALUES 1 FLOAT64_IEEE COLUMN_DIR DIRECT /end RECORD_LAYOUT
/begin RECORD_LAYOUT Scalar_SBYTE FNC_VALUES 1 SBYTE COLUMN_DIR DIRECT /end RECORD_LAYOUT
/begin RECORD_LAYOUT Scalar_SLONG FNC_VALUES 1 SLONG COLUMN_DIR DIRECT /end RECORD_LAYOUT
/begin RECORD_LAYOUT Scalar_UBYTE FNC_VALUES 1 UBYTE COLUMN_DIR DIRECT /end RECORD_LAYOUT
/begin RECORD_LAYOUT Scalar_ULONG FNC_VALUES 1 ULONG COLUMN_DIR DIRECT /end RECORD_LAYOUT
/begin RECORD_LAYOUT Scalar_UWORD FNC_VALUES 1 UWORD COLUMN_DIR DIRECT /end RECORD_LAYOUT
/begin GROUP Arizona_base_GOAT "Arizona_base_GOAT" ROOT
 /begin SUB_GROUP Arizona_base_GOAT_Coupling Arizona_base_GOAT_Decoupling Arizona_base_GOAT_Feedforward Arizona_base_GOAT_Homing Arizona_base_GOAT_IO_Arizona Arizona_base_GOAT_LTI_System Arizona_base_GOAT_LTI_System1 Arizona_base_GOAT_LTI_System2 Arizona_base_GOAT_Penholder_mechanism1 Arizona_base_GOAT_Safety Arizona_base_GOAT_Trajectory /end SUB_GROUP
 /begin REF_CHARACTERISTIC Arizona_base_GOAT_cal_impl.Delay1_InitialCondition_m Arizona_base_GOAT_cal_impl.Delay2_InitialCondition Arizona_base_GOAT_cal_impl.Gain10_Gain Arizona_base_GOAT_cal_impl.Gain8_Gain Arizona_base_GOAT_cal_impl.Gain9_Gain Arizona_base_GOAT_cal_impl.PenColor_Value Arizona_base_GOAT_cal_impl.log_penholder_active_InitialCon Arizona_base_GOAT_cal_impl.startHoming_Value Arizona_base_GOAT_cal_impl.startPenholder_Value Arizona_base_GOAT_cal_impl.startTrial_Value /end REF_CHARACTERISTIC
 /begin REF_MEASUREMENT Arizona_base_GOAT_B.Compare_h2 Arizona_base_GOAT_B.DataTypeConversionendtrial Arizona_base_GOAT_B.Delay2 Arizona_base_GOAT_B.DirectLookupTablechange_color Arizona_base_GOAT_B.DirectLookupTablephiRef Arizona_base_GOAT_B.DirectLookupTablexRef Arizona_base_GOAT_B.Gainphi Arizona_base_GOAT_B.Gainx Arizona_base_GOAT_B.Internal Arizona_base_GOAT_B.Internal_g Arizona_base_GOAT_B.Internal_j Arizona_base_GOAT_B.PenColor Arizona_base_GOAT_B.Switch1 Arizona_base_GOAT_B.Switch1_c Arizona_base_GOAT_B.Switch1_h Arizona_base_GOAT_B.Switch1_hm Arizona_base_GOAT_B.Switch_b Arizona_base_GOAT_B.active Arizona_base_GOAT_B.change_color Arizona_base_GOAT_B.change_color_j Arizona_base_GOAT_B.e_phirad Arizona_base_GOAT_B.e_xm Arizona_base_GOAT_B.e_ym Arizona_base_GOAT_B.encodercarriage Arizona_base_GOAT_B.errorphi Arizona_base_GOAT_B.errorx Arizona_base_GOAT_B.errory Arizona_base_GOAT_B.f_phi Arizona_base_GOAT_B.f_x Arizona_base_GOAT_B.f_y Arizona_base_GOAT_B.homeTrigger Arizona_base_GOAT_B.penholderActive Arizona_base_GOAT_B.r_phirad Arizona_base_GOAT_B.r_xm Arizona_base_GOAT_B.r_ym Arizona_base_GOAT_B.startHoming Arizona_base_GOAT_B.startPenholder Arizona_base_GOAT_B.startTrial Arizona_base_GOAT_B.trialIndex Arizona_base_GOAT_B.trialTrigger Arizona_base_GOAT_B.trialTrigger_e Arizona_base_GOAT_B.u_phiV Arizona_base_GOAT_B.u_xV Arizona_base_GOAT_B.u_yV Arizona_base_GOAT_B.yref_check Arizona_base_GOAT_DW.Delay1_DSTATE_g Arizona_base_GOAT_DW.Delay2_DSTATE Arizona_base_GOAT_DW.is_active_c5_Arizona_base_GOAT Arizona_base_GOAT_DW.is_c5_Arizona_base_GOAT Arizona_base_GOAT_DW.log_penholder_active_DSTATE Arizona_base_GOAT_DW.sfEvent Arizona_base_GOAT_DW.timeIndex /end REF_MEASUREMENT
/end GROUP
/begin GROUP Arizona_base_GOAT_Coupling "Arizona_base_GOAT/Coupling"
 /begin REF_CHARACTERISTIC Arizona_base_GOAT_cal_impl.Gainonu_phi_Gain Arizona_base_GOAT_cal_impl.Gainonu_x_Gain /end REF_CHARACTERISTIC
 /begin REF_MEASUREMENT Arizona_base_GOAT_B.Gainonu_phi Arizona_base_GOAT_B.Gainonu_x Arizona_base_GOAT_B.Sumcurrentx_L Arizona_base_GOAT_B.Sumcurrentx_R Arizona_base_GOAT_B.u_phiV Arizona_base_GOAT_B.u_xV /end REF_MEASUREMENT
/end GROUP
/begin GROUP Arizona_base_GOAT_Decoupling "Arizona_base_GOAT/Decoupling"
 /begin REF_CHARACTERISTIC Arizona_base_GOAT_cal_impl.Gainphi_Gain Arizona_base_GOAT_cal_impl.Gainx_Gain /end REF_CHARACTERISTIC
 /begin REF_MEASUREMENT Arizona_base_GOAT_B.Gainphi Arizona_base_GOAT_B.Gainx Arizona_base_GOAT_B.Sumx_Lx_R Arizona_base_GOAT_B.Sumx_Rx_L Arizona_base_GOAT_B.encodergantryx1 Arizona_base_GOAT_B.encodergantryx2 /end REF_MEASUREMENT
/end GROUP
/begin GROUP Arizona_base_GOAT_Feedforward "Arizona_base_GOAT/Feedforward"
 /begin REF_CHARACTERISTIC Arizona_base_GOAT_cal_impl.phiFF_Y0 Arizona_base_GOAT_cal_impl.set_phiFF_Value Arizona_base_GOAT_cal_impl.set_xFF_Value Arizona_base_GOAT_cal_impl.set_yFF_Value Arizona_base_GOAT_cal_impl.xFF_Y0 Arizona_base_GOAT_cal_impl.yFF_Y0 /end REF_CHARACTERISTIC
 /begin REF_MEASUREMENT Arizona_base_GOAT_B.f_phi Arizona_base_GOAT_B.f_x Arizona_base_GOAT_B.f_y Arizona_base_GOAT_B.time /end REF_MEASUREMENT
/end GROUP
/begin GROUP Arizona_base_GOAT_Homing "Arizona_base_GOAT/Homing"
 /begin SUB_GROUP Arizona_base_GOAT_Homing_Enabled_subsystem Arizona_base_GOAT_Homing_Memory_block_for_homing_during_trials /end SUB_GROUP
/end GROUP
/begin GROUP Arizona_base_GOAT_Homing_Enabled_subsystem "Arizona_base_GOAT/Homing/Enabled subsystem"
 /begin SUB_GROUP Arizona_base_GOAT_Homing_Enabled_subsystem_Initialization Arizona_base_GOAT_Homing_Enabled_subsystem_Reset /end SUB_GROUP
 /begin REF_CHARACTERISTIC Arizona_base_GOAT_cal_impl.homingDone_Y0 Arizona_base_GOAT_cal_impl.phiHome_Y0 Arizona_base_GOAT_cal_impl.xHome_Y0 Arizona_base_GOAT_cal_impl.yHome_Y0 /end REF_CHARACTERISTIC
 /begin REF_MEASUREMENT Arizona_base_GOAT_B.AddphiHome Arizona_base_GOAT_B.AddxHome Arizona_base_GOAT_B.AddyHome Arizona_base_GOAT_B.DirectLookupTablephiFF Arizona_base_GOAT_B.DirectLookupTablexFF Arizona_base_GOAT_B.DirectLookupTableyFF Arizona_base_GOAT_B.jogdistance_phi_reset Arizona_base_GOAT_B.jogdistance_x_reset Arizona_base_GOAT_B.jogdistance_y_reset /end REF_MEASUREMENT
/end GROUP
/begin GROUP Arizona_base_GOAT_Homing_Enabled_subsystem_Initialization "Arizona_base_GOAT/Homing/Enabled subsystem/Initialization"
 /begin SUB_GROUP Arizona_base_GOAT_Homing_Enabled_subsystem_Initialization_Compare_To_Constant_NInit /end SUB_GROUP
 /begin REF_CHARACTERISTIC Arizona_base_GOAT_cal_impl.Constant1_Value Arizona_base_GOAT_cal_impl.Constant_Value Arizona_base_GOAT_cal_impl.Delay_InitialCondition Arizona_base_GOAT_cal_impl.Switch_Threshold /end REF_CHARACTERISTIC
 /begin REF_MEASUREMENT Arizona_base_GOAT_B.Compare_b Arizona_base_GOAT_B.DataTypeConversionendtrial Arizona_base_GOAT_B.Delay_l Arizona_base_GOAT_B.DirectLookupTablephiFF Arizona_base_GOAT_B.DirectLookupTablexFF Arizona_base_GOAT_B.DirectLookupTableyFF Arizona_base_GOAT_B.Sum_b Arizona_base_GOAT_B.Switch_bb Arizona_base_GOAT_B.home_time Arizona_base_GOAT_B.resetDone Arizona_base_GOAT_DW.Delay_DSTATE_m /end REF_MEASUREMENT
/end GROUP
/begin GROUP Arizona_base_GOAT_Homing_Enabled_subsystem_Initialization_Compare_To_Constant_NInit "Arizona_base_GOAT/Homing/Enabled subsystem/Initialization/Compare To
Constant NInit"
 /begin REF_MEASUREMENT Arizona_base_GOAT_B.Compare_b Arizona_base_GOAT_B.home_time /end REF_MEASUREMENT
/end GROUP
/begin GROUP Arizona_base_GOAT_Homing_Enabled_subsystem_Reset "Arizona_base_GOAT/Homing/Enabled subsystem/Reset"
 /begin REF_CHARACTERISTIC Arizona_base_GOAT_cal_impl.Dct2lowpassx1JogSpeed_P1 Arizona_base_GOAT_cal_impl.Dct2lowpassx1JogSpeed_P2 Arizona_base_GOAT_cal_impl.Dct2lowpassx1JogSpeed_P3 Arizona_base_GOAT_cal_impl.Dct2lowpassx2JogSpeed_P1 Arizona_base_GOAT_cal_impl.Dct2lowpassx2JogSpeed_P2 Arizona_base_GOAT_cal_impl.Dct2lowpassx2JogSpeed_P3 Arizona_base_GOAT_cal_impl.Dct2lowpassyJogSpeed_P1 Arizona_base_GOAT_cal_impl.Dct2lowpassyJogSpeed_P2 Arizona_base_GOAT_cal_impl.Dct2lowpassyJogSpeed_P3 Arizona_base_GOAT_cal_impl.DiscreteTimeIntegratorx1JogSp_k Arizona_base_GOAT_cal_impl.DiscreteTimeIntegratorx1JogSpee Arizona_base_GOAT_cal_impl.DiscreteTimeIntegratorx2JogSp_e Arizona_base_GOAT_cal_impl.DiscreteTimeIntegratorx2JogSp_m Arizona_base_GOAT_cal_impl.DiscreteTimeIntegratorx2JogSp_n Arizona_base_GOAT_cal_impl.DiscreteTimeIntegratorx2JogSpee Arizona_base_GOAT_cal_impl.Gainx2_Gain Arizona_base_GOAT_cal_impl.Gainx3_Gain /end REF_CHARACTERISTIC
 /begin REF_MEASUREMENT Arizona_base_GOAT_B.DIcarriagelimitswitch Arizona_base_GOAT_B.DIgantryx1limitswitch Arizona_base_GOAT_B.DIgantryx2limitswitch Arizona_base_GOAT_B.DiscreteTimeIntegratorx1JogSpee Arizona_base_GOAT_B.DiscreteTimeIntegratorx2JogSpee Arizona_base_GOAT_B.change_color_j Arizona_base_GOAT_B.current_x3 Arizona_base_GOAT_B.current_x4 Arizona_base_GOAT_B.jogdistance_phi_reset Arizona_base_GOAT_B.jogdistance_x_reset Arizona_base_GOAT_B.jogdistance_y_reset Arizona_base_GOAT_B.jogspeed_xL_reset Arizona_base_GOAT_B.jogspeed_xL_reset_j Arizona_base_GOAT_B.jogspeed_xR_reset Arizona_base_GOAT_B.jogspeed_xR_reset_f Arizona_base_GOAT_B.jogspeed_y_reset Arizona_base_GOAT_B.jogspeed_y_reset_d Arizona_base_GOAT_B.penholderActive Arizona_base_GOAT_B.resetDone Arizona_base_GOAT_DW.DiscreteTimeIntegratorx1JogSpee Arizona_base_GOAT_DW.DiscreteTimeIntegratorx2JogSp_a Arizona_base_GOAT_DW.DiscreteTimeIntegratorx2JogSpee Arizona_base_GOAT_DW.Ts_l Arizona_base_GOAT_DW.durationCounter_1 Arizona_base_GOAT_DW.durationCounter_1_d Arizona_base_GOAT_DW.durationCounter_1_n Arizona_base_GOAT_DW.is_active_c7_Arizona_base_GOAT Arizona_base_GOAT_DW.is_active_reset_carriage Arizona_base_GOAT_DW.is_active_reset_gantryLeft Arizona_base_GOAT_DW.is_active_reset_gantryright Arizona_base_GOAT_DW.is_c7_Arizona_base_GOAT Arizona_base_GOAT_DW.is_reset_carriage Arizona_base_GOAT_DW.is_reset_gantryLeft Arizona_base_GOAT_DW.is_reset_gantryright Arizona_base_GOAT_DW.sfEvent_h Arizona_base_GOAT_DW.temporalCounter_i1 /end REF_MEASUREMENT
/end GROUP
/begin GROUP Arizona_base_GOAT_Homing_Memory_block_for_homing_during_trials "Arizona_base_GOAT/Homing/Memory block for homing during trials"
 /begin SUB_GROUP Arizona_base_GOAT_Homing_Memory_block_for_homing_during_trials_Memory_phi Arizona_base_GOAT_Homing_Memory_block_for_homing_during_trials_Memory_x Arizona_base_GOAT_Homing_Memory_block_for_homing_during_trials_Memory_y /end SUB_GROUP
/end GROUP
/begin GROUP Arizona_base_GOAT_Homing_Memory_block_for_homing_during_trials_Memory_phi "Arizona_base_GOAT/Homing/Memory block for homing during trials/Memory_phi"
 /begin REF_CHARACTERISTIC Arizona_base_GOAT_cal_impl.Delay1_InitialCondition_l Arizona_base_GOAT_cal_impl.Delay_InitialCondition_a Arizona_base_GOAT_cal_impl.Switch1_Threshold_e Arizona_base_GOAT_cal_impl.Switch_Threshold_l /end REF_CHARACTERISTIC
 /begin REF_MEASUREMENT Arizona_base_GOAT_B.AddphiHome Arizona_base_GOAT_B.Delay1_b Arizona_base_GOAT_B.Delay2 Arizona_base_GOAT_B.Delay_j Arizona_base_GOAT_B.Memory_loop_phi Arizona_base_GOAT_B.Switch1_c Arizona_base_GOAT_B.main Arizona_base_GOAT_DW.Delay1_DSTATE_o Arizona_base_GOAT_DW.Delay_DSTATE_h /end REF_MEASUREMENT
/end GROUP
/begin GROUP Arizona_base_GOAT_Homing_Memory_block_for_homing_during_trials_Memory_x "Arizona_base_GOAT/Homing/Memory block for homing during trials/Memory_x"
 /begin REF_CHARACTERISTIC Arizona_base_GOAT_cal_impl.Delay1_InitialCondition_mu Arizona_base_GOAT_cal_impl.Delay_InitialCondition_d Arizona_base_GOAT_cal_impl.Switch1_Threshold_m Arizona_base_GOAT_cal_impl.Switch_Threshold_b /end REF_CHARACTERISTIC
 /begin REF_MEASUREMENT Arizona_base_GOAT_B.AddxHome Arizona_base_GOAT_B.Delay1_g Arizona_base_GOAT_B.Delay2 Arizona_base_GOAT_B.Delay_m Arizona_base_GOAT_B.Memory_loop_x Arizona_base_GOAT_B.Sum_k Arizona_base_GOAT_B.Switch1_h Arizona_base_GOAT_DW.Delay1_DSTATE_i Arizona_base_GOAT_DW.Delay_DSTATE_j /end REF_MEASUREMENT
/end GROUP
/begin GROUP Arizona_base_GOAT_Homing_Memory_block_for_homing_during_trials_Memory_y "Arizona_base_GOAT/Homing/Memory block for homing during trials/Memory_y"
 /begin REF_CHARACTERISTIC Arizona_base_GOAT_cal_impl.Delay1_InitialCondition Arizona_base_GOAT_cal_impl.Delay_InitialCondition_o Arizona_base_GOAT_cal_impl.Switch1_Threshold Arizona_base_GOAT_cal_impl.Switch_Threshold_o /end REF_CHARACTERISTIC
 /begin REF_MEASUREMENT Arizona_base_GOAT_B.AddyHome Arizona_base_GOAT_B.Delay Arizona_base_GOAT_B.Delay1 Arizona_base_GOAT_B.Delay2 Arizona_base_GOAT_B.Memory_loop_y Arizona_base_GOAT_B.Sum_o Arizona_base_GOAT_B.Switch1 Arizona_base_GOAT_DW.Delay1_DSTATE Arizona_base_GOAT_DW.Delay_DSTATE /end REF_MEASUREMENT
/end GROUP
/begin GROUP Arizona_base_GOAT_IO_Arizona "Arizona_base_GOAT/IO Arizona"
 /begin REF_CHARACTERISTIC Arizona_base_GOAT_cal_impl.Analoginput1_P1 Arizona_base_GOAT_cal_impl.Analoginput1_P10 Arizona_base_GOAT_cal_impl.Analoginput1_P11 Arizona_base_GOAT_cal_impl.Analoginput1_P12 Arizona_base_GOAT_cal_impl.Analoginput1_P2 Arizona_base_GOAT_cal_impl.Analoginput1_P3 Arizona_base_GOAT_cal_impl.Analoginput1_P4 Arizona_base_GOAT_cal_impl.Analoginput1_P5 Arizona_base_GOAT_cal_impl.Analoginput1_P6 Arizona_base_GOAT_cal_impl.Analoginput1_P7 Arizona_base_GOAT_cal_impl.Analoginput1_P8 Arizona_base_GOAT_cal_impl.Analoginput1_P9 Arizona_base_GOAT_cal_impl.Analogoutput2_P1 Arizona_base_GOAT_cal_impl.Analogoutput2_P10 Arizona_base_GOAT_cal_impl.Analogoutput2_P11 Arizona_base_GOAT_cal_impl.Analogoutput2_P12 Arizona_base_GOAT_cal_impl.Analogoutput2_P13 Arizona_base_GOAT_cal_impl.Analogoutput2_P14 Arizona_base_GOAT_cal_impl.Analogoutput2_P2 Arizona_base_GOAT_cal_impl.Analogoutput2_P3 Arizona_base_GOAT_cal_impl.Analogoutput2_P4 Arizona_base_GOAT_cal_impl.Analogoutput2_P5 Arizona_base_GOAT_cal_impl.Analogoutput2_P6 Arizona_base_GOAT_cal_impl.Analogoutput2_P7 Arizona_base_GOAT_cal_impl.Analogoutput2_P8 Arizona_base_GOAT_cal_impl.Analogoutput2_P9 Arizona_base_GOAT_cal_impl.Calibration1_Gain Arizona_base_GOAT_cal_impl.Calibration2_Gain Arizona_base_GOAT_cal_impl.Calibration3_Gain Arizona_base_GOAT_cal_impl.Calibration4_Gain Arizona_base_GOAT_cal_impl.Calibration5_Gain Arizona_base_GOAT_cal_impl.Calibration6_Gain Arizona_base_GOAT_cal_impl.Cariagesecundair_P1 Arizona_base_GOAT_cal_impl.Cariagesecundair_P10 Arizona_base_GOAT_cal_impl.Cariagesecundair_P11 Arizona_base_GOAT_cal_impl.Cariagesecundair_P12 Arizona_base_GOAT_cal_impl.Cariagesecundair_P13 Arizona_base_GOAT_cal_impl.Cariagesecundair_P14 Arizona_base_GOAT_cal_impl.Cariagesecundair_P15 Arizona_base_GOAT_cal_impl.Cariagesecundair_P16 Arizona_base_GOAT_cal_impl.Cariagesecundair_P17 Arizona_base_GOAT_cal_impl.Cariagesecundair_P18 Arizona_base_GOAT_cal_impl.Cariagesecundair_P19 Arizona_base_GOAT_cal_impl.Cariagesecundair_P2 Arizona_base_GOAT_cal_impl.Cariagesecundair_P20 Arizona_base_GOAT_cal_impl.Cariagesecundair_P21 Arizona_base_GOAT_cal_impl.Cariagesecundair_P22 Arizona_base_GOAT_cal_impl.Cariagesecundair_P23 Arizona_base_GOAT_cal_impl.Cariagesecundair_P24 Arizona_base_GOAT_cal_impl.Cariagesecundair_P3 Arizona_base_GOAT_cal_impl.Cariagesecundair_P4 Arizona_base_GOAT_cal_impl.Cariagesecundair_P5 Arizona_base_GOAT_cal_impl.Cariagesecundair_P6 Arizona_base_GOAT_cal_impl.Cariagesecundair_P7 Arizona_base_GOAT_cal_impl.Cariagesecundair_P8 Arizona_base_GOAT_cal_impl.Cariagesecundair_P9 Arizona_base_GOAT_cal_impl.Carriageencoder_P1 Arizona_base_GOAT_cal_impl.Carriageencoder_P10 Arizona_base_GOAT_cal_impl.Carriageencoder_P11 Arizona_base_GOAT_cal_impl.Carriageencoder_P12 Arizona_base_GOAT_cal_impl.Carriageencoder_P13 Arizona_base_GOAT_cal_impl.Carriageencoder_P14 Arizona_base_GOAT_cal_impl.Carriageencoder_P15 Arizona_base_GOAT_cal_impl.Carriageencoder_P16 Arizona_base_GOAT_cal_impl.Carriageencoder_P17 Arizona_base_GOAT_cal_impl.Carriageencoder_P18 Arizona_base_GOAT_cal_impl.Carriageencoder_P19 Arizona_base_GOAT_cal_impl.Carriageencoder_P2 Arizona_base_GOAT_cal_impl.Carriageencoder_P20 Arizona_base_GOAT_cal_impl.Carriageencoder_P21 Arizona_base_GOAT_cal_impl.Carriageencoder_P22 Arizona_base_GOAT_cal_impl.Carriageencoder_P23 Arizona_base_GOAT_cal_impl.Carriageencoder_P24 Arizona_base_GOAT_cal_impl.Carriageencoder_P3 Arizona_base_GOAT_cal_impl.Carriageencoder_P4 Arizona_base_GOAT_cal_impl.Carriageencoder_P5 Arizona_base_GOAT_cal_impl.Carriageencoder_P6 Arizona_base_GOAT_cal_impl.Carriageencoder_P7 Arizona_base_GOAT_cal_impl.Carriageencoder_P8 Arizona_base_GOAT_cal_impl.Carriageencoder_P9 Arizona_base_GOAT_cal_impl.DILimitCarriage_P1 Arizona_base_GOAT_cal_impl.DILimitCarriage_P2 Arizona_base_GOAT_cal_impl.DILimitCarriage_P3 Arizona_base_GOAT_cal_impl.DILimitCarriage_P4 Arizona_base_GOAT_cal_impl.DILimitCarriage_P5 Arizona_base_GOAT_cal_impl.DILimitCarriage_P6 Arizona_base_GOAT_cal_impl.DILimitCarriagesecundairwerk_ix Arizona_base_GOAT_cal_impl.DILimitCarriagesecundairwerk_nn Arizona_base_GOAT_cal_impl.DILimitCarriagesecundairwerkt_a Arizona_base_GOAT_cal_impl.DILimitCarriagesecundairwerkt_g Arizona_base_GOAT_cal_impl.DILimitCarriagesecundairwerkt_l Arizona_base_GOAT_cal_impl.DILimitCarriagesecundairwerkt_n Arizona_base_GOAT_cal_impl.DILimitGantryx1GantryxR_P1 Arizona_base_GOAT_cal_impl.DILimitGantryx1GantryxR_P2 Arizona_base_GOAT_cal_impl.DILimitGantryx1GantryxR_P3 Arizona_base_GOAT_cal_impl.DILimitGantryx1GantryxR_P4 Arizona_base_GOAT_cal_impl.DILimitGantryx1GantryxR_P5 Arizona_base_GOAT_cal_impl.DILimitGantryx1GantryxR_P6 Arizona_base_GOAT_cal_impl.DILimitGantryx1secundairGant_du Arizona_base_GOAT_cal_impl.DILimitGantryx1secundairGant_ir Arizona_base_GOAT_cal_impl.DILimitGantryx1secundairGant_ns Arizona_base_GOAT_cal_impl.DILimitGantryx1secundairGantr_b Arizona_base_GOAT_cal_impl.DILimitGantryx1secundairGantr_d Arizona_base_GOAT_cal_impl.DILimitGantryx1secundairGantr_n Arizona_base_GOAT_cal_impl.DILimitGantryx2GantryxL_P1 Arizona_base_GOAT_cal_impl.DILimitGantryx2GantryxL_P2 Arizona_base_GOAT_cal_impl.DILimitGantryx2GantryxL_P3 Arizona_base_GOAT_cal_impl.DILimitGantryx2GantryxL_P4 Arizona_base_GOAT_cal_impl.DILimitGantryx2GantryxL_P5 Arizona_base_GOAT_cal_impl.DILimitGantryx2GantryxL_P6 Arizona_base_GOAT_cal_impl.DILimitGantryx2secundairGant_dj Arizona_base_GOAT_cal_impl.DILimitGantryx2secundairGantr_a Arizona_base_GOAT_cal_impl.DILimitGantryx2secundairGantr_d Arizona_base_GOAT_cal_impl.DILimitGantryx2secundairGantr_f Arizona_base_GOAT_cal_impl.DILimitGantryx2secundairGantr_l Arizona_base_GOAT_cal_impl.DILimitGantryx2secundairGantr_o Arizona_base_GOAT_cal_impl.DIblacksoftwarebutton_P1 Arizona_base_GOAT_cal_impl.DIblacksoftwarebutton_P2 Arizona_base_GOAT_cal_impl.DIblacksoftwarebutton_P3 Arizona_base_GOAT_cal_impl.DIblacksoftwarebutton_P4 Arizona_base_GOAT_cal_impl.DIblacksoftwarebutton_P5 Arizona_base_GOAT_cal_impl.DIblacksoftwarebutton_P6 Arizona_base_GOAT_cal_impl.DIcarriageampfaultstatus_P1 Arizona_base_GOAT_cal_impl.DIcarriageampfaultstatus_P2 Arizona_base_GOAT_cal_impl.DIcarriageampfaultstatus_P3 Arizona_base_GOAT_cal_impl.DIcarriageampfaultstatus_P4 Arizona_base_GOAT_cal_impl.DIcarriageampfaultstatus_P5 Arizona_base_GOAT_cal_impl.DIcarriageampfaultstatus_P6 Arizona_base_GOAT_cal_impl.DIgantryx1faultstatus_P1 Arizona_base_GOAT_cal_impl.DIgantryx1faultstatus_P2 Arizona_base_GOAT_cal_impl.DIgantryx1faultstatus_P3 Arizona_base_GOAT_cal_impl.DIgantryx1faultstatus_P4 Arizona_base_GOAT_cal_impl.DIgantryx1faultstatus_P5 Arizona_base_GOAT_cal_impl.DIgantryx1faultstatus_P6 Arizona_base_GOAT_cal_impl.DIgantryx2faultstatus_P1 Arizona_base_GOAT_cal_impl.DIgantryx2faultstatus_P2 Arizona_base_GOAT_cal_impl.DIgantryx2faultstatus_P3 Arizona_base_GOAT_cal_impl.DIgantryx2faultstatus_P4 Arizona_base_GOAT_cal_impl.DIgantryx2faultstatus_P5 Arizona_base_GOAT_cal_impl.DIgantryx2faultstatus_P6 Arizona_base_GOAT_cal_impl.DIredsoftwarebutton_P1 Arizona_base_GOAT_cal_impl.DIredsoftwarebutton_P2 Arizona_base_GOAT_cal_impl.DIredsoftwarebutton_P3 Arizona_base_GOAT_cal_impl.DIredsoftwarebutton_P4 Arizona_base_GOAT_cal_impl.DIredsoftwarebutton_P5 Arizona_base_GOAT_cal_impl.DIredsoftwarebutton_P6 Arizona_base_GOAT_cal_impl.DOInhibitCarriage_P1 Arizona_base_GOAT_cal_impl.DOInhibitCarriage_P2 Arizona_base_GOAT_cal_impl.DOInhibitCarriage_P3 Arizona_base_GOAT_cal_impl.DOInhibitCarriage_P4 Arizona_base_GOAT_cal_impl.DOInhibitCarriage_P5 Arizona_base_GOAT_cal_impl.DOInhibitCarriage_P6 Arizona_base_GOAT_cal_impl.DOInhibitCarriage_P7 Arizona_base_GOAT_cal_impl.DOInhibitCarriage_P8 Arizona_base_GOAT_cal_impl.DOInhibitGantryx1GantryxR_P1 Arizona_base_GOAT_cal_impl.DOInhibitGantryx1GantryxR_P2 Arizona_base_GOAT_cal_impl.DOInhibitGantryx1GantryxR_P3 Arizona_base_GOAT_cal_impl.DOInhibitGantryx1GantryxR_P4 Arizona_base_GOAT_cal_impl.DOInhibitGantryx1GantryxR_P5 Arizona_base_GOAT_cal_impl.DOInhibitGantryx1GantryxR_P6 Arizona_base_GOAT_cal_impl.DOInhibitGantryx1GantryxR_P7 Arizona_base_GOAT_cal_impl.DOInhibitGantryx1GantryxR_P8 Arizona_base_GOAT_cal_impl.DOInhibitGantryx2DOGantryxL_P1 Arizona_base_GOAT_cal_impl.DOInhibitGantryx2DOGantryxL_P2 Arizona_base_GOAT_cal_impl.DOInhibitGantryx2DOGantryxL_P3 Arizona_base_GOAT_cal_impl.DOInhibitGantryx2DOGantryxL_P4 Arizona_base_GOAT_cal_impl.DOInhibitGantryx2DOGantryxL_P5 Arizona_base_GOAT_cal_impl.DOInhibitGantryx2DOGantryxL_P6 Arizona_base_GOAT_cal_impl.DOInhibitGantryx2DOGantryxL_P7 Arizona_base_GOAT_cal_impl.DOInhibitGantryx2DOGantryxL_P8 Arizona_base_GOAT_cal_impl.Gain10_Gain_n Arizona_base_GOAT_cal_impl.Gain1_Gain Arizona_base_GOAT_cal_impl.Gain5_Gain Arizona_base_GOAT_cal_impl.Gain6_Gain Arizona_base_GOAT_cal_impl.Gain7_Gain Arizona_base_GOAT_cal_impl.Gain8_Gain_l Arizona_base_GOAT_cal_impl.Gain9_Gain_j Arizona_base_GOAT_cal_impl.Gain_Gain Arizona_base_GOAT_cal_impl.Gaincarriagemotorcurrent_Gain Arizona_base_GOAT_cal_impl.Gaingantryx2motorcurrent1_Gain Arizona_base_GOAT_cal_impl.Gaingantryx2motorcurrent_Gain Arizona_base_GOAT_cal_impl.GantryX1secundair_P1 Arizona_base_GOAT_cal_impl.GantryX1secundair_P10 Arizona_base_GOAT_cal_impl.GantryX1secundair_P11 Arizona_base_GOAT_cal_impl.GantryX1secundair_P12 Arizona_base_GOAT_cal_impl.GantryX1secundair_P13 Arizona_base_GOAT_cal_impl.GantryX1secundair_P14 Arizona_base_GOAT_cal_impl.GantryX1secundair_P15 Arizona_base_GOAT_cal_impl.GantryX1secundair_P16 Arizona_base_GOAT_cal_impl.GantryX1secundair_P17 Arizona_base_GOAT_cal_impl.GantryX1secundair_P18 Arizona_base_GOAT_cal_impl.GantryX1secundair_P19 Arizona_base_GOAT_cal_impl.GantryX1secundair_P2 Arizona_base_GOAT_cal_impl.GantryX1secundair_P20 Arizona_base_GOAT_cal_impl.GantryX1secundair_P21 Arizona_base_GOAT_cal_impl.GantryX1secundair_P22 Arizona_base_GOAT_cal_impl.GantryX1secundair_P23 Arizona_base_GOAT_cal_impl.GantryX1secundair_P24 Arizona_base_GOAT_cal_impl.GantryX1secundair_P3 Arizona_base_GOAT_cal_impl.GantryX1secundair_P4 Arizona_base_GOAT_cal_impl.GantryX1secundair_P5 Arizona_base_GOAT_cal_impl.GantryX1secundair_P6 Arizona_base_GOAT_cal_impl.GantryX1secundair_P7 Arizona_base_GOAT_cal_impl.GantryX1secundair_P8 Arizona_base_GOAT_cal_impl.GantryX1secundair_P9 Arizona_base_GOAT_cal_impl.Gantryx1GantryxR_P1 Arizona_base_GOAT_cal_impl.Gantryx1GantryxR_P10 Arizona_base_GOAT_cal_impl.Gantryx1GantryxR_P11 Arizona_base_GOAT_cal_impl.Gantryx1GantryxR_P12 Arizona_base_GOAT_cal_impl.Gantryx1GantryxR_P13 Arizona_base_GOAT_cal_impl.Gantryx1GantryxR_P14 Arizona_base_GOAT_cal_impl.Gantryx1GantryxR_P15 Arizona_base_GOAT_cal_impl.Gantryx1GantryxR_P16 Arizona_base_GOAT_cal_impl.Gantryx1GantryxR_P17 Arizona_base_GOAT_cal_impl.Gantryx1GantryxR_P18 Arizona_base_GOAT_cal_impl.Gantryx1GantryxR_P19 Arizona_base_GOAT_cal_impl.Gantryx1GantryxR_P2 Arizona_base_GOAT_cal_impl.Gantryx1GantryxR_P20 Arizona_base_GOAT_cal_impl.Gantryx1GantryxR_P21 Arizona_base_GOAT_cal_impl.Gantryx1GantryxR_P22 Arizona_base_GOAT_cal_impl.Gantryx1GantryxR_P23 Arizona_base_GOAT_cal_impl.Gantryx1GantryxR_P24 Arizona_base_GOAT_cal_impl.Gantryx1GantryxR_P3 Arizona_base_GOAT_cal_impl.Gantryx1GantryxR_P4 Arizona_base_GOAT_cal_impl.Gantryx1GantryxR_P5 Arizona_base_GOAT_cal_impl.Gantryx1GantryxR_P6 Arizona_base_GOAT_cal_impl.Gantryx1GantryxR_P7 Arizona_base_GOAT_cal_impl.Gantryx1GantryxR_P8 Arizona_base_GOAT_cal_impl.Gantryx1GantryxR_P9 Arizona_base_GOAT_cal_impl.Gantryx2GantryxL_P1 Arizona_base_GOAT_cal_impl.Gantryx2GantryxL_P10 Arizona_base_GOAT_cal_impl.Gantryx2GantryxL_P11 Arizona_base_GOAT_cal_impl.Gantryx2GantryxL_P12 Arizona_base_GOAT_cal_impl.Gantryx2GantryxL_P13 Arizona_base_GOAT_cal_impl.Gantryx2GantryxL_P14 Arizona_base_GOAT_cal_impl.Gantryx2GantryxL_P15 Arizona_base_GOAT_cal_impl.Gantryx2GantryxL_P16 Arizona_base_GOAT_cal_impl.Gantryx2GantryxL_P17 Arizona_base_GOAT_cal_impl.Gantryx2GantryxL_P18 Arizona_base_GOAT_cal_impl.Gantryx2GantryxL_P19 Arizona_base_GOAT_cal_impl.Gantryx2GantryxL_P2 Arizona_base_GOAT_cal_impl.Gantryx2GantryxL_P20 Arizona_base_GOAT_cal_impl.Gantryx2GantryxL_P21 Arizona_base_GOAT_cal_impl.Gantryx2GantryxL_P22 Arizona_base_GOAT_cal_impl.Gantryx2GantryxL_P23 Arizona_base_GOAT_cal_impl.Gantryx2GantryxL_P24 Arizona_base_GOAT_cal_impl.Gantryx2GantryxL_P3 Arizona_base_GOAT_cal_impl.Gantryx2GantryxL_P4 Arizona_base_GOAT_cal_impl.Gantryx2GantryxL_P5 Arizona_base_GOAT_cal_impl.Gantryx2GantryxL_P6 Arizona_base_GOAT_cal_impl.Gantryx2GantryxL_P7 Arizona_base_GOAT_cal_impl.Gantryx2GantryxL_P8 Arizona_base_GOAT_cal_impl.Gantryx2GantryxL_P9 Arizona_base_GOAT_cal_impl.GentryX2secundair_P1 Arizona_base_GOAT_cal_impl.GentryX2secundair_P10 Arizona_base_GOAT_cal_impl.GentryX2secundair_P11 Arizona_base_GOAT_cal_impl.GentryX2secundair_P12 Arizona_base_GOAT_cal_impl.GentryX2secundair_P13 Arizona_base_GOAT_cal_impl.GentryX2secundair_P14 Arizona_base_GOAT_cal_impl.GentryX2secundair_P15 Arizona_base_GOAT_cal_impl.GentryX2secundair_P16 Arizona_base_GOAT_cal_impl.GentryX2secundair_P17 Arizona_base_GOAT_cal_impl.GentryX2secundair_P18 Arizona_base_GOAT_cal_impl.GentryX2secundair_P19 Arizona_base_GOAT_cal_impl.GentryX2secundair_P2 Arizona_base_GOAT_cal_impl.GentryX2secundair_P20 Arizona_base_GOAT_cal_impl.GentryX2secundair_P21 Arizona_base_GOAT_cal_impl.GentryX2secundair_P22 Arizona_base_GOAT_cal_impl.GentryX2secundair_P23 Arizona_base_GOAT_cal_impl.GentryX2secundair_P24 Arizona_base_GOAT_cal_impl.GentryX2secundair_P3 Arizona_base_GOAT_cal_impl.GentryX2secundair_P4 Arizona_base_GOAT_cal_impl.GentryX2secundair_P5 Arizona_base_GOAT_cal_impl.GentryX2secundair_P6 Arizona_base_GOAT_cal_impl.GentryX2secundair_P7 Arizona_base_GOAT_cal_impl.GentryX2secundair_P8 Arizona_base_GOAT_cal_impl.GentryX2secundair_P9 Arizona_base_GOAT_cal_impl.Setup1_P1 Arizona_base_GOAT_cal_impl.Setup1_P10 Arizona_base_GOAT_cal_impl.Setup1_P11 Arizona_base_GOAT_cal_impl.Setup1_P12 Arizona_base_GOAT_cal_impl.Setup1_P13 Arizona_base_GOAT_cal_impl.Setup1_P14 Arizona_base_GOAT_cal_impl.Setup1_P15 Arizona_base_GOAT_cal_impl.Setup1_P16 Arizona_base_GOAT_cal_impl.Setup1_P17 Arizona_base_GOAT_cal_impl.Setup1_P18 Arizona_base_GOAT_cal_impl.Setup1_P19 Arizona_base_GOAT_cal_impl.Setup1_P2 Arizona_base_GOAT_cal_impl.Setup1_P20 Arizona_base_GOAT_cal_impl.Setup1_P21 Arizona_base_GOAT_cal_impl.Setup1_P22 Arizona_base_GOAT_cal_impl.Setup1_P23 Arizona_base_GOAT_cal_impl.Setup1_P24 Arizona_base_GOAT_cal_impl.Setup1_P25 Arizona_base_GOAT_cal_impl.Setup1_P26 Arizona_base_GOAT_cal_impl.Setup1_P27 Arizona_base_GOAT_cal_impl.Setup1_P28 Arizona_base_GOAT_cal_impl.Setup1_P29 Arizona_base_GOAT_cal_impl.Setup1_P3 Arizona_base_GOAT_cal_impl.Setup1_P30 Arizona_base_GOAT_cal_impl.Setup1_P31 Arizona_base_GOAT_cal_impl.Setup1_P32 Arizona_base_GOAT_cal_impl.Setup1_P33 Arizona_base_GOAT_cal_impl.Setup1_P34 Arizona_base_GOAT_cal_impl.Setup1_P35 Arizona_base_GOAT_cal_impl.Setup1_P36 Arizona_base_GOAT_cal_impl.Setup1_P37 Arizona_base_GOAT_cal_impl.Setup1_P4 Arizona_base_GOAT_cal_impl.Setup1_P5 Arizona_base_GOAT_cal_impl.Setup1_P6 Arizona_base_GOAT_cal_impl.Setup1_P7 Arizona_base_GOAT_cal_impl.Setup1_P8 Arizona_base_GOAT_cal_impl.Setup1_P9 /end REF_CHARACTERISTIC
 /begin REF_MEASUREMENT Arizona_base_GOAT_B.AIcarriagevelocitymonitor Arizona_base_GOAT_B.Analoginput1_o2 Arizona_base_GOAT_B.Calibration1 Arizona_base_GOAT_B.Calibration2 Arizona_base_GOAT_B.Calibration3 Arizona_base_GOAT_B.Calibration4 Arizona_base_GOAT_B.Calibration5 Arizona_base_GOAT_B.Calibration6 Arizona_base_GOAT_B.Cariagesecundair Arizona_base_GOAT_B.Carriageencoder Arizona_base_GOAT_B.DIblacksoftwarebutton Arizona_base_GOAT_B.DIblacksofwarefunctionbutton Arizona_base_GOAT_B.DIcarriageamplifyerstatus Arizona_base_GOAT_B.DIcarriagelimitswitch Arizona_base_GOAT_B.DIcarriagelimitswitchsecundaird Arizona_base_GOAT_B.DIgantryx1amplifyerstatus Arizona_base_GOAT_B.DIgantryx1limitswitch Arizona_base_GOAT_B.DIgantryx1limitswitchsecundaird Arizona_base_GOAT_B.DIgantryx2amplifyerstatus Arizona_base_GOAT_B.DIgantryx2limitswitch Arizona_base_GOAT_B.DIgantryx2limitswitchsecundaird Arizona_base_GOAT_B.DIredsoftwarefunctionbutton Arizona_base_GOAT_B.GantryX1secundair Arizona_base_GOAT_B.Gantryx1GantryxR Arizona_base_GOAT_B.Gantryx2GantryxL Arizona_base_GOAT_B.GentryX2secundair Arizona_base_GOAT_B.analogvelin Arizona_base_GOAT_B.carriageamplifierenable Arizona_base_GOAT_B.carriagemotorvoltage Arizona_base_GOAT_B.carriagemotorvoltage_o Arizona_base_GOAT_B.encodercarriage Arizona_base_GOAT_B.encodergantryx1 Arizona_base_GOAT_B.encodergantryx2 Arizona_base_GOAT_B.gantryx1motorvoltage Arizona_base_GOAT_B.gantryx2motorvoltage Arizona_base_GOAT_B.gantryx_Lamplifierenable Arizona_base_GOAT_B.gantryx_Lmotorvoltage Arizona_base_GOAT_B.gantryx_Ramplifierenable Arizona_base_GOAT_B.gantryx_Rmotorvoltage Arizona_base_GOAT_B.u_loopback_yV Arizona_base_GOAT_B.x_L_secundairm Arizona_base_GOAT_B.x_R_secundairm Arizona_base_GOAT_B.y_secundairm Arizona_base_GOAT_DW.Analoginput1_PWORK Arizona_base_GOAT_DW.Analogoutput2_PWORK Arizona_base_GOAT_DW.Cariagesecundair_PWORK Arizona_base_GOAT_DW.Carriageencoder_PWORK Arizona_base_GOAT_DW.DILimitCarriage_PWORK Arizona_base_GOAT_DW.DILimitCarriagesecundairwerktni Arizona_base_GOAT_DW.DILimitGantryx1GantryxR_PWORK Arizona_base_GOAT_DW.DILimitGantryx1secundairGantryx Arizona_base_GOAT_DW.DILimitGantryx2GantryxL_PWORK Arizona_base_GOAT_DW.DILimitGantryx2secundairGantryx Arizona_base_GOAT_DW.DIblacksoftwarebutton_PWORK Arizona_base_GOAT_DW.DIcarriageampfaultstatus_PWORK Arizona_base_GOAT_DW.DIgantryx1faultstatus_PWORK Arizona_base_GOAT_DW.DIgantryx2faultstatus_PWORK Arizona_base_GOAT_DW.DIredsoftwarebutton_PWORK Arizona_base_GOAT_DW.DOInhibitCarriage_PWORK Arizona_base_GOAT_DW.DOInhibitGantryx1GantryxR_PWORK Arizona_base_GOAT_DW.DOInhibitGantryx2DOGantryxL_PWO Arizona_base_GOAT_DW.GantryX1secundair_PWORK Arizona_base_GOAT_DW.Gantryx1GantryxR_PWORK Arizona_base_GOAT_DW.Gantryx2GantryxL_PWORK Arizona_base_GOAT_DW.GentryX2secundair_PWORK Arizona_base_GOAT_DW.Setup_PWORK /end REF_MEASUREMENT
/end GROUP
/begin GROUP Arizona_base_GOAT_LTI_System "Arizona_base_GOAT/LTI System"
 /begin REF_CHARACTERISTIC Arizona_base_GOAT_cal_impl.Internal_A_g Arizona_base_GOAT_cal_impl.Internal_B_j Arizona_base_GOAT_cal_impl.Internal_C_l Arizona_base_GOAT_cal_impl.Internal_D_f Arizona_base_GOAT_cal_impl.Internal_InitialCondition_o /end REF_CHARACTERISTIC
 /begin REF_MEASUREMENT Arizona_base_GOAT_B.Internal_g Arizona_base_GOAT_B.e_ym Arizona_base_GOAT_DW.Internal_DSTATE_h /end REF_MEASUREMENT
/end GROUP
/begin GROUP Arizona_base_GOAT_LTI_System1 "Arizona_base_GOAT/LTI System1"
 /begin REF_CHARACTERISTIC Arizona_base_GOAT_cal_impl.Internal_A Arizona_base_GOAT_cal_impl.Internal_B Arizona_base_GOAT_cal_impl.Internal_C Arizona_base_GOAT_cal_impl.Internal_D Arizona_base_GOAT_cal_impl.Internal_InitialCondition /end REF_CHARACTERISTIC
 /begin REF_MEASUREMENT Arizona_base_GOAT_B.Internal Arizona_base_GOAT_B.e_xm Arizona_base_GOAT_DW.Internal_DSTATE /end REF_MEASUREMENT
/end GROUP
/begin GROUP Arizona_base_GOAT_LTI_System2 "Arizona_base_GOAT/LTI System2"
 /begin REF_CHARACTERISTIC Arizona_base_GOAT_cal_impl.Internal_A_p Arizona_base_GOAT_cal_impl.Internal_B_g Arizona_base_GOAT_cal_impl.Internal_C_i Arizona_base_GOAT_cal_impl.Internal_D_g Arizona_base_GOAT_cal_impl.Internal_InitialCondition_e /end REF_CHARACTERISTIC
 /begin REF_MEASUREMENT Arizona_base_GOAT_B.Internal_j Arizona_base_GOAT_B.e_phirad Arizona_base_GOAT_DW.Internal_DSTATE_l /end REF_MEASUREMENT
/end GROUP
/begin GROUP Arizona_base_GOAT_Penholder_mechanism1 "Arizona_base_GOAT/Penholder mechanism1"
 /begin SUB_GROUP Arizona_base_GOAT_Penholder_mechanism1_Motor_Theta Arizona_base_GOAT_Penholder_mechanism1_Motor_Z /end SUB_GROUP
 /begin REF_CHARACTERISTIC Arizona_base_GOAT_cal_impl.Gainonphi2_Gain Arizona_base_GOAT_cal_impl.Gainonphi3_Gain Arizona_base_GOAT_cal_impl.log_jogspeed_Gain /end REF_CHARACTERISTIC
 /begin REF_MEASUREMENT Arizona_base_GOAT_B.DataTypeConversion1 Arizona_base_GOAT_B.DataTypeConversion2 Arizona_base_GOAT_B.DataTypeConversion3 Arizona_base_GOAT_B.DataTypeConversionendtrial Arizona_base_GOAT_B.Gainonphi2 Arizona_base_GOAT_B.Gainonphi3 Arizona_base_GOAT_B.Switch1_hm Arizona_base_GOAT_B.active Arizona_base_GOAT_B.jogSpeed Arizona_base_GOAT_B.jogspeed_Theta Arizona_base_GOAT_B.jogspeed_Z Arizona_base_GOAT_DW.color_pos Arizona_base_GOAT_DW.counter Arizona_base_GOAT_DW.is_HOME Arizona_base_GOAT_DW.is_MAIN Arizona_base_GOAT_DW.is_ROTATION Arizona_base_GOAT_DW.is_VERTICAL Arizona_base_GOAT_DW.is_active_HOME Arizona_base_GOAT_DW.is_active_MAIN Arizona_base_GOAT_DW.is_active_ROTATION Arizona_base_GOAT_DW.is_active_VERTICAL Arizona_base_GOAT_DW.is_active_c4_Arizona_base_GOAT Arizona_base_GOAT_DW.is_c4_Arizona_base_GOAT Arizona_base_GOAT_DW.job Arizona_base_GOAT_DW.rot_change Arizona_base_GOAT_DW.sfEvent_l Arizona_base_GOAT_DW.temporalCounter_i1_b Arizona_base_GOAT_DW.temporalCounter_i2 Arizona_base_GOAT_DW.temporalCounter_i3 /end REF_MEASUREMENT
/end GROUP
/begin GROUP Arizona_base_GOAT_Penholder_mechanism1_Motor_Theta "Arizona_base_GOAT/Penholder mechanism1/Motor Theta"
 /begin SUB_GROUP Arizona_base_GOAT_Penholder_mechanism1_Motor_Theta_Compare_To_Zero Arizona_base_GOAT_Penholder_mechanism1_Motor_Theta_PWMcreator5 /end SUB_GROUP
 /begin REF_MEASUREMENT Arizona_base_GOAT_B.Abs Arizona_base_GOAT_B.Compare Arizona_base_GOAT_B.DataTypeConversion Arizona_base_GOAT_B.Gainonphi2 /end REF_MEASUREMENT
/end GROUP
/begin GROUP Arizona_base_GOAT_Penholder_mechanism1_Motor_Theta_Compare_To_Zero "Arizona_base_GOAT/Penholder mechanism1/Motor Theta/Compare
To Zero" /begin REF_CHARACTERISTIC Arizona_base_GOAT_cal_impl.Constant_Value_a /end REF_CHARACTERISTIC /begin REF_MEASUREMENT Arizona_base_GOAT_B.Abs Arizona_base_GOAT_B.Compare /end REF_MEASUREMENT /end GROUP
/begin GROUP Arizona_base_GOAT_Penholder_mechanism1_Motor_Theta_PWMcreator5 "Arizona_base_GOAT/Penholder mechanism1/Motor Theta/PWMcreator5"
 /begin SUB_GROUP Arizona_base_GOAT_Penholder_mechanism1_Motor_Theta_PWMcreator5_Compare_To_Constant /end SUB_GROUP
 /begin REF_CHARACTERISTIC Arizona_base_GOAT_cal_impl.Gain1_Gain_o Arizona_base_GOAT_cal_impl.Gain8_Gain_e Arizona_base_GOAT_cal_impl.Gain_Gain_c Arizona_base_GOAT_cal_impl.PWM1_Value Arizona_base_GOAT_cal_impl.Saturation2_LowerSat Arizona_base_GOAT_cal_impl.Saturation2_UpperSat Arizona_base_GOAT_cal_impl.basefreq_Value Arizona_base_GOAT_cal_impl.dutycycleblockwave1_Value Arizona_base_GOAT_cal_impl.dutycycleblockwave_Value /end REF_CHARACTERISTIC
 /begin REF_MEASUREMENT Arizona_base_GOAT_B.Abs1 Arizona_base_GOAT_B.Abs_d Arizona_base_GOAT_B.Compare_p Arizona_base_GOAT_B.Divide Arizona_base_GOAT_B.Divide1 Arizona_base_GOAT_B.Divide2 Arizona_base_GOAT_B.Divide3 Arizona_base_GOAT_B.Gain Arizona_base_GOAT_B.Gain1 Arizona_base_GOAT_B.Gain8 Arizona_base_GOAT_B.Gainonphi2 Arizona_base_GOAT_B.Sign2 Arizona_base_GOAT_B.Subtract Arizona_base_GOAT_B.Switch Arizona_base_GOAT_B.XtranMo_DIR /end REF_MEASUREMENT
/end GROUP
/begin GROUP Arizona_base_GOAT_Penholder_mechanism1_Motor_Theta_PWMcreator5_Compare_To_Constant "Arizona_base_GOAT/Penholder mechanism1/Motor Theta/PWMcreator5/Compare
To Constant" /begin REF_CHARACTERISTIC Arizona_base_GOAT_cal_impl.CompareToConstant_const /end REF_CHARACTERISTIC /begin REF_MEASUREMENT Arizona_base_GOAT_B.Abs1 Arizona_base_GOAT_B.Compare_p /end REF_MEASUREMENT /end GROUP
/begin GROUP Arizona_base_GOAT_Penholder_mechanism1_Motor_Z "Arizona_base_GOAT/Penholder mechanism1/Motor Z"
 /begin SUB_GROUP Arizona_base_GOAT_Penholder_mechanism1_Motor_Z_Compare_To_Zero1 Arizona_base_GOAT_Penholder_mechanism1_Motor_Z_PWMcreator1 /end SUB_GROUP
 /begin REF_MEASUREMENT Arizona_base_GOAT_B.Abs1_l Arizona_base_GOAT_B.Compare_l Arizona_base_GOAT_B.DataTypeConversion1_n Arizona_base_GOAT_B.Gainonphi3 /end REF_MEASUREMENT
/end GROUP
/begin GROUP Arizona_base_GOAT_Penholder_mechanism1_Motor_Z_Compare_To_Zero1 "Arizona_base_GOAT/Penholder mechanism1/Motor Z/Compare
To Zero1" /begin REF_CHARACTERISTIC Arizona_base_GOAT_cal_impl.Constant_Value_l /end REF_CHARACTERISTIC /begin REF_MEASUREMENT Arizona_base_GOAT_B.Abs1_l Arizona_base_GOAT_B.Compare_l /end REF_MEASUREMENT /end GROUP
/begin GROUP Arizona_base_GOAT_Penholder_mechanism1_Motor_Z_PWMcreator1 "Arizona_base_GOAT/Penholder mechanism1/Motor Z/PWMcreator1"
 /begin SUB_GROUP Arizona_base_GOAT_Penholder_mechanism1_Motor_Z_PWMcreator1_Compare_To_Constant /end SUB_GROUP
 /begin REF_CHARACTERISTIC Arizona_base_GOAT_cal_impl.Gain1_Gain_i Arizona_base_GOAT_cal_impl.Gain8_Gain_c Arizona_base_GOAT_cal_impl.Gain_Gain_f Arizona_base_GOAT_cal_impl.PWM1_Value_l Arizona_base_GOAT_cal_impl.Saturation2_LowerSat_e Arizona_base_GOAT_cal_impl.Saturation2_UpperSat_m Arizona_base_GOAT_cal_impl.basefreq_Value_i Arizona_base_GOAT_cal_impl.dutycycleblockwave1_Value_k Arizona_base_GOAT_cal_impl.dutycycleblockwave_Value_h /end REF_CHARACTERISTIC
 /begin REF_MEASUREMENT Arizona_base_GOAT_B.Abs1_m Arizona_base_GOAT_B.Abs_dw Arizona_base_GOAT_B.Compare_h Arizona_base_GOAT_B.Divide1_c Arizona_base_GOAT_B.Divide2_c Arizona_base_GOAT_B.Divide3_g Arizona_base_GOAT_B.Divide_b Arizona_base_GOAT_B.Gain1_d Arizona_base_GOAT_B.Gain8_o Arizona_base_GOAT_B.Gain_b Arizona_base_GOAT_B.Gainonphi3 Arizona_base_GOAT_B.Sign2_g Arizona_base_GOAT_B.Subtract_g Arizona_base_GOAT_B.Switch_i Arizona_base_GOAT_B.XtranMo_DIR_k /end REF_MEASUREMENT
/end GROUP
/begin GROUP Arizona_base_GOAT_Penholder_mechanism1_Motor_Z_PWMcreator1_Compare_To_Constant "Arizona_base_GOAT/Penholder mechanism1/Motor Z/PWMcreator1/Compare
To Constant" /begin REF_CHARACTERISTIC Arizona_base_GOAT_cal_impl.CompareToConstant_const_n /end REF_CHARACTERISTIC /begin REF_MEASUREMENT Arizona_base_GOAT_B.Abs1_m Arizona_base_GOAT_B.Compare_h /end REF_MEASUREMENT /end GROUP
/begin GROUP Arizona_base_GOAT_Safety "Arizona_base_GOAT/Safety"
 /begin SUB_GROUP Arizona_base_GOAT_Safety_Discrete_Derivative_output_x Arizona_base_GOAT_Safety_Discrete_Derivative_output_y /end SUB_GROUP
 /begin REF_CHARACTERISTIC Arizona_base_GOAT_cal_impl.Dct2lowpasscurrent_carriageAi_c Arizona_base_GOAT_cal_impl.Dct2lowpasscurrent_carriageAi_l Arizona_base_GOAT_cal_impl.Dct2lowpasscurrent_carriageAi_n Arizona_base_GOAT_cal_impl.Dct2lowpasscurrent_gantryAirb_a Arizona_base_GOAT_cal_impl.Dct2lowpasscurrent_gantryAirb_e Arizona_base_GOAT_cal_impl.Dct2lowpasscurrent_gantryAirb_m Arizona_base_GOAT_cal_impl.Dct2lowpassoutput_x_P1 Arizona_base_GOAT_cal_impl.Dct2lowpassoutput_x_P2 Arizona_base_GOAT_cal_impl.Dct2lowpassoutput_x_P3 Arizona_base_GOAT_cal_impl.Dct2lowpassoutput_y_P1 Arizona_base_GOAT_cal_impl.Dct2lowpassoutput_y_P2 Arizona_base_GOAT_cal_impl.Dct2lowpassoutput_y_P3 Arizona_base_GOAT_cal_impl.Enable_amplifier_xL_Value Arizona_base_GOAT_cal_impl.Enable_amplifier_xR_Value Arizona_base_GOAT_cal_impl.Enable_amplifier_y_Value /end REF_CHARACTERISTIC
 /begin REF_MEASUREMENT Arizona_base_GOAT_B.DataTypeConversionendtrial Arizona_base_GOAT_B.Dct2lowpasscurrent_carriageAirb Arizona_base_GOAT_B.Dct2lowpasscurrent_gantryAirbag Arizona_base_GOAT_B.Dct2lowpassoutput_x Arizona_base_GOAT_B.Dct2lowpassoutput_y Arizona_base_GOAT_B.Diff Arizona_base_GOAT_B.Diff_n Arizona_base_GOAT_B.Gainphi Arizona_base_GOAT_B.Gainx Arizona_base_GOAT_B.Sumcurrentx_L Arizona_base_GOAT_B.Sumcurrentx_R Arizona_base_GOAT_B.Switch1 Arizona_base_GOAT_B.Switch1_c Arizona_base_GOAT_B.Switch1_h Arizona_base_GOAT_B.carriageamplifierenable Arizona_base_GOAT_B.carriagemotorvoltage Arizona_base_GOAT_B.current_carriageAirbag Arizona_base_GOAT_B.current_gantryAirbag Arizona_base_GOAT_B.e_phirad Arizona_base_GOAT_B.e_xm Arizona_base_GOAT_B.e_ym Arizona_base_GOAT_B.enableAirbags Arizona_base_GOAT_B.encodercarriage Arizona_base_GOAT_B.gantryx_Lamplifierenable Arizona_base_GOAT_B.gantryx_Lmotorvoltage Arizona_base_GOAT_B.gantryx_Ramplifierenable Arizona_base_GOAT_B.gantryx_Rmotorvoltage Arizona_base_GOAT_B.phiNomrad Arizona_base_GOAT_B.stopSimulation Arizona_base_GOAT_B.u_yV Arizona_base_GOAT_B.xNomm Arizona_base_GOAT_B.yNomm Arizona_base_GOAT_DW.is_active_c3_Arizona_base_GOAT Arizona_base_GOAT_DW.is_active_carriageAirbag Arizona_base_GOAT_DW.is_active_errorAirbag Arizona_base_GOAT_DW.is_active_gantryAirbag Arizona_base_GOAT_DW.is_c3_Arizona_base_GOAT Arizona_base_GOAT_DW.is_carriageAirbag Arizona_base_GOAT_DW.is_errorAirbag Arizona_base_GOAT_DW.is_gantryAirbag Arizona_base_GOAT_DW.sfEvent_i /end REF_MEASUREMENT
/end GROUP
/begin GROUP Arizona_base_GOAT_Safety_Discrete_Derivative_output_x "Arizona_base_GOAT/Safety/Discrete Derivative
output_x"
 /begin REF_CHARACTERISTIC Arizona_base_GOAT_cal_impl.DiscreteDerivativeoutput_x_ICPr Arizona_base_GOAT_cal_impl.TSamp_WtEt_p /end REF_CHARACTERISTIC
 /begin REF_MEASUREMENT Arizona_base_GOAT_B.Dct2lowpassoutput_x Arizona_base_GOAT_B.Diff_n Arizona_base_GOAT_B.TSamp_n Arizona_base_GOAT_B.Uk1_o Arizona_base_GOAT_DW.UD_DSTATE_a /end REF_MEASUREMENT
/end GROUP
/begin GROUP Arizona_base_GOAT_Safety_Discrete_Derivative_output_y "Arizona_base_GOAT/Safety/Discrete Derivative
output_y"
 /begin REF_CHARACTERISTIC Arizona_base_GOAT_cal_impl.DiscreteDerivativeoutput_y_ICPr Arizona_base_GOAT_cal_impl.TSamp_WtEt /end REF_CHARACTERISTIC
 /begin REF_MEASUREMENT Arizona_base_GOAT_B.Dct2lowpassoutput_y Arizona_base_GOAT_B.Diff Arizona_base_GOAT_B.TSamp Arizona_base_GOAT_B.Uk1 Arizona_base_GOAT_DW.UD_DSTATE /end REF_MEASUREMENT
/end GROUP
/begin GROUP Arizona_base_GOAT_Trajectory "Arizona_base_GOAT/Trajectory"
 /begin SUB_GROUP Arizona_base_GOAT_Trajectory_Compare_To_Constant Arizona_base_GOAT_Trajectory_Resettable_Subsystem____Memory /end SUB_GROUP
 /begin REF_CHARACTERISTIC Arizona_base_GOAT_cal_impl.Constant_Value_e Arizona_base_GOAT_cal_impl.Delay_InitialCondition_g Arizona_base_GOAT_cal_impl.change_color_Y0 Arizona_base_GOAT_cal_impl.phiRef_Y0 Arizona_base_GOAT_cal_impl.set_cRef_Value Arizona_base_GOAT_cal_impl.set_phiRef_Value Arizona_base_GOAT_cal_impl.set_xRef_Value Arizona_base_GOAT_cal_impl.set_yRef_Value Arizona_base_GOAT_cal_impl.time_Y0 Arizona_base_GOAT_cal_impl.trialDone_Y0 Arizona_base_GOAT_cal_impl.xRef_Y0 Arizona_base_GOAT_cal_impl.yRef_Y0 /end REF_CHARACTERISTIC
 /begin REF_MEASUREMENT Arizona_base_GOAT_B.Compare_h2 Arizona_base_GOAT_B.Delay_c Arizona_base_GOAT_B.DirectLookupTablechange_color Arizona_base_GOAT_B.DirectLookupTablephiRef Arizona_base_GOAT_B.DirectLookupTablexRef Arizona_base_GOAT_B.LogicalOperator Arizona_base_GOAT_B.Memory Arizona_base_GOAT_B.Product Arizona_base_GOAT_B.Sum Arizona_base_GOAT_B.penholderActive Arizona_base_GOAT_B.time Arizona_base_GOAT_B.yref_check Arizona_base_GOAT_DW.Delay_DSTATE_k /end REF_MEASUREMENT
/end GROUP
/begin GROUP Arizona_base_GOAT_Trajectory_Compare_To_Constant "Arizona_base_GOAT/Trajectory/Compare
To Constant" /begin REF_MEASUREMENT Arizona_base_GOAT_B.Compare_h2 Arizona_base_GOAT_B.time /end REF_MEASUREMENT /end GROUP
/begin GROUP Arizona_base_GOAT_Trajectory_Resettable_Subsystem____Memory "Arizona_base_GOAT/Trajectory/Resettable
Subsystem // Memory" /begin REF_CHARACTERISTIC Arizona_base_GOAT_cal_impl.Memory_InitialCondition /end REF_CHARACTERISTIC
 /begin REF_MEASUREMENT Arizona_base_GOAT_B.Memory Arizona_base_GOAT_B.Sum Arizona_base_GOAT_DW.Memory_PreviousInput /end REF_MEASUREMENT
/end GROUP
/end MODULE
/end PROJECT
