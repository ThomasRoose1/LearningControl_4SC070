/******************************************************************************
* ASAP2 file: Arizona_all_IO.a2l
* Academic License - for use in teaching, academic research, and meeting
* course requirements at degree granting institutions only. Not for
* government, commercial, or other organizational use.
* Code generation for model "Arizona_all_IO".
* Model version : 1.42
* Simulink Coder version : 10.5 R2022a
* C source code generated on : Thu May 15 16:22:29 2025
* Target selection: slrealtime.tlc
* Embedded hardware selection: Intel->x86-64 (Linux 64)
* Code generation objectives: Unspecified
* Validation result: Not run
* (add additional file header information here)
******************************************************************************/ ASAP2_VERSION 1 71
/begin PROJECT ProjectName "Project Comment Goes Here"
/begin HEADER "Header Comments go here" /end HEADER
/begin MODULE ModuleName "Module Comment Goes Here"
/begin IF_DATA XCP
 /begin PROTOCOL_LAYER 0x0100 0x03E8 0x00C8 0x0000 0x0000 0x0000 0x0000 0x0000 0xFC 0x0578 BYTE_ORDER_MSB_LAST ADDRESS_GRANULARITY_BYTE OPTIONAL_CMD ALLOC_ODT_ENTRY OPTIONAL_CMD ALLOC_ODT OPTIONAL_CMD ALLOC_DAQ OPTIONAL_CMD FREE_DAQ OPTIONAL_CMD GET_DAQ_CLOCK OPTIONAL_CMD GET_DAQ_RESOLUTION_INFO OPTIONAL_CMD GET_DAQ_PROCESSOR_INFO OPTIONAL_CMD START_STOP_SYNCH OPTIONAL_CMD START_STOP_DAQ_LIST OPTIONAL_CMD SET_DAQ_LIST_MODE OPTIONAL_CMD WRITE_DAQ OPTIONAL_CMD SET_DAQ_PTR OPTIONAL_CMD GET_CAL_PAGE OPTIONAL_CMD SET_CAL_PAGE OPTIONAL_CMD COPY_CAL_PAGE OPTIONAL_CMD SHORT_DOWNLOAD OPTIONAL_CMD DOWNLOAD_MAX OPTIONAL_CMD DOWNLOAD OPTIONAL_CMD SHORT_UPLOAD OPTIONAL_CMD UPLOAD OPTIONAL_CMD SET_MTA OPTIONAL_CMD GET_SEGMENT_INFO OPTIONAL_CMD GET_PAGE_INFO OPTIONAL_CMD SET_SEGMENT_MODE OPTIONAL_CMD GET_SEGMENT_MODE OPTIONAL_CMD GET_PAG_PROCESSOR_INFO OPTIONAL_CMD MODIFY_BITS /end PROTOCOL_LAYER
 /begin DAQ DYNAMIC 0x0000 0x0080 0x00 OPTIMISATION_TYPE_DEFAULT ADDRESS_EXTENSION_FREE IDENTIFICATION_FIELD_TYPE_RELATIVE_WORD_ALIGNED GRANULARITY_ODT_ENTRY_SIZE_DAQ_BYTE 0xFF OVERLOAD_INDICATION_PID PRESCALER_SUPPORTED /begin STIM GRANULARITY_ODT_ENTRY_SIZE_STIM_BYTE 0xFF /end STIM /begin TIMESTAMP_SUPPORTED 0x0001 SIZE_DWORD UNIT_1US TIMESTAMP_FIXED /end TIMESTAMP_SUPPORTED /begin EVENT "1 ms" "1 ms" 0x0000 DAQ 0xFF 0x01 0x06 0x00 /end EVENT /end DAQ
 /begin XCP_ON_UDP_IP 0x0100 0x15B3 ADDRESS "192.168.7.5" /end XCP_ON_UDP_IP
/end IF_DATA
/begin MOD_PAR "MOD PAR Comment Goes Here"
 /begin MEMORY_SEGMENT Arizona_all_IO_cal_impl "Arizona_all_IO_cal_impl" DATA FLASH INTERN 0x0021D060 0x1E70 -1 -1 -1 -1 -1
  /begin IF_DATA XCP
   /begin SEGMENT 0x00 0x02 0x00 0x00 0x00
    /begin PAGE 0x00 ECU_ACCESS_DONT_CARE XCP_READ_ACCESS_DONT_CARE XCP_WRITE_ACCESS_NOT_ALLOWED /end PAGE
    /begin PAGE 0x01 ECU_ACCESS_DONT_CARE XCP_READ_ACCESS_DONT_CARE XCP_WRITE_ACCESS_DONT_CARE /end PAGE
   /end SEGMENT
  /end IF_DATA
 /end MEMORY_SEGMENT
/end MOD_PAR
/begin MOD_COMMON "Mod Common Comment Here" BYTE_ORDER MSB_LAST ALIGNMENT_BYTE 1 ALIGNMENT_WORD 2 ALIGNMENT_LONG 4 ALIGNMENT_FLOAT32_IEEE 4 ALIGNMENT_FLOAT64_IEEE 8 ALIGNMENT_INT64 8 /end MOD_COMMON
/begin CHARACTERISTIC Arizona_all_IO_cal_impl.Analoginput1_P1 "" VALUE 0x0021D508 Scalar_FLOAT64_IEEE 0 Arizona_all_IO_CM_double -1.7E+308 1.7E+308 /end CHARACTERISTIC
/begin CHARACTERISTIC Arizona_all_IO_cal_impl.Analoginput1_P10 "" VALUE 0x0021D668 Scalar_FLOAT64_IEEE 0 Arizona_all_IO_CM_double -1.7E+308 1.7E+308 /end CHARACTERISTIC
/begin CHARACTERISTIC Arizona_all_IO_cal_impl.Analoginput1_P11 "" VAL_BLK 0x0021D680 Scalar_FLOAT64_IEEE 0 Arizona_all_IO_CM_double -1.7E+308 1.7E+308 MATRIX_DIM 4 1 /end CHARACTERISTIC
/begin CHARACTERISTIC Arizona_all_IO_cal_impl.Analoginput1_P12 "" VALUE 0x0021D6B0 Scalar_FLOAT64_IEEE 0 Arizona_all_IO_CM_double -1.7E+308 1.7E+308 /end CHARACTERISTIC
/begin CHARACTERISTIC Arizona_all_IO_cal_impl.Analoginput1_P2 "" VALUE 0x0021D520 Scalar_FLOAT64_IEEE 0 Arizona_all_IO_CM_double -1.7E+308 1.7E+308 /end CHARACTERISTIC
/begin CHARACTERISTIC Arizona_all_IO_cal_impl.Analoginput1_P3 "" VALUE 0x0021D538 Scalar_FLOAT64_IEEE 0 Arizona_all_IO_CM_double -1.7E+308 1.7E+308 /end CHARACTERISTIC
/begin CHARACTERISTIC Arizona_all_IO_cal_impl.Analoginput1_P4 "" VALUE 0x0021D550 Scalar_FLOAT64_IEEE 0 Arizona_all_IO_CM_double -1.7E+308 1.7E+308 /end CHARACTERISTIC
/begin CHARACTERISTIC Arizona_all_IO_cal_impl.Analoginput1_P5 "" VALUE 0x0021D568 Scalar_FLOAT64_IEEE 0 Arizona_all_IO_CM_double -1.7E+308 1.7E+308 /end CHARACTERISTIC
/begin CHARACTERISTIC Arizona_all_IO_cal_impl.Analoginput1_P6 "" VAL_BLK 0x0021D580 Scalar_FLOAT64_IEEE 0 Arizona_all_IO_CM_double -1.7E+308 1.7E+308 MATRIX_DIM 2 1 /end CHARACTERISTIC
/begin CHARACTERISTIC Arizona_all_IO_cal_impl.Analoginput1_P7 "" VAL_BLK 0x0021D5A0 Scalar_FLOAT64_IEEE 0 Arizona_all_IO_CM_double -1.7E+308 1.7E+308 MATRIX_DIM 16 1 /end CHARACTERISTIC
/begin CHARACTERISTIC Arizona_all_IO_cal_impl.Analoginput1_P8 "" VAL_BLK 0x0021D630 Scalar_FLOAT64_IEEE 0 Arizona_all_IO_CM_double -1.7E+308 1.7E+308 MATRIX_DIM 2 1 /end CHARACTERISTIC
/begin CHARACTERISTIC Arizona_all_IO_cal_impl.Analoginput1_P9 "" VALUE 0x0021D650 Scalar_FLOAT64_IEEE 0 Arizona_all_IO_CM_double -1.7E+308 1.7E+308 /end CHARACTERISTIC
/begin CHARACTERISTIC Arizona_all_IO_cal_impl.Analogoutput2_P1 "" VALUE 0x0021D708 Scalar_FLOAT64_IEEE 0 Arizona_all_IO_CM_double -1.7E+308 1.7E+308 /end CHARACTERISTIC
/begin CHARACTERISTIC Arizona_all_IO_cal_impl.Analogoutput2_P10 "" VALUE 0x0021D840 Scalar_FLOAT64_IEEE 0 Arizona_all_IO_CM_double -1.7E+308 1.7E+308 /end CHARACTERISTIC
/begin CHARACTERISTIC Arizona_all_IO_cal_impl.Analogoutput2_P11 "" VALUE 0x0021D858 Scalar_FLOAT64_IEEE 0 Arizona_all_IO_CM_double -1.7E+308 1.7E+308 /end CHARACTERISTIC
/begin CHARACTERISTIC Arizona_all_IO_cal_impl.Analogoutput2_P12 "" VAL_BLK 0x0021D870 Scalar_FLOAT64_IEEE 0 Arizona_all_IO_CM_double -1.7E+308 1.7E+308 MATRIX_DIM 4 1 /end CHARACTERISTIC
/begin CHARACTERISTIC Arizona_all_IO_cal_impl.Analogoutput2_P13 "" VALUE 0x0021D8A0 Scalar_FLOAT64_IEEE 0 Arizona_all_IO_CM_double -1.7E+308 1.7E+308 /end CHARACTERISTIC
/begin CHARACTERISTIC Arizona_all_IO_cal_impl.Analogoutput2_P14 "" VALUE 0x0021D8B8 Scalar_FLOAT64_IEEE 0 Arizona_all_IO_CM_double -1.7E+308 1.7E+308 /end CHARACTERISTIC
/begin CHARACTERISTIC Arizona_all_IO_cal_impl.Analogoutput2_P2 "" VALUE 0x0021D720 Scalar_FLOAT64_IEEE 0 Arizona_all_IO_CM_double -1.7E+308 1.7E+308 /end CHARACTERISTIC
/begin CHARACTERISTIC Arizona_all_IO_cal_impl.Analogoutput2_P3 "" VALUE 0x0021D738 Scalar_FLOAT64_IEEE 0 Arizona_all_IO_CM_double -1.7E+308 1.7E+308 /end CHARACTERISTIC
/begin CHARACTERISTIC Arizona_all_IO_cal_impl.Analogoutput2_P4 "" VALUE 0x0021D750 Scalar_FLOAT64_IEEE 0 Arizona_all_IO_CM_double -1.7E+308 1.7E+308 /end CHARACTERISTIC
/begin CHARACTERISTIC Arizona_all_IO_cal_impl.Analogoutput2_P5 "" VAL_BLK 0x0021D768 Scalar_FLOAT64_IEEE 0 Arizona_all_IO_CM_double -1.7E+308 1.7E+308 MATRIX_DIM 3 1 /end CHARACTERISTIC
/begin CHARACTERISTIC Arizona_all_IO_cal_impl.Analogoutput2_P6 "" VAL_BLK 0x0021D790 Scalar_FLOAT64_IEEE 0 Arizona_all_IO_CM_double -1.7E+308 1.7E+308 MATRIX_DIM 4 1 /end CHARACTERISTIC
/begin CHARACTERISTIC Arizona_all_IO_cal_impl.Analogoutput2_P7 "" VAL_BLK 0x0021D7C0 Scalar_FLOAT64_IEEE 0 Arizona_all_IO_CM_double -1.7E+308 1.7E+308 MATRIX_DIM 4 1 /end CHARACTERISTIC
/begin CHARACTERISTIC Arizona_all_IO_cal_impl.Analogoutput2_P8 "" VAL_BLK 0x0021D7F0 Scalar_FLOAT64_IEEE 0 Arizona_all_IO_CM_double -1.7E+308 1.7E+308 MATRIX_DIM 3 1 /end CHARACTERISTIC
/begin CHARACTERISTIC Arizona_all_IO_cal_impl.Analogoutput2_P9 "" VAL_BLK 0x0021D818 Scalar_FLOAT64_IEEE 0 Arizona_all_IO_CM_double -1.7E+308 1.7E+308 MATRIX_DIM 3 1 /end CHARACTERISTIC
/begin CHARACTERISTIC Arizona_all_IO_cal_impl.Cariagesecundair_P1 "" VALUE 0x0021D8D0 Scalar_FLOAT64_IEEE 0 Arizona_all_IO_CM_double -1.7E+308 1.7E+308 /end CHARACTERISTIC
/begin CHARACTERISTIC Arizona_all_IO_cal_impl.Cariagesecundair_P10 "" VALUE 0x0021D9A8 Scalar_FLOAT64_IEEE 0 Arizona_all_IO_CM_double -1.7E+308 1.7E+308 /end CHARACTERISTIC
/begin CHARACTERISTIC Arizona_all_IO_cal_impl.Cariagesecundair_P11 "" VALUE 0x0021D9C0 Scalar_FLOAT64_IEEE 0 Arizona_all_IO_CM_double -1.7E+308 1.7E+308 /end CHARACTERISTIC
/begin CHARACTERISTIC Arizona_all_IO_cal_impl.Cariagesecundair_P12 "" VALUE 0x0021D9D8 Scalar_FLOAT64_IEEE 0 Arizona_all_IO_CM_double -1.7E+308 1.7E+308 /end CHARACTERISTIC
/begin CHARACTERISTIC Arizona_all_IO_cal_impl.Cariagesecundair_P13 "" VALUE 0x0021D9F0 Scalar_FLOAT64_IEEE 0 Arizona_all_IO_CM_double -1.7E+308 1.7E+308 /end CHARACTERISTIC
/begin CHARACTERISTIC Arizona_all_IO_cal_impl.Cariagesecundair_P14 "" VALUE 0x0021DA08 Scalar_FLOAT64_IEEE 0 Arizona_all_IO_CM_double -1.7E+308 1.7E+308 /end CHARACTERISTIC
/begin CHARACTERISTIC Arizona_all_IO_cal_impl.Cariagesecundair_P15 "" VALUE 0x0021DA20 Scalar_FLOAT64_IEEE 0 Arizona_all_IO_CM_double -1.7E+308 1.7E+308 /end CHARACTERISTIC
/begin CHARACTERISTIC Arizona_all_IO_cal_impl.Cariagesecundair_P16 "" VALUE 0x0021DA38 Scalar_FLOAT64_IEEE 0 Arizona_all_IO_CM_double -1.7E+308 1.7E+308 /end CHARACTERISTIC
/begin CHARACTERISTIC Arizona_all_IO_cal_impl.Cariagesecundair_P17 "" VALUE 0x0021DA50 Scalar_FLOAT64_IEEE 0 Arizona_all_IO_CM_double -1.7E+308 1.7E+308 /end CHARACTERISTIC
/begin CHARACTERISTIC Arizona_all_IO_cal_impl.Cariagesecundair_P18 "" VALUE 0x0021DA68 Scalar_FLOAT64_IEEE 0 Arizona_all_IO_CM_double -1.7E+308 1.7E+308 /end CHARACTERISTIC
/begin CHARACTERISTIC Arizona_all_IO_cal_impl.Cariagesecundair_P19 "" VALUE 0x0021DA80 Scalar_FLOAT64_IEEE 0 Arizona_all_IO_CM_double -1.7E+308 1.7E+308 /end CHARACTERISTIC
/begin CHARACTERISTIC Arizona_all_IO_cal_impl.Cariagesecundair_P2 "" VALUE 0x0021D8E8 Scalar_FLOAT64_IEEE 0 Arizona_all_IO_CM_double -1.7E+308 1.7E+308 /end CHARACTERISTIC
/begin CHARACTERISTIC Arizona_all_IO_cal_impl.Cariagesecundair_P20 "" VALUE 0x0021DA98 Scalar_FLOAT64_IEEE 0 Arizona_all_IO_CM_double -1.7E+308 1.7E+308 /end CHARACTERISTIC
/begin CHARACTERISTIC Arizona_all_IO_cal_impl.Cariagesecundair_P21 "" VALUE 0x0021DAB0 Scalar_FLOAT64_IEEE 0 Arizona_all_IO_CM_double -1.7E+308 1.7E+308 /end CHARACTERISTIC
/begin CHARACTERISTIC Arizona_all_IO_cal_impl.Cariagesecundair_P22 "" VALUE 0x0021DAC8 Scalar_FLOAT64_IEEE 0 Arizona_all_IO_CM_double -1.7E+308 1.7E+308 /end CHARACTERISTIC
/begin CHARACTERISTIC Arizona_all_IO_cal_impl.Cariagesecundair_P23 "" VALUE 0x0021DAE0 Scalar_FLOAT64_IEEE 0 Arizona_all_IO_CM_double -1.7E+308 1.7E+308 /end CHARACTERISTIC
/begin CHARACTERISTIC Arizona_all_IO_cal_impl.Cariagesecundair_P24 "" VALUE 0x0021DAF8 Scalar_FLOAT64_IEEE 0 Arizona_all_IO_CM_double -1.7E+308 1.7E+308 /end CHARACTERISTIC
/begin CHARACTERISTIC Arizona_all_IO_cal_impl.Cariagesecundair_P3 "" VALUE 0x0021D900 Scalar_FLOAT64_IEEE 0 Arizona_all_IO_CM_double -1.7E+308 1.7E+308 /end CHARACTERISTIC
/begin CHARACTERISTIC Arizona_all_IO_cal_impl.Cariagesecundair_P4 "" VALUE 0x0021D918 Scalar_FLOAT64_IEEE 0 Arizona_all_IO_CM_double -1.7E+308 1.7E+308 /end CHARACTERISTIC
/begin CHARACTERISTIC Arizona_all_IO_cal_impl.Cariagesecundair_P5 "" VALUE 0x0021D930 Scalar_FLOAT64_IEEE 0 Arizona_all_IO_CM_double -1.7E+308 1.7E+308 /end CHARACTERISTIC
/begin CHARACTERISTIC Arizona_all_IO_cal_impl.Cariagesecundair_P6 "" VALUE 0x0021D948 Scalar_FLOAT64_IEEE 0 Arizona_all_IO_CM_double -1.7E+308 1.7E+308 /end CHARACTERISTIC
/begin CHARACTERISTIC Arizona_all_IO_cal_impl.Cariagesecundair_P7 "" VALUE 0x0021D960 Scalar_FLOAT64_IEEE 0 Arizona_all_IO_CM_double -1.7E+308 1.7E+308 /end CHARACTERISTIC
/begin CHARACTERISTIC Arizona_all_IO_cal_impl.Cariagesecundair_P8 "" VALUE 0x0021D978 Scalar_FLOAT64_IEEE 0 Arizona_all_IO_CM_double -1.7E+308 1.7E+308 /end CHARACTERISTIC
/begin CHARACTERISTIC Arizona_all_IO_cal_impl.Cariagesecundair_P9 "" VALUE 0x0021D990 Scalar_FLOAT64_IEEE 0 Arizona_all_IO_CM_double -1.7E+308 1.7E+308 /end CHARACTERISTIC
/begin CHARACTERISTIC Arizona_all_IO_cal_impl.Carriageenable0Inhibit1Enable_V "" VALUE 0x0021DB00 Scalar_FLOAT64_IEEE 0 Arizona_all_IO_CM_double -1.7E+308 1.7E+308 /end CHARACTERISTIC
/begin CHARACTERISTIC Arizona_all_IO_cal_impl.Carriageencoder_P1 "" VALUE 0x0021DBD8 Scalar_FLOAT64_IEEE 0 Arizona_all_IO_CM_double -1.7E+308 1.7E+308 /end CHARACTERISTIC
/begin CHARACTERISTIC Arizona_all_IO_cal_impl.Carriageencoder_P10 "" VALUE 0x0021DCB0 Scalar_FLOAT64_IEEE 0 Arizona_all_IO_CM_double -1.7E+308 1.7E+308 /end CHARACTERISTIC
/begin CHARACTERISTIC Arizona_all_IO_cal_impl.Carriageencoder_P11 "" VALUE 0x0021DCC8 Scalar_FLOAT64_IEEE 0 Arizona_all_IO_CM_double -1.7E+308 1.7E+308 /end CHARACTERISTIC
/begin CHARACTERISTIC Arizona_all_IO_cal_impl.Carriageencoder_P12 "" VALUE 0x0021DCE0 Scalar_FLOAT64_IEEE 0 Arizona_all_IO_CM_double -1.7E+308 1.7E+308 /end CHARACTERISTIC
/begin CHARACTERISTIC Arizona_all_IO_cal_impl.Carriageencoder_P13 "" VALUE 0x0021DCF8 Scalar_FLOAT64_IEEE 0 Arizona_all_IO_CM_double -1.7E+308 1.7E+308 /end CHARACTERISTIC
/begin CHARACTERISTIC Arizona_all_IO_cal_impl.Carriageencoder_P14 "" VALUE 0x0021DD10 Scalar_FLOAT64_IEEE 0 Arizona_all_IO_CM_double -1.7E+308 1.7E+308 /end CHARACTERISTIC
/begin CHARACTERISTIC Arizona_all_IO_cal_impl.Carriageencoder_P15 "" VALUE 0x0021DD28 Scalar_FLOAT64_IEEE 0 Arizona_all_IO_CM_double -1.7E+308 1.7E+308 /end CHARACTERISTIC
/begin CHARACTERISTIC Arizona_all_IO_cal_impl.Carriageencoder_P16 "" VALUE 0x0021DD40 Scalar_FLOAT64_IEEE 0 Arizona_all_IO_CM_double -1.7E+308 1.7E+308 /end CHARACTERISTIC
/begin CHARACTERISTIC Arizona_all_IO_cal_impl.Carriageencoder_P17 "" VALUE 0x0021DD58 Scalar_FLOAT64_IEEE 0 Arizona_all_IO_CM_double -1.7E+308 1.7E+308 /end CHARACTERISTIC
/begin CHARACTERISTIC Arizona_all_IO_cal_impl.Carriageencoder_P18 "" VALUE 0x0021DD70 Scalar_FLOAT64_IEEE 0 Arizona_all_IO_CM_double -1.7E+308 1.7E+308 /end CHARACTERISTIC
/begin CHARACTERISTIC Arizona_all_IO_cal_impl.Carriageencoder_P19 "" VALUE 0x0021DD88 Scalar_FLOAT64_IEEE 0 Arizona_all_IO_CM_double -1.7E+308 1.7E+308 /end CHARACTERISTIC
/begin CHARACTERISTIC Arizona_all_IO_cal_impl.Carriageencoder_P2 "" VALUE 0x0021DBF0 Scalar_FLOAT64_IEEE 0 Arizona_all_IO_CM_double -1.7E+308 1.7E+308 /end CHARACTERISTIC
/begin CHARACTERISTIC Arizona_all_IO_cal_impl.Carriageencoder_P20 "" VALUE 0x0021DDA0 Scalar_FLOAT64_IEEE 0 Arizona_all_IO_CM_double -1.7E+308 1.7E+308 /end CHARACTERISTIC
/begin CHARACTERISTIC Arizona_all_IO_cal_impl.Carriageencoder_P21 "" VALUE 0x0021DDB8 Scalar_FLOAT64_IEEE 0 Arizona_all_IO_CM_double -1.7E+308 1.7E+308 /end CHARACTERISTIC
/begin CHARACTERISTIC Arizona_all_IO_cal_impl.Carriageencoder_P22 "" VALUE 0x0021DDD0 Scalar_FLOAT64_IEEE 0 Arizona_all_IO_CM_double -1.7E+308 1.7E+308 /end CHARACTERISTIC
/begin CHARACTERISTIC Arizona_all_IO_cal_impl.Carriageencoder_P23 "" VALUE 0x0021DDE8 Scalar_FLOAT64_IEEE 0 Arizona_all_IO_CM_double -1.7E+308 1.7E+308 /end CHARACTERISTIC
/begin CHARACTERISTIC Arizona_all_IO_cal_impl.Carriageencoder_P24 "" VALUE 0x0021DE00 Scalar_FLOAT64_IEEE 0 Arizona_all_IO_CM_double -1.7E+308 1.7E+308 /end CHARACTERISTIC
/begin CHARACTERISTIC Arizona_all_IO_cal_impl.Carriageencoder_P3 "" VALUE 0x0021DC08 Scalar_FLOAT64_IEEE 0 Arizona_all_IO_CM_double -1.7E+308 1.7E+308 /end CHARACTERISTIC
/begin CHARACTERISTIC Arizona_all_IO_cal_impl.Carriageencoder_P4 "" VALUE 0x0021DC20 Scalar_FLOAT64_IEEE 0 Arizona_all_IO_CM_double -1.7E+308 1.7E+308 /end CHARACTERISTIC
/begin CHARACTERISTIC Arizona_all_IO_cal_impl.Carriageencoder_P5 "" VALUE 0x0021DC38 Scalar_FLOAT64_IEEE 0 Arizona_all_IO_CM_double -1.7E+308 1.7E+308 /end CHARACTERISTIC
/begin CHARACTERISTIC Arizona_all_IO_cal_impl.Carriageencoder_P6 "" VALUE 0x0021DC50 Scalar_FLOAT64_IEEE 0 Arizona_all_IO_CM_double -1.7E+308 1.7E+308 /end CHARACTERISTIC
/begin CHARACTERISTIC Arizona_all_IO_cal_impl.Carriageencoder_P7 "" VALUE 0x0021DC68 Scalar_FLOAT64_IEEE 0 Arizona_all_IO_CM_double -1.7E+308 1.7E+308 /end CHARACTERISTIC
/begin CHARACTERISTIC Arizona_all_IO_cal_impl.Carriageencoder_P8 "" VALUE 0x0021DC80 Scalar_FLOAT64_IEEE 0 Arizona_all_IO_CM_double -1.7E+308 1.7E+308 /end CHARACTERISTIC
/begin CHARACTERISTIC Arizona_all_IO_cal_impl.Carriageencoder_P9 "" VALUE 0x0021DC98 Scalar_FLOAT64_IEEE 0 Arizona_all_IO_CM_double -1.7E+308 1.7E+308 /end CHARACTERISTIC
/begin CHARACTERISTIC Arizona_all_IO_cal_impl.DILimitCarriage_P1 "" VALUE 0x0021DE18 Scalar_FLOAT64_IEEE 0 Arizona_all_IO_CM_double -1.7E+308 1.7E+308 /end CHARACTERISTIC
/begin CHARACTERISTIC Arizona_all_IO_cal_impl.DILimitCarriage_P2 "" VALUE 0x0021DE30 Scalar_FLOAT64_IEEE 0 Arizona_all_IO_CM_double -1.7E+308 1.7E+308 /end CHARACTERISTIC
/begin CHARACTERISTIC Arizona_all_IO_cal_impl.DILimitCarriage_P3 "" VALUE 0x0021DE48 Scalar_FLOAT64_IEEE 0 Arizona_all_IO_CM_double -1.7E+308 1.7E+308 /end CHARACTERISTIC
/begin CHARACTERISTIC Arizona_all_IO_cal_impl.DILimitCarriage_P4 "" VALUE 0x0021DE60 Scalar_FLOAT64_IEEE 0 Arizona_all_IO_CM_double -1.7E+308 1.7E+308 /end CHARACTERISTIC
/begin CHARACTERISTIC Arizona_all_IO_cal_impl.DILimitCarriage_P5 "" VALUE 0x0021DE78 Scalar_FLOAT64_IEEE 0 Arizona_all_IO_CM_double -1.7E+308 1.7E+308 /end CHARACTERISTIC
/begin CHARACTERISTIC Arizona_all_IO_cal_impl.DILimitCarriage_P6 "" VALUE 0x0021DE90 Scalar_FLOAT64_IEEE 0 Arizona_all_IO_CM_double -1.7E+308 1.7E+308 /end CHARACTERISTIC
/begin CHARACTERISTIC Arizona_all_IO_cal_impl.DILimitCarriagesecundairwerk_cm "" VALUE 0x0021DF08 Scalar_FLOAT64_IEEE 0 Arizona_all_IO_CM_double -1.7E+308 1.7E+308 /end CHARACTERISTIC
/begin CHARACTERISTIC Arizona_all_IO_cal_impl.DILimitCarriagesecundairwerkt_a "" VALUE 0x0021DED8 Scalar_FLOAT64_IEEE 0 Arizona_all_IO_CM_double -1.7E+308 1.7E+308 /end CHARACTERISTIC
/begin CHARACTERISTIC Arizona_all_IO_cal_impl.DILimitCarriagesecundairwerkt_c "" VALUE 0x0021DEC0 Scalar_FLOAT64_IEEE 0 Arizona_all_IO_CM_double -1.7E+308 1.7E+308 /end CHARACTERISTIC
/begin CHARACTERISTIC Arizona_all_IO_cal_impl.DILimitCarriagesecundairwerkt_k "" VALUE 0x0021DEA8 Scalar_FLOAT64_IEEE 0 Arizona_all_IO_CM_double -1.7E+308 1.7E+308 /end CHARACTERISTIC
/begin CHARACTERISTIC Arizona_all_IO_cal_impl.DILimitCarriagesecundairwerkt_n "" VALUE 0x0021DF20 Scalar_FLOAT64_IEEE 0 Arizona_all_IO_CM_double -1.7E+308 1.7E+308 /end CHARACTERISTIC
/begin CHARACTERISTIC Arizona_all_IO_cal_impl.DILimitCarriagesecundairwerkt_p "" VALUE 0x0021DEF0 Scalar_FLOAT64_IEEE 0 Arizona_all_IO_CM_double -1.7E+308 1.7E+308 /end CHARACTERISTIC
/begin CHARACTERISTIC Arizona_all_IO_cal_impl.DILimitGantryx1GantryxR_P1 "" VALUE 0x0021DF38 Scalar_FLOAT64_IEEE 0 Arizona_all_IO_CM_double -1.7E+308 1.7E+308 /end CHARACTERISTIC
/begin CHARACTERISTIC Arizona_all_IO_cal_impl.DILimitGantryx1GantryxR_P2 "" VALUE 0x0021DF50 Scalar_FLOAT64_IEEE 0 Arizona_all_IO_CM_double -1.7E+308 1.7E+308 /end CHARACTERISTIC
/begin CHARACTERISTIC Arizona_all_IO_cal_impl.DILimitGantryx1GantryxR_P3 "" VALUE 0x0021DF68 Scalar_FLOAT64_IEEE 0 Arizona_all_IO_CM_double -1.7E+308 1.7E+308 /end CHARACTERISTIC
/begin CHARACTERISTIC Arizona_all_IO_cal_impl.DILimitGantryx1GantryxR_P4 "" VALUE 0x0021DF80 Scalar_FLOAT64_IEEE 0 Arizona_all_IO_CM_double -1.7E+308 1.7E+308 /end CHARACTERISTIC
/begin CHARACTERISTIC Arizona_all_IO_cal_impl.DILimitGantryx1GantryxR_P5 "" VALUE 0x0021DF98 Scalar_FLOAT64_IEEE 0 Arizona_all_IO_CM_double -1.7E+308 1.7E+308 /end CHARACTERISTIC
/begin CHARACTERISTIC Arizona_all_IO_cal_impl.DILimitGantryx1GantryxR_P6 "" VALUE 0x0021DFB0 Scalar_FLOAT64_IEEE 0 Arizona_all_IO_CM_double -1.7E+308 1.7E+308 /end CHARACTERISTIC
/begin CHARACTERISTIC Arizona_all_IO_cal_impl.DILimitGantryx1secundairGant_bw "" VALUE 0x0021E028 Scalar_FLOAT64_IEEE 0 Arizona_all_IO_CM_double -1.7E+308 1.7E+308 /end CHARACTERISTIC
/begin CHARACTERISTIC Arizona_all_IO_cal_impl.DILimitGantryx1secundairGantr_b "" VALUE 0x0021DFF8 Scalar_FLOAT64_IEEE 0 Arizona_all_IO_CM_double -1.7E+308 1.7E+308 /end CHARACTERISTIC
/begin CHARACTERISTIC Arizona_all_IO_cal_impl.DILimitGantryx1secundairGantr_f "" VALUE 0x0021E010 Scalar_FLOAT64_IEEE 0 Arizona_all_IO_CM_double -1.7E+308 1.7E+308 /end CHARACTERISTIC
/begin CHARACTERISTIC Arizona_all_IO_cal_impl.DILimitGantryx1secundairGantr_h "" VALUE 0x0021DFC8 Scalar_FLOAT64_IEEE 0 Arizona_all_IO_CM_double -1.7E+308 1.7E+308 /end CHARACTERISTIC
/begin CHARACTERISTIC Arizona_all_IO_cal_impl.DILimitGantryx1secundairGantr_m "" VALUE 0x0021E040 Scalar_FLOAT64_IEEE 0 Arizona_all_IO_CM_double -1.7E+308 1.7E+308 /end CHARACTERISTIC
/begin CHARACTERISTIC Arizona_all_IO_cal_impl.DILimitGantryx1secundairGantr_o "" VALUE 0x0021DFE0 Scalar_FLOAT64_IEEE 0 Arizona_all_IO_CM_double -1.7E+308 1.7E+308 /end CHARACTERISTIC
/begin CHARACTERISTIC Arizona_all_IO_cal_impl.DILimitGantryx2GantryxL_P1 "" VALUE 0x0021E058 Scalar_FLOAT64_IEEE 0 Arizona_all_IO_CM_double -1.7E+308 1.7E+308 /end CHARACTERISTIC
/begin CHARACTERISTIC Arizona_all_IO_cal_impl.DILimitGantryx2GantryxL_P2 "" VALUE 0x0021E070 Scalar_FLOAT64_IEEE 0 Arizona_all_IO_CM_double -1.7E+308 1.7E+308 /end CHARACTERISTIC
/begin CHARACTERISTIC Arizona_all_IO_cal_impl.DILimitGantryx2GantryxL_P3 "" VALUE 0x0021E088 Scalar_FLOAT64_IEEE 0 Arizona_all_IO_CM_double -1.7E+308 1.7E+308 /end CHARACTERISTIC
/begin CHARACTERISTIC Arizona_all_IO_cal_impl.DILimitGantryx2GantryxL_P4 "" VALUE 0x0021E0A0 Scalar_FLOAT64_IEEE 0 Arizona_all_IO_CM_double -1.7E+308 1.7E+308 /end CHARACTERISTIC
/begin CHARACTERISTIC Arizona_all_IO_cal_impl.DILimitGantryx2GantryxL_P5 "" VALUE 0x0021E0B8 Scalar_FLOAT64_IEEE 0 Arizona_all_IO_CM_double -1.7E+308 1.7E+308 /end CHARACTERISTIC
/begin CHARACTERISTIC Arizona_all_IO_cal_impl.DILimitGantryx2GantryxL_P6 "" VALUE 0x0021E0D0 Scalar_FLOAT64_IEEE 0 Arizona_all_IO_CM_double -1.7E+308 1.7E+308 /end CHARACTERISTIC
/begin CHARACTERISTIC Arizona_all_IO_cal_impl.DILimitGantryx2secundairGantr_e "" VALUE 0x0021E100 Scalar_FLOAT64_IEEE 0 Arizona_all_IO_CM_double -1.7E+308 1.7E+308 /end CHARACTERISTIC
/begin CHARACTERISTIC Arizona_all_IO_cal_impl.DILimitGantryx2secundairGantr_g "" VALUE 0x0021E160 Scalar_FLOAT64_IEEE 0 Arizona_all_IO_CM_double -1.7E+308 1.7E+308 /end CHARACTERISTIC
/begin CHARACTERISTIC Arizona_all_IO_cal_impl.DILimitGantryx2secundairGantr_h "" VALUE 0x0021E148 Scalar_FLOAT64_IEEE 0 Arizona_all_IO_CM_double -1.7E+308 1.7E+308 /end CHARACTERISTIC
/begin CHARACTERISTIC Arizona_all_IO_cal_impl.DILimitGantryx2secundairGantr_i "" VALUE 0x0021E130 Scalar_FLOAT64_IEEE 0 Arizona_all_IO_CM_double -1.7E+308 1.7E+308 /end CHARACTERISTIC
/begin CHARACTERISTIC Arizona_all_IO_cal_impl.DILimitGantryx2secundairGantr_k "" VALUE 0x0021E0E8 Scalar_FLOAT64_IEEE 0 Arizona_all_IO_CM_double -1.7E+308 1.7E+308 /end CHARACTERISTIC
/begin CHARACTERISTIC Arizona_all_IO_cal_impl.DILimitGantryx2secundairGantr_n "" VALUE 0x0021E118 Scalar_FLOAT64_IEEE 0 Arizona_all_IO_CM_double -1.7E+308 1.7E+308 /end CHARACTERISTIC
/begin CHARACTERISTIC Arizona_all_IO_cal_impl.DIblacksoftwarebutton_P1 "" VALUE 0x0021E178 Scalar_FLOAT64_IEEE 0 Arizona_all_IO_CM_double -1.7E+308 1.7E+308 /end CHARACTERISTIC
/begin CHARACTERISTIC Arizona_all_IO_cal_impl.DIblacksoftwarebutton_P2 "" VALUE 0x0021E190 Scalar_FLOAT64_IEEE 0 Arizona_all_IO_CM_double -1.7E+308 1.7E+308 /end CHARACTERISTIC
/begin CHARACTERISTIC Arizona_all_IO_cal_impl.DIblacksoftwarebutton_P3 "" VALUE 0x0021E1A8 Scalar_FLOAT64_IEEE 0 Arizona_all_IO_CM_double -1.7E+308 1.7E+308 /end CHARACTERISTIC
/begin CHARACTERISTIC Arizona_all_IO_cal_impl.DIblacksoftwarebutton_P4 "" VALUE 0x0021E1C0 Scalar_FLOAT64_IEEE 0 Arizona_all_IO_CM_double -1.7E+308 1.7E+308 /end CHARACTERISTIC
/begin CHARACTERISTIC Arizona_all_IO_cal_impl.DIblacksoftwarebutton_P5 "" VALUE 0x0021E1D8 Scalar_FLOAT64_IEEE 0 Arizona_all_IO_CM_double -1.7E+308 1.7E+308 /end CHARACTERISTIC
/begin CHARACTERISTIC Arizona_all_IO_cal_impl.DIblacksoftwarebutton_P6 "" VALUE 0x0021E1F0 Scalar_FLOAT64_IEEE 0 Arizona_all_IO_CM_double -1.7E+308 1.7E+308 /end CHARACTERISTIC
/begin CHARACTERISTIC Arizona_all_IO_cal_impl.DIcarriageampfaultstatus_P1 "" VALUE 0x0021E208 Scalar_FLOAT64_IEEE 0 Arizona_all_IO_CM_double -1.7E+308 1.7E+308 /end CHARACTERISTIC
/begin CHARACTERISTIC Arizona_all_IO_cal_impl.DIcarriageampfaultstatus_P2 "" VALUE 0x0021E220 Scalar_FLOAT64_IEEE 0 Arizona_all_IO_CM_double -1.7E+308 1.7E+308 /end CHARACTERISTIC
/begin CHARACTERISTIC Arizona_all_IO_cal_impl.DIcarriageampfaultstatus_P3 "" VALUE 0x0021E238 Scalar_FLOAT64_IEEE 0 Arizona_all_IO_CM_double -1.7E+308 1.7E+308 /end CHARACTERISTIC
/begin CHARACTERISTIC Arizona_all_IO_cal_impl.DIcarriageampfaultstatus_P4 "" VALUE 0x0021E250 Scalar_FLOAT64_IEEE 0 Arizona_all_IO_CM_double -1.7E+308 1.7E+308 /end CHARACTERISTIC
/begin CHARACTERISTIC Arizona_all_IO_cal_impl.DIcarriageampfaultstatus_P5 "" VALUE 0x0021E268 Scalar_FLOAT64_IEEE 0 Arizona_all_IO_CM_double -1.7E+308 1.7E+308 /end CHARACTERISTIC
/begin CHARACTERISTIC Arizona_all_IO_cal_impl.DIcarriageampfaultstatus_P6 "" VALUE 0x0021E280 Scalar_FLOAT64_IEEE 0 Arizona_all_IO_CM_double -1.7E+308 1.7E+308 /end CHARACTERISTIC
/begin CHARACTERISTIC Arizona_all_IO_cal_impl.DIgantryx1faultstatus_P1 "" VALUE 0x0021E298 Scalar_FLOAT64_IEEE 0 Arizona_all_IO_CM_double -1.7E+308 1.7E+308 /end CHARACTERISTIC
/begin CHARACTERISTIC Arizona_all_IO_cal_impl.DIgantryx1faultstatus_P2 "" VALUE 0x0021E2B0 Scalar_FLOAT64_IEEE 0 Arizona_all_IO_CM_double -1.7E+308 1.7E+308 /end CHARACTERISTIC
/begin CHARACTERISTIC Arizona_all_IO_cal_impl.DIgantryx1faultstatus_P3 "" VALUE 0x0021E2C8 Scalar_FLOAT64_IEEE 0 Arizona_all_IO_CM_double -1.7E+308 1.7E+308 /end CHARACTERISTIC
/begin CHARACTERISTIC Arizona_all_IO_cal_impl.DIgantryx1faultstatus_P4 "" VALUE 0x0021E2E0 Scalar_FLOAT64_IEEE 0 Arizona_all_IO_CM_double -1.7E+308 1.7E+308 /end CHARACTERISTIC
/begin CHARACTERISTIC Arizona_all_IO_cal_impl.DIgantryx1faultstatus_P5 "" VALUE 0x0021E2F8 Scalar_FLOAT64_IEEE 0 Arizona_all_IO_CM_double -1.7E+308 1.7E+308 /end CHARACTERISTIC
/begin CHARACTERISTIC Arizona_all_IO_cal_impl.DIgantryx1faultstatus_P6 "" VALUE 0x0021E310 Scalar_FLOAT64_IEEE 0 Arizona_all_IO_CM_double -1.7E+308 1.7E+308 /end CHARACTERISTIC
/begin CHARACTERISTIC Arizona_all_IO_cal_impl.DIgantryx2faultstatus_P1 "" VALUE 0x0021E328 Scalar_FLOAT64_IEEE 0 Arizona_all_IO_CM_double -1.7E+308 1.7E+308 /end CHARACTERISTIC
/begin CHARACTERISTIC Arizona_all_IO_cal_impl.DIgantryx2faultstatus_P2 "" VALUE 0x0021E340 Scalar_FLOAT64_IEEE 0 Arizona_all_IO_CM_double -1.7E+308 1.7E+308 /end CHARACTERISTIC
/begin CHARACTERISTIC Arizona_all_IO_cal_impl.DIgantryx2faultstatus_P3 "" VALUE 0x0021E358 Scalar_FLOAT64_IEEE 0 Arizona_all_IO_CM_double -1.7E+308 1.7E+308 /end CHARACTERISTIC
/begin CHARACTERISTIC Arizona_all_IO_cal_impl.DIgantryx2faultstatus_P4 "" VALUE 0x0021E370 Scalar_FLOAT64_IEEE 0 Arizona_all_IO_CM_double -1.7E+308 1.7E+308 /end CHARACTERISTIC
/begin CHARACTERISTIC Arizona_all_IO_cal_impl.DIgantryx2faultstatus_P5 "" VALUE 0x0021E388 Scalar_FLOAT64_IEEE 0 Arizona_all_IO_CM_double -1.7E+308 1.7E+308 /end CHARACTERISTIC
/begin CHARACTERISTIC Arizona_all_IO_cal_impl.DIgantryx2faultstatus_P6 "" VALUE 0x0021E3A0 Scalar_FLOAT64_IEEE 0 Arizona_all_IO_CM_double -1.7E+308 1.7E+308 /end CHARACTERISTIC
/begin CHARACTERISTIC Arizona_all_IO_cal_impl.DIredsoftwarebutton_P1 "" VALUE 0x0021E3B8 Scalar_FLOAT64_IEEE 0 Arizona_all_IO_CM_double -1.7E+308 1.7E+308 /end CHARACTERISTIC
/begin CHARACTERISTIC Arizona_all_IO_cal_impl.DIredsoftwarebutton_P2 "" VALUE 0x0021E3D0 Scalar_FLOAT64_IEEE 0 Arizona_all_IO_CM_double -1.7E+308 1.7E+308 /end CHARACTERISTIC
/begin CHARACTERISTIC Arizona_all_IO_cal_impl.DIredsoftwarebutton_P3 "" VALUE 0x0021E3E8 Scalar_FLOAT64_IEEE 0 Arizona_all_IO_CM_double -1.7E+308 1.7E+308 /end CHARACTERISTIC
/begin CHARACTERISTIC Arizona_all_IO_cal_impl.DIredsoftwarebutton_P4 "" VALUE 0x0021E400 Scalar_FLOAT64_IEEE 0 Arizona_all_IO_CM_double -1.7E+308 1.7E+308 /end CHARACTERISTIC
/begin CHARACTERISTIC Arizona_all_IO_cal_impl.DIredsoftwarebutton_P5 "" VALUE 0x0021E418 Scalar_FLOAT64_IEEE 0 Arizona_all_IO_CM_double -1.7E+308 1.7E+308 /end CHARACTERISTIC
/begin CHARACTERISTIC Arizona_all_IO_cal_impl.DIredsoftwarebutton_P6 "" VALUE 0x0021E430 Scalar_FLOAT64_IEEE 0 Arizona_all_IO_CM_double -1.7E+308 1.7E+308 /end CHARACTERISTIC
/begin CHARACTERISTIC Arizona_all_IO_cal_impl.DOInhibitCarriage_P1 "" VALUE 0x0021DB18 Scalar_FLOAT64_IEEE 0 Arizona_all_IO_CM_double -1.7E+308 1.7E+308 /end CHARACTERISTIC
/begin CHARACTERISTIC Arizona_all_IO_cal_impl.DOInhibitCarriage_P2 "" VALUE 0x0021DB30 Scalar_FLOAT64_IEEE 0 Arizona_all_IO_CM_double -1.7E+308 1.7E+308 /end CHARACTERISTIC
/begin CHARACTERISTIC Arizona_all_IO_cal_impl.DOInhibitCarriage_P3 "" VALUE 0x0021DB48 Scalar_FLOAT64_IEEE 0 Arizona_all_IO_CM_double -1.7E+308 1.7E+308 /end CHARACTERISTIC
/begin CHARACTERISTIC Arizona_all_IO_cal_impl.DOInhibitCarriage_P4 "" VALUE 0x0021DB60 Scalar_FLOAT64_IEEE 0 Arizona_all_IO_CM_double -1.7E+308 1.7E+308 /end CHARACTERISTIC
/begin CHARACTERISTIC Arizona_all_IO_cal_impl.DOInhibitCarriage_P5 "" VALUE 0x0021DB78 Scalar_FLOAT64_IEEE 0 Arizona_all_IO_CM_double -1.7E+308 1.7E+308 /end CHARACTERISTIC
/begin CHARACTERISTIC Arizona_all_IO_cal_impl.DOInhibitCarriage_P6 "" VALUE 0x0021DB90 Scalar_FLOAT64_IEEE 0 Arizona_all_IO_CM_double -1.7E+308 1.7E+308 /end CHARACTERISTIC
/begin CHARACTERISTIC Arizona_all_IO_cal_impl.DOInhibitCarriage_P7 "" VALUE 0x0021DBA8 Scalar_FLOAT64_IEEE 0 Arizona_all_IO_CM_double -1.7E+308 1.7E+308 /end CHARACTERISTIC
/begin CHARACTERISTIC Arizona_all_IO_cal_impl.DOInhibitCarriage_P8 "" VALUE 0x0021DBC0 Scalar_FLOAT64_IEEE 0 Arizona_all_IO_CM_double -1.7E+308 1.7E+308 /end CHARACTERISTIC
/begin CHARACTERISTIC Arizona_all_IO_cal_impl.DOInhibitGantryx1GantryxR_P1 "" VALUE 0x0021E450 Scalar_FLOAT64_IEEE 0 Arizona_all_IO_CM_double -1.7E+308 1.7E+308 /end CHARACTERISTIC
/begin CHARACTERISTIC Arizona_all_IO_cal_impl.DOInhibitGantryx1GantryxR_P2 "" VALUE 0x0021E468 Scalar_FLOAT64_IEEE 0 Arizona_all_IO_CM_double -1.7E+308 1.7E+308 /end CHARACTERISTIC
/begin CHARACTERISTIC Arizona_all_IO_cal_impl.DOInhibitGantryx1GantryxR_P3 "" VALUE 0x0021E480 Scalar_FLOAT64_IEEE 0 Arizona_all_IO_CM_double -1.7E+308 1.7E+308 /end CHARACTERISTIC
/begin CHARACTERISTIC Arizona_all_IO_cal_impl.DOInhibitGantryx1GantryxR_P4 "" VALUE 0x0021E498 Scalar_FLOAT64_IEEE 0 Arizona_all_IO_CM_double -1.7E+308 1.7E+308 /end CHARACTERISTIC
/begin CHARACTERISTIC Arizona_all_IO_cal_impl.DOInhibitGantryx1GantryxR_P5 "" VALUE 0x0021E4B0 Scalar_FLOAT64_IEEE 0 Arizona_all_IO_CM_double -1.7E+308 1.7E+308 /end CHARACTERISTIC
/begin CHARACTERISTIC Arizona_all_IO_cal_impl.DOInhibitGantryx1GantryxR_P6 "" VALUE 0x0021E4C8 Scalar_FLOAT64_IEEE 0 Arizona_all_IO_CM_double -1.7E+308 1.7E+308 /end CHARACTERISTIC
/begin CHARACTERISTIC Arizona_all_IO_cal_impl.DOInhibitGantryx1GantryxR_P7 "" VALUE 0x0021E4E0 Scalar_FLOAT64_IEEE 0 Arizona_all_IO_CM_double -1.7E+308 1.7E+308 /end CHARACTERISTIC
/begin CHARACTERISTIC Arizona_all_IO_cal_impl.DOInhibitGantryx1GantryxR_P8 "" VALUE 0x0021E4F8 Scalar_FLOAT64_IEEE 0 Arizona_all_IO_CM_double -1.7E+308 1.7E+308 /end CHARACTERISTIC
/begin CHARACTERISTIC Arizona_all_IO_cal_impl.DOInhibitGantryx2DOGantryxL_P1 "" VALUE 0x0021E518 Scalar_FLOAT64_IEEE 0 Arizona_all_IO_CM_double -1.7E+308 1.7E+308 /end CHARACTERISTIC
/begin CHARACTERISTIC Arizona_all_IO_cal_impl.DOInhibitGantryx2DOGantryxL_P2 "" VALUE 0x0021E530 Scalar_FLOAT64_IEEE 0 Arizona_all_IO_CM_double -1.7E+308 1.7E+308 /end CHARACTERISTIC
/begin CHARACTERISTIC Arizona_all_IO_cal_impl.DOInhibitGantryx2DOGantryxL_P3 "" VALUE 0x0021E548 Scalar_FLOAT64_IEEE 0 Arizona_all_IO_CM_double -1.7E+308 1.7E+308 /end CHARACTERISTIC
/begin CHARACTERISTIC Arizona_all_IO_cal_impl.DOInhibitGantryx2DOGantryxL_P4 "" VALUE 0x0021E560 Scalar_FLOAT64_IEEE 0 Arizona_all_IO_CM_double -1.7E+308 1.7E+308 /end CHARACTERISTIC
/begin CHARACTERISTIC Arizona_all_IO_cal_impl.DOInhibitGantryx2DOGantryxL_P5 "" VALUE 0x0021E578 Scalar_FLOAT64_IEEE 0 Arizona_all_IO_CM_double -1.7E+308 1.7E+308 /end CHARACTERISTIC
/begin CHARACTERISTIC Arizona_all_IO_cal_impl.DOInhibitGantryx2DOGantryxL_P6 "" VALUE 0x0021E590 Scalar_FLOAT64_IEEE 0 Arizona_all_IO_CM_double -1.7E+308 1.7E+308 /end CHARACTERISTIC
/begin CHARACTERISTIC Arizona_all_IO_cal_impl.DOInhibitGantryx2DOGantryxL_P7 "" VALUE 0x0021E5A8 Scalar_FLOAT64_IEEE 0 Arizona_all_IO_CM_double -1.7E+308 1.7E+308 /end CHARACTERISTIC
/begin CHARACTERISTIC Arizona_all_IO_cal_impl.DOInhibitGantryx2DOGantryxL_P8 "" VALUE 0x0021E5C0 Scalar_FLOAT64_IEEE 0 Arizona_all_IO_CM_double -1.7E+308 1.7E+308 /end CHARACTERISTIC
/begin CHARACTERISTIC Arizona_all_IO_cal_impl.Gain1_Gain "" VALUE 0x0021D6D0 Scalar_FLOAT64_IEEE 0 Arizona_all_IO_CM_double -1.7E+308 1.7E+308 /end CHARACTERISTIC
/begin CHARACTERISTIC Arizona_all_IO_cal_impl.Gain2_Gain "" VALUE 0x0021D6E0 Scalar_FLOAT64_IEEE 0 Arizona_all_IO_CM_double -1.7E+308 1.7E+308 /end CHARACTERISTIC
/begin CHARACTERISTIC Arizona_all_IO_cal_impl.Gain3_Gain "" VALUE 0x0021D6E8 Scalar_FLOAT64_IEEE 0 Arizona_all_IO_CM_double -1.7E+308 1.7E+308 /end CHARACTERISTIC
/begin CHARACTERISTIC Arizona_all_IO_cal_impl.Gain4_Gain "" VALUE 0x0021D6F0 Scalar_FLOAT64_IEEE 0 Arizona_all_IO_CM_double -1.7E+308 1.7E+308 /end CHARACTERISTIC
/begin CHARACTERISTIC Arizona_all_IO_cal_impl.Gain5_Gain "" VALUE 0x0021D6D8 Scalar_FLOAT64_IEEE 0 Arizona_all_IO_CM_double -1.7E+308 1.7E+308 /end CHARACTERISTIC
/begin CHARACTERISTIC Arizona_all_IO_cal_impl.Gain9_Gain "" VALUE 0x0021E808 Scalar_FLOAT64_IEEE 0 Arizona_all_IO_CM_double -1.7E+308 1.7E+308 /end CHARACTERISTIC
/begin CHARACTERISTIC Arizona_all_IO_cal_impl.Gain_Gain "" VALUE 0x0021D6B8 Scalar_FLOAT64_IEEE 0 Arizona_all_IO_CM_double -1.7E+308 1.7E+308 /end CHARACTERISTIC
/begin CHARACTERISTIC Arizona_all_IO_cal_impl.GantryX1secundair_P1 "" VALUE 0x0021E820 Scalar_FLOAT64_IEEE 0 Arizona_all_IO_CM_double -1.7E+308 1.7E+308 /end CHARACTERISTIC
/begin CHARACTERISTIC Arizona_all_IO_cal_impl.GantryX1secundair_P10 "" VALUE 0x0021E8F8 Scalar_FLOAT64_IEEE 0 Arizona_all_IO_CM_double -1.7E+308 1.7E+308 /end CHARACTERISTIC
/begin CHARACTERISTIC Arizona_all_IO_cal_impl.GantryX1secundair_P11 "" VALUE 0x0021E910 Scalar_FLOAT64_IEEE 0 Arizona_all_IO_CM_double -1.7E+308 1.7E+308 /end CHARACTERISTIC
/begin CHARACTERISTIC Arizona_all_IO_cal_impl.GantryX1secundair_P12 "" VALUE 0x0021E928 Scalar_FLOAT64_IEEE 0 Arizona_all_IO_CM_double -1.7E+308 1.7E+308 /end CHARACTERISTIC
/begin CHARACTERISTIC Arizona_all_IO_cal_impl.GantryX1secundair_P13 "" VALUE 0x0021E940 Scalar_FLOAT64_IEEE 0 Arizona_all_IO_CM_double -1.7E+308 1.7E+308 /end CHARACTERISTIC
/begin CHARACTERISTIC Arizona_all_IO_cal_impl.GantryX1secundair_P14 "" VALUE 0x0021E958 Scalar_FLOAT64_IEEE 0 Arizona_all_IO_CM_double -1.7E+308 1.7E+308 /end CHARACTERISTIC
/begin CHARACTERISTIC Arizona_all_IO_cal_impl.GantryX1secundair_P15 "" VALUE 0x0021E970 Scalar_FLOAT64_IEEE 0 Arizona_all_IO_CM_double -1.7E+308 1.7E+308 /end CHARACTERISTIC
/begin CHARACTERISTIC Arizona_all_IO_cal_impl.GantryX1secundair_P16 "" VALUE 0x0021E988 Scalar_FLOAT64_IEEE 0 Arizona_all_IO_CM_double -1.7E+308 1.7E+308 /end CHARACTERISTIC
/begin CHARACTERISTIC Arizona_all_IO_cal_impl.GantryX1secundair_P17 "" VALUE 0x0021E9A0 Scalar_FLOAT64_IEEE 0 Arizona_all_IO_CM_double -1.7E+308 1.7E+308 /end CHARACTERISTIC
/begin CHARACTERISTIC Arizona_all_IO_cal_impl.GantryX1secundair_P18 "" VALUE 0x0021E9B8 Scalar_FLOAT64_IEEE 0 Arizona_all_IO_CM_double -1.7E+308 1.7E+308 /end CHARACTERISTIC
/begin CHARACTERISTIC Arizona_all_IO_cal_impl.GantryX1secundair_P19 "" VALUE 0x0021E9D0 Scalar_FLOAT64_IEEE 0 Arizona_all_IO_CM_double -1.7E+308 1.7E+308 /end CHARACTERISTIC
/begin CHARACTERISTIC Arizona_all_IO_cal_impl.GantryX1secundair_P2 "" VALUE 0x0021E838 Scalar_FLOAT64_IEEE 0 Arizona_all_IO_CM_double -1.7E+308 1.7E+308 /end CHARACTERISTIC
/begin CHARACTERISTIC Arizona_all_IO_cal_impl.GantryX1secundair_P20 "" VALUE 0x0021E9E8 Scalar_FLOAT64_IEEE 0 Arizona_all_IO_CM_double -1.7E+308 1.7E+308 /end CHARACTERISTIC
/begin CHARACTERISTIC Arizona_all_IO_cal_impl.GantryX1secundair_P21 "" VALUE 0x0021EA00 Scalar_FLOAT64_IEEE 0 Arizona_all_IO_CM_double -1.7E+308 1.7E+308 /end CHARACTERISTIC
/begin CHARACTERISTIC Arizona_all_IO_cal_impl.GantryX1secundair_P22 "" VALUE 0x0021EA18 Scalar_FLOAT64_IEEE 0 Arizona_all_IO_CM_double -1.7E+308 1.7E+308 /end CHARACTERISTIC
/begin CHARACTERISTIC Arizona_all_IO_cal_impl.GantryX1secundair_P23 "" VALUE 0x0021EA30 Scalar_FLOAT64_IEEE 0 Arizona_all_IO_CM_double -1.7E+308 1.7E+308 /end CHARACTERISTIC
/begin CHARACTERISTIC Arizona_all_IO_cal_impl.GantryX1secundair_P24 "" VALUE 0x0021EA48 Scalar_FLOAT64_IEEE 0 Arizona_all_IO_CM_double -1.7E+308 1.7E+308 /end CHARACTERISTIC
/begin CHARACTERISTIC Arizona_all_IO_cal_impl.GantryX1secundair_P3 "" VALUE 0x0021E850 Scalar_FLOAT64_IEEE 0 Arizona_all_IO_CM_double -1.7E+308 1.7E+308 /end CHARACTERISTIC
/begin CHARACTERISTIC Arizona_all_IO_cal_impl.GantryX1secundair_P4 "" VALUE 0x0021E868 Scalar_FLOAT64_IEEE 0 Arizona_all_IO_CM_double -1.7E+308 1.7E+308 /end CHARACTERISTIC
/begin CHARACTERISTIC Arizona_all_IO_cal_impl.GantryX1secundair_P5 "" VALUE 0x0021E880 Scalar_FLOAT64_IEEE 0 Arizona_all_IO_CM_double -1.7E+308 1.7E+308 /end CHARACTERISTIC
/begin CHARACTERISTIC Arizona_all_IO_cal_impl.GantryX1secundair_P6 "" VALUE 0x0021E898 Scalar_FLOAT64_IEEE 0 Arizona_all_IO_CM_double -1.7E+308 1.7E+308 /end CHARACTERISTIC
/begin CHARACTERISTIC Arizona_all_IO_cal_impl.GantryX1secundair_P7 "" VALUE 0x0021E8B0 Scalar_FLOAT64_IEEE 0 Arizona_all_IO_CM_double -1.7E+308 1.7E+308 /end CHARACTERISTIC
/begin CHARACTERISTIC Arizona_all_IO_cal_impl.GantryX1secundair_P8 "" VALUE 0x0021E8C8 Scalar_FLOAT64_IEEE 0 Arizona_all_IO_CM_double -1.7E+308 1.7E+308 /end CHARACTERISTIC
/begin CHARACTERISTIC Arizona_all_IO_cal_impl.GantryX1secundair_P9 "" VALUE 0x0021E8E0 Scalar_FLOAT64_IEEE 0 Arizona_all_IO_CM_double -1.7E+308 1.7E+308 /end CHARACTERISTIC
/begin CHARACTERISTIC Arizona_all_IO_cal_impl.Gantryx1GantryxR_P1 "" VALUE 0x0021E5D8 Scalar_FLOAT64_IEEE 0 Arizona_all_IO_CM_double -1.7E+308 1.7E+308 /end CHARACTERISTIC
/begin CHARACTERISTIC Arizona_all_IO_cal_impl.Gantryx1GantryxR_P10 "" VALUE 0x0021E6B0 Scalar_FLOAT64_IEEE 0 Arizona_all_IO_CM_double -1.7E+308 1.7E+308 /end CHARACTERISTIC
/begin CHARACTERISTIC Arizona_all_IO_cal_impl.Gantryx1GantryxR_P11 "" VALUE 0x0021E6C8 Scalar_FLOAT64_IEEE 0 Arizona_all_IO_CM_double -1.7E+308 1.7E+308 /end CHARACTERISTIC
/begin CHARACTERISTIC Arizona_all_IO_cal_impl.Gantryx1GantryxR_P12 "" VALUE 0x0021E6E0 Scalar_FLOAT64_IEEE 0 Arizona_all_IO_CM_double -1.7E+308 1.7E+308 /end CHARACTERISTIC
/begin CHARACTERISTIC Arizona_all_IO_cal_impl.Gantryx1GantryxR_P13 "" VALUE 0x0021E6F8 Scalar_FLOAT64_IEEE 0 Arizona_all_IO_CM_double -1.7E+308 1.7E+308 /end CHARACTERISTIC
/begin CHARACTERISTIC Arizona_all_IO_cal_impl.Gantryx1GantryxR_P14 "" VALUE 0x0021E710 Scalar_FLOAT64_IEEE 0 Arizona_all_IO_CM_double -1.7E+308 1.7E+308 /end CHARACTERISTIC
/begin CHARACTERISTIC Arizona_all_IO_cal_impl.Gantryx1GantryxR_P15 "" VALUE 0x0021E728 Scalar_FLOAT64_IEEE 0 Arizona_all_IO_CM_double -1.7E+308 1.7E+308 /end CHARACTERISTIC
/begin CHARACTERISTIC Arizona_all_IO_cal_impl.Gantryx1GantryxR_P16 "" VALUE 0x0021E740 Scalar_FLOAT64_IEEE 0 Arizona_all_IO_CM_double -1.7E+308 1.7E+308 /end CHARACTERISTIC
/begin CHARACTERISTIC Arizona_all_IO_cal_impl.Gantryx1GantryxR_P17 "" VALUE 0x0021E758 Scalar_FLOAT64_IEEE 0 Arizona_all_IO_CM_double -1.7E+308 1.7E+308 /end CHARACTERISTIC
/begin CHARACTERISTIC Arizona_all_IO_cal_impl.Gantryx1GantryxR_P18 "" VALUE 0x0021E770 Scalar_FLOAT64_IEEE 0 Arizona_all_IO_CM_double -1.7E+308 1.7E+308 /end CHARACTERISTIC
/begin CHARACTERISTIC Arizona_all_IO_cal_impl.Gantryx1GantryxR_P19 "" VALUE 0x0021E788 Scalar_FLOAT64_IEEE 0 Arizona_all_IO_CM_double -1.7E+308 1.7E+308 /end CHARACTERISTIC
/begin CHARACTERISTIC Arizona_all_IO_cal_impl.Gantryx1GantryxR_P2 "" VALUE 0x0021E5F0 Scalar_FLOAT64_IEEE 0 Arizona_all_IO_CM_double -1.7E+308 1.7E+308 /end CHARACTERISTIC
/begin CHARACTERISTIC Arizona_all_IO_cal_impl.Gantryx1GantryxR_P20 "" VALUE 0x0021E7A0 Scalar_FLOAT64_IEEE 0 Arizona_all_IO_CM_double -1.7E+308 1.7E+308 /end CHARACTERISTIC
/begin CHARACTERISTIC Arizona_all_IO_cal_impl.Gantryx1GantryxR_P21 "" VALUE 0x0021E7B8 Scalar_FLOAT64_IEEE 0 Arizona_all_IO_CM_double -1.7E+308 1.7E+308 /end CHARACTERISTIC
/begin CHARACTERISTIC Arizona_all_IO_cal_impl.Gantryx1GantryxR_P22 "" VALUE 0x0021E7D0 Scalar_FLOAT64_IEEE 0 Arizona_all_IO_CM_double -1.7E+308 1.7E+308 /end CHARACTERISTIC
/begin CHARACTERISTIC Arizona_all_IO_cal_impl.Gantryx1GantryxR_P23 "" VALUE 0x0021E7E8 Scalar_FLOAT64_IEEE 0 Arizona_all_IO_CM_double -1.7E+308 1.7E+308 /end CHARACTERISTIC
/begin CHARACTERISTIC Arizona_all_IO_cal_impl.Gantryx1GantryxR_P24 "" VALUE 0x0021E800 Scalar_FLOAT64_IEEE 0 Arizona_all_IO_CM_double -1.7E+308 1.7E+308 /end CHARACTERISTIC
/begin CHARACTERISTIC Arizona_all_IO_cal_impl.Gantryx1GantryxR_P3 "" VALUE 0x0021E608 Scalar_FLOAT64_IEEE 0 Arizona_all_IO_CM_double -1.7E+308 1.7E+308 /end CHARACTERISTIC
/begin CHARACTERISTIC Arizona_all_IO_cal_impl.Gantryx1GantryxR_P4 "" VALUE 0x0021E620 Scalar_FLOAT64_IEEE 0 Arizona_all_IO_CM_double -1.7E+308 1.7E+308 /end CHARACTERISTIC
/begin CHARACTERISTIC Arizona_all_IO_cal_impl.Gantryx1GantryxR_P5 "" VALUE 0x0021E638 Scalar_FLOAT64_IEEE 0 Arizona_all_IO_CM_double -1.7E+308 1.7E+308 /end CHARACTERISTIC
/begin CHARACTERISTIC Arizona_all_IO_cal_impl.Gantryx1GantryxR_P6 "" VALUE 0x0021E650 Scalar_FLOAT64_IEEE 0 Arizona_all_IO_CM_double -1.7E+308 1.7E+308 /end CHARACTERISTIC
/begin CHARACTERISTIC Arizona_all_IO_cal_impl.Gantryx1GantryxR_P7 "" VALUE 0x0021E668 Scalar_FLOAT64_IEEE 0 Arizona_all_IO_CM_double -1.7E+308 1.7E+308 /end CHARACTERISTIC
/begin CHARACTERISTIC Arizona_all_IO_cal_impl.Gantryx1GantryxR_P8 "" VALUE 0x0021E680 Scalar_FLOAT64_IEEE 0 Arizona_all_IO_CM_double -1.7E+308 1.7E+308 /end CHARACTERISTIC
/begin CHARACTERISTIC Arizona_all_IO_cal_impl.Gantryx1GantryxR_P9 "" VALUE 0x0021E698 Scalar_FLOAT64_IEEE 0 Arizona_all_IO_CM_double -1.7E+308 1.7E+308 /end CHARACTERISTIC
/begin CHARACTERISTIC Arizona_all_IO_cal_impl.Gantryx1enable0Inhibit1Enable_V "" VALUE 0x0021E438 Scalar_FLOAT64_IEEE 0 Arizona_all_IO_CM_double -1.7E+308 1.7E+308 /end CHARACTERISTIC
/begin CHARACTERISTIC Arizona_all_IO_cal_impl.Gantryx2GantryxL_P1 "" VALUE 0x0021EA60 Scalar_FLOAT64_IEEE 0 Arizona_all_IO_CM_double -1.7E+308 1.7E+308 /end CHARACTERISTIC
/begin CHARACTERISTIC Arizona_all_IO_cal_impl.Gantryx2GantryxL_P10 "" VALUE 0x0021EB38 Scalar_FLOAT64_IEEE 0 Arizona_all_IO_CM_double -1.7E+308 1.7E+308 /end CHARACTERISTIC
/begin CHARACTERISTIC Arizona_all_IO_cal_impl.Gantryx2GantryxL_P11 "" VALUE 0x0021EB50 Scalar_FLOAT64_IEEE 0 Arizona_all_IO_CM_double -1.7E+308 1.7E+308 /end CHARACTERISTIC
/begin CHARACTERISTIC Arizona_all_IO_cal_impl.Gantryx2GantryxL_P12 "" VALUE 0x0021EB68 Scalar_FLOAT64_IEEE 0 Arizona_all_IO_CM_double -1.7E+308 1.7E+308 /end CHARACTERISTIC
/begin CHARACTERISTIC Arizona_all_IO_cal_impl.Gantryx2GantryxL_P13 "" VALUE 0x0021EB80 Scalar_FLOAT64_IEEE 0 Arizona_all_IO_CM_double -1.7E+308 1.7E+308 /end CHARACTERISTIC
/begin CHARACTERISTIC Arizona_all_IO_cal_impl.Gantryx2GantryxL_P14 "" VALUE 0x0021EB98 Scalar_FLOAT64_IEEE 0 Arizona_all_IO_CM_double -1.7E+308 1.7E+308 /end CHARACTERISTIC
/begin CHARACTERISTIC Arizona_all_IO_cal_impl.Gantryx2GantryxL_P15 "" VALUE 0x0021EBB0 Scalar_FLOAT64_IEEE 0 Arizona_all_IO_CM_double -1.7E+308 1.7E+308 /end CHARACTERISTIC
/begin CHARACTERISTIC Arizona_all_IO_cal_impl.Gantryx2GantryxL_P16 "" VALUE 0x0021EBC8 Scalar_FLOAT64_IEEE 0 Arizona_all_IO_CM_double -1.7E+308 1.7E+308 /end CHARACTERISTIC
/begin CHARACTERISTIC Arizona_all_IO_cal_impl.Gantryx2GantryxL_P17 "" VALUE 0x0021EBE0 Scalar_FLOAT64_IEEE 0 Arizona_all_IO_CM_double -1.7E+308 1.7E+308 /end CHARACTERISTIC
/begin CHARACTERISTIC Arizona_all_IO_cal_impl.Gantryx2GantryxL_P18 "" VALUE 0x0021EBF8 Scalar_FLOAT64_IEEE 0 Arizona_all_IO_CM_double -1.7E+308 1.7E+308 /end CHARACTERISTIC
/begin CHARACTERISTIC Arizona_all_IO_cal_impl.Gantryx2GantryxL_P19 "" VALUE 0x0021EC10 Scalar_FLOAT64_IEEE 0 Arizona_all_IO_CM_double -1.7E+308 1.7E+308 /end CHARACTERISTIC
/begin CHARACTERISTIC Arizona_all_IO_cal_impl.Gantryx2GantryxL_P2 "" VALUE 0x0021EA78 Scalar_FLOAT64_IEEE 0 Arizona_all_IO_CM_double -1.7E+308 1.7E+308 /end CHARACTERISTIC
/begin CHARACTERISTIC Arizona_all_IO_cal_impl.Gantryx2GantryxL_P20 "" VALUE 0x0021EC28 Scalar_FLOAT64_IEEE 0 Arizona_all_IO_CM_double -1.7E+308 1.7E+308 /end CHARACTERISTIC
/begin CHARACTERISTIC Arizona_all_IO_cal_impl.Gantryx2GantryxL_P21 "" VALUE 0x0021EC40 Scalar_FLOAT64_IEEE 0 Arizona_all_IO_CM_double -1.7E+308 1.7E+308 /end CHARACTERISTIC
/begin CHARACTERISTIC Arizona_all_IO_cal_impl.Gantryx2GantryxL_P22 "" VALUE 0x0021EC58 Scalar_FLOAT64_IEEE 0 Arizona_all_IO_CM_double -1.7E+308 1.7E+308 /end CHARACTERISTIC
/begin CHARACTERISTIC Arizona_all_IO_cal_impl.Gantryx2GantryxL_P23 "" VALUE 0x0021EC70 Scalar_FLOAT64_IEEE 0 Arizona_all_IO_CM_double -1.7E+308 1.7E+308 /end CHARACTERISTIC
/begin CHARACTERISTIC Arizona_all_IO_cal_impl.Gantryx2GantryxL_P24 "" VALUE 0x0021EC88 Scalar_FLOAT64_IEEE 0 Arizona_all_IO_CM_double -1.7E+308 1.7E+308 /end CHARACTERISTIC
/begin CHARACTERISTIC Arizona_all_IO_cal_impl.Gantryx2GantryxL_P3 "" VALUE 0x0021EA90 Scalar_FLOAT64_IEEE 0 Arizona_all_IO_CM_double -1.7E+308 1.7E+308 /end CHARACTERISTIC
/begin CHARACTERISTIC Arizona_all_IO_cal_impl.Gantryx2GantryxL_P4 "" VALUE 0x0021EAA8 Scalar_FLOAT64_IEEE 0 Arizona_all_IO_CM_double -1.7E+308 1.7E+308 /end CHARACTERISTIC
/begin CHARACTERISTIC Arizona_all_IO_cal_impl.Gantryx2GantryxL_P5 "" VALUE 0x0021EAC0 Scalar_FLOAT64_IEEE 0 Arizona_all_IO_CM_double -1.7E+308 1.7E+308 /end CHARACTERISTIC
/begin CHARACTERISTIC Arizona_all_IO_cal_impl.Gantryx2GantryxL_P6 "" VALUE 0x0021EAD8 Scalar_FLOAT64_IEEE 0 Arizona_all_IO_CM_double -1.7E+308 1.7E+308 /end CHARACTERISTIC
/begin CHARACTERISTIC Arizona_all_IO_cal_impl.Gantryx2GantryxL_P7 "" VALUE 0x0021EAF0 Scalar_FLOAT64_IEEE 0 Arizona_all_IO_CM_double -1.7E+308 1.7E+308 /end CHARACTERISTIC
/begin CHARACTERISTIC Arizona_all_IO_cal_impl.Gantryx2GantryxL_P8 "" VALUE 0x0021EB08 Scalar_FLOAT64_IEEE 0 Arizona_all_IO_CM_double -1.7E+308 1.7E+308 /end CHARACTERISTIC
/begin CHARACTERISTIC Arizona_all_IO_cal_impl.Gantryx2GantryxL_P9 "" VALUE 0x0021EB20 Scalar_FLOAT64_IEEE 0 Arizona_all_IO_CM_double -1.7E+308 1.7E+308 /end CHARACTERISTIC
/begin CHARACTERISTIC Arizona_all_IO_cal_impl.Gantryx2enable0Inhibit1Enable_V "" VALUE 0x0021E500 Scalar_FLOAT64_IEEE 0 Arizona_all_IO_CM_double -1.7E+308 1.7E+308 /end CHARACTERISTIC
/begin CHARACTERISTIC Arizona_all_IO_cal_impl.GentryX2secundair_P1 "" VALUE 0x0021ECA0 Scalar_FLOAT64_IEEE 0 Arizona_all_IO_CM_double -1.7E+308 1.7E+308 /end CHARACTERISTIC
/begin CHARACTERISTIC Arizona_all_IO_cal_impl.GentryX2secundair_P10 "" VALUE 0x0021ED78 Scalar_FLOAT64_IEEE 0 Arizona_all_IO_CM_double -1.7E+308 1.7E+308 /end CHARACTERISTIC
/begin CHARACTERISTIC Arizona_all_IO_cal_impl.GentryX2secundair_P11 "" VALUE 0x0021ED90 Scalar_FLOAT64_IEEE 0 Arizona_all_IO_CM_double -1.7E+308 1.7E+308 /end CHARACTERISTIC
/begin CHARACTERISTIC Arizona_all_IO_cal_impl.GentryX2secundair_P12 "" VALUE 0x0021EDA8 Scalar_FLOAT64_IEEE 0 Arizona_all_IO_CM_double -1.7E+308 1.7E+308 /end CHARACTERISTIC
/begin CHARACTERISTIC Arizona_all_IO_cal_impl.GentryX2secundair_P13 "" VALUE 0x0021EDC0 Scalar_FLOAT64_IEEE 0 Arizona_all_IO_CM_double -1.7E+308 1.7E+308 /end CHARACTERISTIC
/begin CHARACTERISTIC Arizona_all_IO_cal_impl.GentryX2secundair_P14 "" VALUE 0x0021EDD8 Scalar_FLOAT64_IEEE 0 Arizona_all_IO_CM_double -1.7E+308 1.7E+308 /end CHARACTERISTIC
/begin CHARACTERISTIC Arizona_all_IO_cal_impl.GentryX2secundair_P15 "" VALUE 0x0021EDF0 Scalar_FLOAT64_IEEE 0 Arizona_all_IO_CM_double -1.7E+308 1.7E+308 /end CHARACTERISTIC
/begin CHARACTERISTIC Arizona_all_IO_cal_impl.GentryX2secundair_P16 "" VALUE 0x0021EE08 Scalar_FLOAT64_IEEE 0 Arizona_all_IO_CM_double -1.7E+308 1.7E+308 /end CHARACTERISTIC
/begin CHARACTERISTIC Arizona_all_IO_cal_impl.GentryX2secundair_P17 "" VALUE 0x0021EE20 Scalar_FLOAT64_IEEE 0 Arizona_all_IO_CM_double -1.7E+308 1.7E+308 /end CHARACTERISTIC
/begin CHARACTERISTIC Arizona_all_IO_cal_impl.GentryX2secundair_P18 "" VALUE 0x0021EE38 Scalar_FLOAT64_IEEE 0 Arizona_all_IO_CM_double -1.7E+308 1.7E+308 /end CHARACTERISTIC
/begin CHARACTERISTIC Arizona_all_IO_cal_impl.GentryX2secundair_P19 "" VALUE 0x0021EE50 Scalar_FLOAT64_IEEE 0 Arizona_all_IO_CM_double -1.7E+308 1.7E+308 /end CHARACTERISTIC
/begin CHARACTERISTIC Arizona_all_IO_cal_impl.GentryX2secundair_P2 "" VALUE 0x0021ECB8 Scalar_FLOAT64_IEEE 0 Arizona_all_IO_CM_double -1.7E+308 1.7E+308 /end CHARACTERISTIC
/begin CHARACTERISTIC Arizona_all_IO_cal_impl.GentryX2secundair_P20 "" VALUE 0x0021EE68 Scalar_FLOAT64_IEEE 0 Arizona_all_IO_CM_double -1.7E+308 1.7E+308 /end CHARACTERISTIC
/begin CHARACTERISTIC Arizona_all_IO_cal_impl.GentryX2secundair_P21 "" VALUE 0x0021EE80 Scalar_FLOAT64_IEEE 0 Arizona_all_IO_CM_double -1.7E+308 1.7E+308 /end CHARACTERISTIC
/begin CHARACTERISTIC Arizona_all_IO_cal_impl.GentryX2secundair_P22 "" VALUE 0x0021EE98 Scalar_FLOAT64_IEEE 0 Arizona_all_IO_CM_double -1.7E+308 1.7E+308 /end CHARACTERISTIC
/begin CHARACTERISTIC Arizona_all_IO_cal_impl.GentryX2secundair_P23 "" VALUE 0x0021EEB0 Scalar_FLOAT64_IEEE 0 Arizona_all_IO_CM_double -1.7E+308 1.7E+308 /end CHARACTERISTIC
/begin CHARACTERISTIC Arizona_all_IO_cal_impl.GentryX2secundair_P24 "" VALUE 0x0021EEC8 Scalar_FLOAT64_IEEE 0 Arizona_all_IO_CM_double -1.7E+308 1.7E+308 /end CHARACTERISTIC
/begin CHARACTERISTIC Arizona_all_IO_cal_impl.GentryX2secundair_P3 "" VALUE 0x0021ECD0 Scalar_FLOAT64_IEEE 0 Arizona_all_IO_CM_double -1.7E+308 1.7E+308 /end CHARACTERISTIC
/begin CHARACTERISTIC Arizona_all_IO_cal_impl.GentryX2secundair_P4 "" VALUE 0x0021ECE8 Scalar_FLOAT64_IEEE 0 Arizona_all_IO_CM_double -1.7E+308 1.7E+308 /end CHARACTERISTIC
/begin CHARACTERISTIC Arizona_all_IO_cal_impl.GentryX2secundair_P5 "" VALUE 0x0021ED00 Scalar_FLOAT64_IEEE 0 Arizona_all_IO_CM_double -1.7E+308 1.7E+308 /end CHARACTERISTIC
/begin CHARACTERISTIC Arizona_all_IO_cal_impl.GentryX2secundair_P6 "" VALUE 0x0021ED18 Scalar_FLOAT64_IEEE 0 Arizona_all_IO_CM_double -1.7E+308 1.7E+308 /end CHARACTERISTIC
/begin CHARACTERISTIC Arizona_all_IO_cal_impl.GentryX2secundair_P7 "" VALUE 0x0021ED30 Scalar_FLOAT64_IEEE 0 Arizona_all_IO_CM_double -1.7E+308 1.7E+308 /end CHARACTERISTIC
/begin CHARACTERISTIC Arizona_all_IO_cal_impl.GentryX2secundair_P8 "" VALUE 0x0021ED48 Scalar_FLOAT64_IEEE 0 Arizona_all_IO_CM_double -1.7E+308 1.7E+308 /end CHARACTERISTIC
/begin CHARACTERISTIC Arizona_all_IO_cal_impl.GentryX2secundair_P9 "" VALUE 0x0021ED60 Scalar_FLOAT64_IEEE 0 Arizona_all_IO_CM_double -1.7E+308 1.7E+308 /end CHARACTERISTIC
/begin CHARACTERISTIC Arizona_all_IO_cal_impl.Setup2_P1 "" VALUE 0x0021D070 Scalar_FLOAT64_IEEE 0 Arizona_all_IO_CM_double -1.7E+308 1.7E+308 /end CHARACTERISTIC
/begin CHARACTERISTIC Arizona_all_IO_cal_impl.Setup2_P10 "" VALUE 0x0021D1D0 Scalar_FLOAT64_IEEE 0 Arizona_all_IO_CM_double -1.7E+308 1.7E+308 /end CHARACTERISTIC
/begin CHARACTERISTIC Arizona_all_IO_cal_impl.Setup2_P11 "" VALUE 0x0021D1E8 Scalar_FLOAT64_IEEE 0 Arizona_all_IO_CM_double -1.7E+308 1.7E+308 /end CHARACTERISTIC
/begin CHARACTERISTIC Arizona_all_IO_cal_impl.Setup2_P12 "" VAL_BLK 0x0021D200 Scalar_FLOAT64_IEEE 0 Arizona_all_IO_CM_double -1.7E+308 1.7E+308 MATRIX_DIM 4 1 /end CHARACTERISTIC
/begin CHARACTERISTIC Arizona_all_IO_cal_impl.Setup2_P13 "" VALUE 0x0021D230 Scalar_FLOAT64_IEEE 0 Arizona_all_IO_CM_double -1.7E+308 1.7E+308 /end CHARACTERISTIC
/begin CHARACTERISTIC Arizona_all_IO_cal_impl.Setup2_P14 "" VALUE 0x0021D248 Scalar_FLOAT64_IEEE 0 Arizona_all_IO_CM_double -1.7E+308 1.7E+308 /end CHARACTERISTIC
/begin CHARACTERISTIC Arizona_all_IO_cal_impl.Setup2_P15 "" VALUE 0x0021D260 Scalar_FLOAT64_IEEE 0 Arizona_all_IO_CM_double -1.7E+308 1.7E+308 /end CHARACTERISTIC
/begin CHARACTERISTIC Arizona_all_IO_cal_impl.Setup2_P16 "" VAL_BLK 0x0021D278 Scalar_FLOAT64_IEEE 0 Arizona_all_IO_CM_double -1.7E+308 1.7E+308 MATRIX_DIM 2 1 /end CHARACTERISTIC
/begin CHARACTERISTIC Arizona_all_IO_cal_impl.Setup2_P17 "" VAL_BLK 0x0021D298 Scalar_FLOAT64_IEEE 0 Arizona_all_IO_CM_double -1.7E+308 1.7E+308 MATRIX_DIM 4 1 /end CHARACTERISTIC
/begin CHARACTERISTIC Arizona_all_IO_cal_impl.Setup2_P18 "" VAL_BLK 0x0021D2C8 Scalar_FLOAT64_IEEE 0 Arizona_all_IO_CM_double -1.7E+308 1.7E+308 MATRIX_DIM 4 1 /end CHARACTERISTIC
/begin CHARACTERISTIC Arizona_all_IO_cal_impl.Setup2_P19 "" VALUE 0x0021D2F8 Scalar_FLOAT64_IEEE 0 Arizona_all_IO_CM_double -1.7E+308 1.7E+308 /end CHARACTERISTIC
/begin CHARACTERISTIC Arizona_all_IO_cal_impl.Setup2_P2 "" VALUE 0x0021D088 Scalar_FLOAT64_IEEE 0 Arizona_all_IO_CM_double -1.7E+308 1.7E+308 /end CHARACTERISTIC
/begin CHARACTERISTIC Arizona_all_IO_cal_impl.Setup2_P20 "" VALUE 0x0021D310 Scalar_FLOAT64_IEEE 0 Arizona_all_IO_CM_double -1.7E+308 1.7E+308 /end CHARACTERISTIC
/begin CHARACTERISTIC Arizona_all_IO_cal_impl.Setup2_P21 "" VALUE 0x0021D328 Scalar_FLOAT64_IEEE 0 Arizona_all_IO_CM_double -1.7E+308 1.7E+308 /end CHARACTERISTIC
/begin CHARACTERISTIC Arizona_all_IO_cal_impl.Setup2_P22 "" VAL_BLK 0x0021D340 Scalar_FLOAT64_IEEE 0 Arizona_all_IO_CM_double -1.7E+308 1.7E+308 MATRIX_DIM 4 1 /end CHARACTERISTIC
/begin CHARACTERISTIC Arizona_all_IO_cal_impl.Setup2_P23 "" VALUE 0x0021D370 Scalar_FLOAT64_IEEE 0 Arizona_all_IO_CM_double -1.7E+308 1.7E+308 /end CHARACTERISTIC
/begin CHARACTERISTIC Arizona_all_IO_cal_impl.Setup2_P24 "" VALUE 0x0021D388 Scalar_FLOAT64_IEEE 0 Arizona_all_IO_CM_double -1.7E+308 1.7E+308 /end CHARACTERISTIC
/begin CHARACTERISTIC Arizona_all_IO_cal_impl.Setup2_P25 "" VALUE 0x0021D3A0 Scalar_FLOAT64_IEEE 0 Arizona_all_IO_CM_double -1.7E+308 1.7E+308 /end CHARACTERISTIC
/begin CHARACTERISTIC Arizona_all_IO_cal_impl.Setup2_P26 "" VALUE 0x0021D3B8 Scalar_FLOAT64_IEEE 0 Arizona_all_IO_CM_double -1.7E+308 1.7E+308 /end CHARACTERISTIC
/begin CHARACTERISTIC Arizona_all_IO_cal_impl.Setup2_P27 "" VALUE 0x0021D3D0 Scalar_FLOAT64_IEEE 0 Arizona_all_IO_CM_double -1.7E+308 1.7E+308 /end CHARACTERISTIC
/begin CHARACTERISTIC Arizona_all_IO_cal_impl.Setup2_P28 "" VALUE 0x0021D3E8 Scalar_FLOAT64_IEEE 0 Arizona_all_IO_CM_double -1.7E+308 1.7E+308 /end CHARACTERISTIC
/begin CHARACTERISTIC Arizona_all_IO_cal_impl.Setup2_P29 "" VALUE 0x0021D400 Scalar_FLOAT64_IEEE 0 Arizona_all_IO_CM_double -1.7E+308 1.7E+308 /end CHARACTERISTIC
/begin CHARACTERISTIC Arizona_all_IO_cal_impl.Setup2_P3 "" VALUE 0x0021D0A0 Scalar_FLOAT64_IEEE 0 Arizona_all_IO_CM_double -1.7E+308 1.7E+308 /end CHARACTERISTIC
/begin CHARACTERISTIC Arizona_all_IO_cal_impl.Setup2_P30 "" VALUE 0x0021D418 Scalar_FLOAT64_IEEE 0 Arizona_all_IO_CM_double -1.7E+308 1.7E+308 /end CHARACTERISTIC
/begin CHARACTERISTIC Arizona_all_IO_cal_impl.Setup2_P31 "" VALUE 0x0021D430 Scalar_FLOAT64_IEEE 0 Arizona_all_IO_CM_double -1.7E+308 1.7E+308 /end CHARACTERISTIC
/begin CHARACTERISTIC Arizona_all_IO_cal_impl.Setup2_P32 "" VALUE 0x0021D448 Scalar_FLOAT64_IEEE 0 Arizona_all_IO_CM_double -1.7E+308 1.7E+308 /end CHARACTERISTIC
/begin CHARACTERISTIC Arizona_all_IO_cal_impl.Setup2_P33 "" VAL_BLK 0x0021D460 Scalar_FLOAT64_IEEE 0 Arizona_all_IO_CM_double -1.7E+308 1.7E+308 MATRIX_DIM 3 1 /end CHARACTERISTIC
/begin CHARACTERISTIC Arizona_all_IO_cal_impl.Setup2_P34 "" VAL_BLK 0x0021D488 Scalar_FLOAT64_IEEE 0 Arizona_all_IO_CM_double -1.7E+308 1.7E+308 MATRIX_DIM 5 1 /end CHARACTERISTIC
/begin CHARACTERISTIC Arizona_all_IO_cal_impl.Setup2_P35 "" VALUE 0x0021D4C0 Scalar_FLOAT64_IEEE 0 Arizona_all_IO_CM_double -1.7E+308 1.7E+308 /end CHARACTERISTIC
/begin CHARACTERISTIC Arizona_all_IO_cal_impl.Setup2_P36 "" VALUE 0x0021D4D8 Scalar_FLOAT64_IEEE 0 Arizona_all_IO_CM_double -1.7E+308 1.7E+308 /end CHARACTERISTIC
/begin CHARACTERISTIC Arizona_all_IO_cal_impl.Setup2_P37 "" VALUE 0x0021D4F0 Scalar_FLOAT64_IEEE 0 Arizona_all_IO_CM_double -1.7E+308 1.7E+308 /end CHARACTERISTIC
/begin CHARACTERISTIC Arizona_all_IO_cal_impl.Setup2_P4 "" VALUE 0x0021D0B8 Scalar_FLOAT64_IEEE 0 Arizona_all_IO_CM_double -1.7E+308 1.7E+308 /end CHARACTERISTIC
/begin CHARACTERISTIC Arizona_all_IO_cal_impl.Setup2_P5 "" VALUE 0x0021D0D0 Scalar_FLOAT64_IEEE 0 Arizona_all_IO_CM_double -1.7E+308 1.7E+308 /end CHARACTERISTIC
/begin CHARACTERISTIC Arizona_all_IO_cal_impl.Setup2_P6 "" VAL_BLK 0x0021D0E8 Scalar_FLOAT64_IEEE 0 Arizona_all_IO_CM_double -1.7E+308 1.7E+308 MATRIX_DIM 2 1 /end CHARACTERISTIC
/begin CHARACTERISTIC Arizona_all_IO_cal_impl.Setup2_P7 "" VAL_BLK 0x0021D108 Scalar_FLOAT64_IEEE 0 Arizona_all_IO_CM_double -1.7E+308 1.7E+308 MATRIX_DIM 16 1 /end CHARACTERISTIC
/begin CHARACTERISTIC Arizona_all_IO_cal_impl.Setup2_P8 "" VAL_BLK 0x0021D198 Scalar_FLOAT64_IEEE 0 Arizona_all_IO_CM_double -1.7E+308 1.7E+308 MATRIX_DIM 2 1 /end CHARACTERISTIC
/begin CHARACTERISTIC Arizona_all_IO_cal_impl.Setup2_P9 "" VALUE 0x0021D1B8 Scalar_FLOAT64_IEEE 0 Arizona_all_IO_CM_double -1.7E+308 1.7E+308 /end CHARACTERISTIC
/begin CHARACTERISTIC Arizona_all_IO_cal_impl.SignalGenerator_Amplitude "" VALUE 0x0021D6C0 Scalar_FLOAT64_IEEE 0 Arizona_all_IO_CM_double -1.7E+308 1.7E+308 /end CHARACTERISTIC
/begin CHARACTERISTIC Arizona_all_IO_cal_impl.SignalGenerator_Frequency "" VALUE 0x0021D6C8 Scalar_FLOAT64_IEEE 0 Arizona_all_IO_CM_double -1.7E+308 1.7E+308 /end CHARACTERISTIC
/begin MEASUREMENT Arizona_all_IO_B.Cariagesecundair "" FLOAT64_IEEE Arizona_all_IO_CM_double 0 0 -1.7E+308 1.7E+308 ECU_ADDRESS 0x0022BAC0 /end MEASUREMENT
/begin MEASUREMENT Arizona_all_IO_B.Carriageenable0Inhibit1Enable "" FLOAT64_IEEE Arizona_all_IO_CM_double 0 0 -1.7E+308 1.7E+308 ECU_ADDRESS 0x0022BAC8 /end MEASUREMENT
/begin MEASUREMENT Arizona_all_IO_B.Carriageencoder "" FLOAT64_IEEE Arizona_all_IO_CM_double 0 0 -1.7E+308 1.7E+308 ECU_ADDRESS 0x0022BAD0 /end MEASUREMENT
/begin MEASUREMENT Arizona_all_IO_B.DILimitCarriage "" FLOAT64_IEEE Arizona_all_IO_CM_double 0 0 -1.7E+308 1.7E+308 ECU_ADDRESS 0x0022BAD8 /end MEASUREMENT
/begin MEASUREMENT Arizona_all_IO_B.DILimitCarriagesecundairwerktni "" FLOAT64_IEEE Arizona_all_IO_CM_double 0 0 -1.7E+308 1.7E+308 ECU_ADDRESS 0x0022BAE0 /end MEASUREMENT
/begin MEASUREMENT Arizona_all_IO_B.DILimitGantryx1GantryxR "" FLOAT64_IEEE Arizona_all_IO_CM_double 0 0 -1.7E+308 1.7E+308 ECU_ADDRESS 0x0022BAE8 /end MEASUREMENT
/begin MEASUREMENT Arizona_all_IO_B.DILimitGantryx1secundairGantryx "" FLOAT64_IEEE Arizona_all_IO_CM_double 0 0 -1.7E+308 1.7E+308 ECU_ADDRESS 0x0022BAF0 /end MEASUREMENT
/begin MEASUREMENT Arizona_all_IO_B.DILimitGantryx2GantryxL "" FLOAT64_IEEE Arizona_all_IO_CM_double 0 0 -1.7E+308 1.7E+308 ECU_ADDRESS 0x0022BAF8 /end MEASUREMENT
/begin MEASUREMENT Arizona_all_IO_B.DILimitGantryx2secundairGantryx "" FLOAT64_IEEE Arizona_all_IO_CM_double 0 0 -1.7E+308 1.7E+308 ECU_ADDRESS 0x0022BB00 /end MEASUREMENT
/begin MEASUREMENT Arizona_all_IO_B.DIblacksoftwarebutton "" FLOAT64_IEEE Arizona_all_IO_CM_double 0 0 -1.7E+308 1.7E+308 ECU_ADDRESS 0x0022BB08 /end MEASUREMENT
/begin MEASUREMENT Arizona_all_IO_B.DIcarriageampfaultstatus "" FLOAT64_IEEE Arizona_all_IO_CM_double 0 0 -1.7E+308 1.7E+308 ECU_ADDRESS 0x0022BB10 /end MEASUREMENT
/begin MEASUREMENT Arizona_all_IO_B.DIgantryx1faultstatus "" FLOAT64_IEEE Arizona_all_IO_CM_double 0 0 -1.7E+308 1.7E+308 ECU_ADDRESS 0x0022BB18 /end MEASUREMENT
/begin MEASUREMENT Arizona_all_IO_B.DIgantryx2faultstatus "" FLOAT64_IEEE Arizona_all_IO_CM_double 0 0 -1.7E+308 1.7E+308 ECU_ADDRESS 0x0022BB20 /end MEASUREMENT
/begin MEASUREMENT Arizona_all_IO_B.DIredsoftwarebutton "" FLOAT64_IEEE Arizona_all_IO_CM_double 0 0 -1.7E+308 1.7E+308 ECU_ADDRESS 0x0022BB28 /end MEASUREMENT
/begin MEASUREMENT Arizona_all_IO_B.Gain "" FLOAT64_IEEE Arizona_all_IO_CM_double 0 0 -1.7E+308 1.7E+308 ECU_ADDRESS 0x0022BA88 /end MEASUREMENT
/begin MEASUREMENT Arizona_all_IO_B.Gain1 "" FLOAT64_IEEE Arizona_all_IO_CM_double 0 0 -1.7E+308 1.7E+308 ECU_ADDRESS 0x0022BA98 /end MEASUREMENT
/begin MEASUREMENT Arizona_all_IO_B.Gain2 "" FLOAT64_IEEE Arizona_all_IO_CM_double 0 0 -1.7E+308 1.7E+308 ECU_ADDRESS 0x0022BAA8 /end MEASUREMENT
/begin MEASUREMENT Arizona_all_IO_B.Gain3 "" FLOAT64_IEEE Arizona_all_IO_CM_double 0 0 -1.7E+308 1.7E+308 ECU_ADDRESS 0x0022BAB0 /end MEASUREMENT
/begin MEASUREMENT Arizona_all_IO_B.Gain5 "" FLOAT64_IEEE Arizona_all_IO_CM_double 0 0 -1.7E+308 1.7E+308 ECU_ADDRESS 0x0022BAA0 /end MEASUREMENT
/begin MEASUREMENT Arizona_all_IO_B.GantryX1secundair "" FLOAT64_IEEE Arizona_all_IO_CM_double 0 0 -1.7E+308 1.7E+308 ECU_ADDRESS 0x0022BB50 /end MEASUREMENT
/begin MEASUREMENT Arizona_all_IO_B.Gantryx1GantryxR "" FLOAT64_IEEE Arizona_all_IO_CM_double 0 0 -1.7E+308 1.7E+308 ECU_ADDRESS 0x0022BB40 /end MEASUREMENT
/begin MEASUREMENT Arizona_all_IO_B.Gantryx1enable0Inhibit1Enable "" FLOAT64_IEEE Arizona_all_IO_CM_double 0 0 -1.7E+308 1.7E+308 ECU_ADDRESS 0x0022BB30 /end MEASUREMENT
/begin MEASUREMENT Arizona_all_IO_B.Gantryx2GantryxL "" FLOAT64_IEEE Arizona_all_IO_CM_double 0 0 -1.7E+308 1.7E+308 ECU_ADDRESS 0x0022BB58 /end MEASUREMENT
/begin MEASUREMENT Arizona_all_IO_B.Gantryx2enable0Inhibit1Enable "" FLOAT64_IEEE Arizona_all_IO_CM_double 0 0 -1.7E+308 1.7E+308 ECU_ADDRESS 0x0022BB38 /end MEASUREMENT
/begin MEASUREMENT Arizona_all_IO_B.GentryX2secundair "" FLOAT64_IEEE Arizona_all_IO_CM_double 0 0 -1.7E+308 1.7E+308 ECU_ADDRESS 0x0022BB60 /end MEASUREMENT
/begin MEASUREMENT Arizona_all_IO_B.LogicalOperator "" UBYTE Arizona_all_IO_CM_logical 0 0 0 1 ECU_ADDRESS 0x0022BB68 /end MEASUREMENT
/begin MEASUREMENT Arizona_all_IO_B.SignalGenerator "" FLOAT64_IEEE Arizona_all_IO_CM_double 0 0 -1.7E+308 1.7E+308 ECU_ADDRESS 0x0022BA90 /end MEASUREMENT
/begin MEASUREMENT Arizona_all_IO_B.analogvelin "" FLOAT64_IEEE Arizona_all_IO_CM_double 0 0 -1.7E+308 1.7E+308 ECU_ADDRESS 0x0022BA80 /end MEASUREMENT
/begin MEASUREMENT Arizona_all_IO_B.encodergantryx_R "" FLOAT64_IEEE Arizona_all_IO_CM_double 0 0 -1.7E+308 1.7E+308 ECU_ADDRESS 0x0022BB48 /end MEASUREMENT
/begin MEASUREMENT Arizona_all_IO_B.gantry_input_enabled_L "" FLOAT64_IEEE Arizona_all_IO_CM_double 0 0 -1.7E+308 1.7E+308 ECU_ADDRESS 0x0022BAB8 /end MEASUREMENT
/begin COMPU_METHOD Arizona_all_IO_CM_double "" IDENTICAL "%15.10" "" /end COMPU_METHOD
/begin COMPU_METHOD Arizona_all_IO_CM_logical "" IDENTICAL "%1.0" "" /end COMPU_METHOD
/begin RECORD_LAYOUT Scalar_BOOLEAN FNC_VALUES 1 UBYTE COLUMN_DIR DIRECT /end RECORD_LAYOUT
/begin RECORD_LAYOUT Scalar_FLOAT64_IEEE FNC_VALUES 1 FLOAT64_IEEE COLUMN_DIR DIRECT /end RECORD_LAYOUT
/begin GROUP Arizona_all_IO "Arizona_all_IO" ROOT
 /begin REF_CHARACTERISTIC Arizona_all_IO_cal_impl.Analoginput1_P1 Arizona_all_IO_cal_impl.Analoginput1_P10 Arizona_all_IO_cal_impl.Analoginput1_P11 Arizona_all_IO_cal_impl.Analoginput1_P12 Arizona_all_IO_cal_impl.Analoginput1_P2 Arizona_all_IO_cal_impl.Analoginput1_P3 Arizona_all_IO_cal_impl.Analoginput1_P4 Arizona_all_IO_cal_impl.Analoginput1_P5 Arizona_all_IO_cal_impl.Analoginput1_P6 Arizona_all_IO_cal_impl.Analoginput1_P7 Arizona_all_IO_cal_impl.Analoginput1_P8 Arizona_all_IO_cal_impl.Analoginput1_P9 Arizona_all_IO_cal_impl.Analogoutput2_P1 Arizona_all_IO_cal_impl.Analogoutput2_P10 Arizona_all_IO_cal_impl.Analogoutput2_P11 Arizona_all_IO_cal_impl.Analogoutput2_P12 Arizona_all_IO_cal_impl.Analogoutput2_P13 Arizona_all_IO_cal_impl.Analogoutput2_P14 Arizona_all_IO_cal_impl.Analogoutput2_P2 Arizona_all_IO_cal_impl.Analogoutput2_P3 Arizona_all_IO_cal_impl.Analogoutput2_P4 Arizona_all_IO_cal_impl.Analogoutput2_P5 Arizona_all_IO_cal_impl.Analogoutput2_P6 Arizona_all_IO_cal_impl.Analogoutput2_P7 Arizona_all_IO_cal_impl.Analogoutput2_P8 Arizona_all_IO_cal_impl.Analogoutput2_P9 Arizona_all_IO_cal_impl.Cariagesecundair_P1 Arizona_all_IO_cal_impl.Cariagesecundair_P10 Arizona_all_IO_cal_impl.Cariagesecundair_P11 Arizona_all_IO_cal_impl.Cariagesecundair_P12 Arizona_all_IO_cal_impl.Cariagesecundair_P13 Arizona_all_IO_cal_impl.Cariagesecundair_P14 Arizona_all_IO_cal_impl.Cariagesecundair_P15 Arizona_all_IO_cal_impl.Cariagesecundair_P16 Arizona_all_IO_cal_impl.Cariagesecundair_P17 Arizona_all_IO_cal_impl.Cariagesecundair_P18 Arizona_all_IO_cal_impl.Cariagesecundair_P19 Arizona_all_IO_cal_impl.Cariagesecundair_P2 Arizona_all_IO_cal_impl.Cariagesecundair_P20 Arizona_all_IO_cal_impl.Cariagesecundair_P21 Arizona_all_IO_cal_impl.Cariagesecundair_P22 Arizona_all_IO_cal_impl.Cariagesecundair_P23 Arizona_all_IO_cal_impl.Cariagesecundair_P24 Arizona_all_IO_cal_impl.Cariagesecundair_P3 Arizona_all_IO_cal_impl.Cariagesecundair_P4 Arizona_all_IO_cal_impl.Cariagesecundair_P5 Arizona_all_IO_cal_impl.Cariagesecundair_P6 Arizona_all_IO_cal_impl.Cariagesecundair_P7 Arizona_all_IO_cal_impl.Cariagesecundair_P8 Arizona_all_IO_cal_impl.Cariagesecundair_P9 Arizona_all_IO_cal_impl.Carriageenable0Inhibit1Enable_V Arizona_all_IO_cal_impl.Carriageencoder_P1 Arizona_all_IO_cal_impl.Carriageencoder_P10 Arizona_all_IO_cal_impl.Carriageencoder_P11 Arizona_all_IO_cal_impl.Carriageencoder_P12 Arizona_all_IO_cal_impl.Carriageencoder_P13 Arizona_all_IO_cal_impl.Carriageencoder_P14 Arizona_all_IO_cal_impl.Carriageencoder_P15 Arizona_all_IO_cal_impl.Carriageencoder_P16 Arizona_all_IO_cal_impl.Carriageencoder_P17 Arizona_all_IO_cal_impl.Carriageencoder_P18 Arizona_all_IO_cal_impl.Carriageencoder_P19 Arizona_all_IO_cal_impl.Carriageencoder_P2 Arizona_all_IO_cal_impl.Carriageencoder_P20 Arizona_all_IO_cal_impl.Carriageencoder_P21 Arizona_all_IO_cal_impl.Carriageencoder_P22 Arizona_all_IO_cal_impl.Carriageencoder_P23 Arizona_all_IO_cal_impl.Carriageencoder_P24 Arizona_all_IO_cal_impl.Carriageencoder_P3 Arizona_all_IO_cal_impl.Carriageencoder_P4 Arizona_all_IO_cal_impl.Carriageencoder_P5 Arizona_all_IO_cal_impl.Carriageencoder_P6 Arizona_all_IO_cal_impl.Carriageencoder_P7 Arizona_all_IO_cal_impl.Carriageencoder_P8 Arizona_all_IO_cal_impl.Carriageencoder_P9 Arizona_all_IO_cal_impl.DILimitCarriage_P1 Arizona_all_IO_cal_impl.DILimitCarriage_P2 Arizona_all_IO_cal_impl.DILimitCarriage_P3 Arizona_all_IO_cal_impl.DILimitCarriage_P4 Arizona_all_IO_cal_impl.DILimitCarriage_P5 Arizona_all_IO_cal_impl.DILimitCarriage_P6 Arizona_all_IO_cal_impl.DILimitCarriagesecundairwerk_cm Arizona_all_IO_cal_impl.DILimitCarriagesecundairwerkt_a Arizona_all_IO_cal_impl.DILimitCarriagesecundairwerkt_c Arizona_all_IO_cal_impl.DILimitCarriagesecundairwerkt_k Arizona_all_IO_cal_impl.DILimitCarriagesecundairwerkt_n Arizona_all_IO_cal_impl.DILimitCarriagesecundairwerkt_p Arizona_all_IO_cal_impl.DILimitGantryx1GantryxR_P1 Arizona_all_IO_cal_impl.DILimitGantryx1GantryxR_P2 Arizona_all_IO_cal_impl.DILimitGantryx1GantryxR_P3 Arizona_all_IO_cal_impl.DILimitGantryx1GantryxR_P4 Arizona_all_IO_cal_impl.DILimitGantryx1GantryxR_P5 Arizona_all_IO_cal_impl.DILimitGantryx1GantryxR_P6 Arizona_all_IO_cal_impl.DILimitGantryx1secundairGant_bw Arizona_all_IO_cal_impl.DILimitGantryx1secundairGantr_b Arizona_all_IO_cal_impl.DILimitGantryx1secundairGantr_f Arizona_all_IO_cal_impl.DILimitGantryx1secundairGantr_h Arizona_all_IO_cal_impl.DILimitGantryx1secundairGantr_m Arizona_all_IO_cal_impl.DILimitGantryx1secundairGantr_o Arizona_all_IO_cal_impl.DILimitGantryx2GantryxL_P1 Arizona_all_IO_cal_impl.DILimitGantryx2GantryxL_P2 Arizona_all_IO_cal_impl.DILimitGantryx2GantryxL_P3 Arizona_all_IO_cal_impl.DILimitGantryx2GantryxL_P4 Arizona_all_IO_cal_impl.DILimitGantryx2GantryxL_P5 Arizona_all_IO_cal_impl.DILimitGantryx2GantryxL_P6 Arizona_all_IO_cal_impl.DILimitGantryx2secundairGantr_e Arizona_all_IO_cal_impl.DILimitGantryx2secundairGantr_g Arizona_all_IO_cal_impl.DILimitGantryx2secundairGantr_h Arizona_all_IO_cal_impl.DILimitGantryx2secundairGantr_i Arizona_all_IO_cal_impl.DILimitGantryx2secundairGantr_k Arizona_all_IO_cal_impl.DILimitGantryx2secundairGantr_n Arizona_all_IO_cal_impl.DIblacksoftwarebutton_P1 Arizona_all_IO_cal_impl.DIblacksoftwarebutton_P2 Arizona_all_IO_cal_impl.DIblacksoftwarebutton_P3 Arizona_all_IO_cal_impl.DIblacksoftwarebutton_P4 Arizona_all_IO_cal_impl.DIblacksoftwarebutton_P5 Arizona_all_IO_cal_impl.DIblacksoftwarebutton_P6 Arizona_all_IO_cal_impl.DIcarriageampfaultstatus_P1 Arizona_all_IO_cal_impl.DIcarriageampfaultstatus_P2 Arizona_all_IO_cal_impl.DIcarriageampfaultstatus_P3 Arizona_all_IO_cal_impl.DIcarriageampfaultstatus_P4 Arizona_all_IO_cal_impl.DIcarriageampfaultstatus_P5 Arizona_all_IO_cal_impl.DIcarriageampfaultstatus_P6 Arizona_all_IO_cal_impl.DIgantryx1faultstatus_P1 Arizona_all_IO_cal_impl.DIgantryx1faultstatus_P2 Arizona_all_IO_cal_impl.DIgantryx1faultstatus_P3 Arizona_all_IO_cal_impl.DIgantryx1faultstatus_P4 Arizona_all_IO_cal_impl.DIgantryx1faultstatus_P5 Arizona_all_IO_cal_impl.DIgantryx1faultstatus_P6 Arizona_all_IO_cal_impl.DIgantryx2faultstatus_P1 Arizona_all_IO_cal_impl.DIgantryx2faultstatus_P2 Arizona_all_IO_cal_impl.DIgantryx2faultstatus_P3 Arizona_all_IO_cal_impl.DIgantryx2faultstatus_P4 Arizona_all_IO_cal_impl.DIgantryx2faultstatus_P5 Arizona_all_IO_cal_impl.DIgantryx2faultstatus_P6 Arizona_all_IO_cal_impl.DIredsoftwarebutton_P1 Arizona_all_IO_cal_impl.DIredsoftwarebutton_P2 Arizona_all_IO_cal_impl.DIredsoftwarebutton_P3 Arizona_all_IO_cal_impl.DIredsoftwarebutton_P4 Arizona_all_IO_cal_impl.DIredsoftwarebutton_P5 Arizona_all_IO_cal_impl.DIredsoftwarebutton_P6 Arizona_all_IO_cal_impl.DOInhibitCarriage_P1 Arizona_all_IO_cal_impl.DOInhibitCarriage_P2 Arizona_all_IO_cal_impl.DOInhibitCarriage_P3 Arizona_all_IO_cal_impl.DOInhibitCarriage_P4 Arizona_all_IO_cal_impl.DOInhibitCarriage_P5 Arizona_all_IO_cal_impl.DOInhibitCarriage_P6 Arizona_all_IO_cal_impl.DOInhibitCarriage_P7 Arizona_all_IO_cal_impl.DOInhibitCarriage_P8 Arizona_all_IO_cal_impl.DOInhibitGantryx1GantryxR_P1 Arizona_all_IO_cal_impl.DOInhibitGantryx1GantryxR_P2 Arizona_all_IO_cal_impl.DOInhibitGantryx1GantryxR_P3 Arizona_all_IO_cal_impl.DOInhibitGantryx1GantryxR_P4 Arizona_all_IO_cal_impl.DOInhibitGantryx1GantryxR_P5 Arizona_all_IO_cal_impl.DOInhibitGantryx1GantryxR_P6 Arizona_all_IO_cal_impl.DOInhibitGantryx1GantryxR_P7 Arizona_all_IO_cal_impl.DOInhibitGantryx1GantryxR_P8 Arizona_all_IO_cal_impl.DOInhibitGantryx2DOGantryxL_P1 Arizona_all_IO_cal_impl.DOInhibitGantryx2DOGantryxL_P2 Arizona_all_IO_cal_impl.DOInhibitGantryx2DOGantryxL_P3 Arizona_all_IO_cal_impl.DOInhibitGantryx2DOGantryxL_P4 Arizona_all_IO_cal_impl.DOInhibitGantryx2DOGantryxL_P5 Arizona_all_IO_cal_impl.DOInhibitGantryx2DOGantryxL_P6 Arizona_all_IO_cal_impl.DOInhibitGantryx2DOGantryxL_P7 Arizona_all_IO_cal_impl.DOInhibitGantryx2DOGantryxL_P8 Arizona_all_IO_cal_impl.Gain1_Gain Arizona_all_IO_cal_impl.Gain2_Gain Arizona_all_IO_cal_impl.Gain3_Gain Arizona_all_IO_cal_impl.Gain4_Gain Arizona_all_IO_cal_impl.Gain5_Gain Arizona_all_IO_cal_impl.Gain9_Gain Arizona_all_IO_cal_impl.Gain_Gain Arizona_all_IO_cal_impl.GantryX1secundair_P1 Arizona_all_IO_cal_impl.GantryX1secundair_P10 Arizona_all_IO_cal_impl.GantryX1secundair_P11 Arizona_all_IO_cal_impl.GantryX1secundair_P12 Arizona_all_IO_cal_impl.GantryX1secundair_P13 Arizona_all_IO_cal_impl.GantryX1secundair_P14 Arizona_all_IO_cal_impl.GantryX1secundair_P15 Arizona_all_IO_cal_impl.GantryX1secundair_P16 Arizona_all_IO_cal_impl.GantryX1secundair_P17 Arizona_all_IO_cal_impl.GantryX1secundair_P18 Arizona_all_IO_cal_impl.GantryX1secundair_P19 Arizona_all_IO_cal_impl.GantryX1secundair_P2 Arizona_all_IO_cal_impl.GantryX1secundair_P20 Arizona_all_IO_cal_impl.GantryX1secundair_P21 Arizona_all_IO_cal_impl.GantryX1secundair_P22 Arizona_all_IO_cal_impl.GantryX1secundair_P23 Arizona_all_IO_cal_impl.GantryX1secundair_P24 Arizona_all_IO_cal_impl.GantryX1secundair_P3 Arizona_all_IO_cal_impl.GantryX1secundair_P4 Arizona_all_IO_cal_impl.GantryX1secundair_P5 Arizona_all_IO_cal_impl.GantryX1secundair_P6 Arizona_all_IO_cal_impl.GantryX1secundair_P7 Arizona_all_IO_cal_impl.GantryX1secundair_P8 Arizona_all_IO_cal_impl.GantryX1secundair_P9 Arizona_all_IO_cal_impl.Gantryx1GantryxR_P1 Arizona_all_IO_cal_impl.Gantryx1GantryxR_P10 Arizona_all_IO_cal_impl.Gantryx1GantryxR_P11 Arizona_all_IO_cal_impl.Gantryx1GantryxR_P12 Arizona_all_IO_cal_impl.Gantryx1GantryxR_P13 Arizona_all_IO_cal_impl.Gantryx1GantryxR_P14 Arizona_all_IO_cal_impl.Gantryx1GantryxR_P15 Arizona_all_IO_cal_impl.Gantryx1GantryxR_P16 Arizona_all_IO_cal_impl.Gantryx1GantryxR_P17 Arizona_all_IO_cal_impl.Gantryx1GantryxR_P18 Arizona_all_IO_cal_impl.Gantryx1GantryxR_P19 Arizona_all_IO_cal_impl.Gantryx1GantryxR_P2 Arizona_all_IO_cal_impl.Gantryx1GantryxR_P20 Arizona_all_IO_cal_impl.Gantryx1GantryxR_P21 Arizona_all_IO_cal_impl.Gantryx1GantryxR_P22 Arizona_all_IO_cal_impl.Gantryx1GantryxR_P23 Arizona_all_IO_cal_impl.Gantryx1GantryxR_P24 Arizona_all_IO_cal_impl.Gantryx1GantryxR_P3 Arizona_all_IO_cal_impl.Gantryx1GantryxR_P4 Arizona_all_IO_cal_impl.Gantryx1GantryxR_P5 Arizona_all_IO_cal_impl.Gantryx1GantryxR_P6 Arizona_all_IO_cal_impl.Gantryx1GantryxR_P7 Arizona_all_IO_cal_impl.Gantryx1GantryxR_P8 Arizona_all_IO_cal_impl.Gantryx1GantryxR_P9 Arizona_all_IO_cal_impl.Gantryx1enable0Inhibit1Enable_V Arizona_all_IO_cal_impl.Gantryx2GantryxL_P1 Arizona_all_IO_cal_impl.Gantryx2GantryxL_P10 Arizona_all_IO_cal_impl.Gantryx2GantryxL_P11 Arizona_all_IO_cal_impl.Gantryx2GantryxL_P12 Arizona_all_IO_cal_impl.Gantryx2GantryxL_P13 Arizona_all_IO_cal_impl.Gantryx2GantryxL_P14 Arizona_all_IO_cal_impl.Gantryx2GantryxL_P15 Arizona_all_IO_cal_impl.Gantryx2GantryxL_P16 Arizona_all_IO_cal_impl.Gantryx2GantryxL_P17 Arizona_all_IO_cal_impl.Gantryx2GantryxL_P18 Arizona_all_IO_cal_impl.Gantryx2GantryxL_P19 Arizona_all_IO_cal_impl.Gantryx2GantryxL_P2 Arizona_all_IO_cal_impl.Gantryx2GantryxL_P20 Arizona_all_IO_cal_impl.Gantryx2GantryxL_P21 Arizona_all_IO_cal_impl.Gantryx2GantryxL_P22 Arizona_all_IO_cal_impl.Gantryx2GantryxL_P23 Arizona_all_IO_cal_impl.Gantryx2GantryxL_P24 Arizona_all_IO_cal_impl.Gantryx2GantryxL_P3 Arizona_all_IO_cal_impl.Gantryx2GantryxL_P4 Arizona_all_IO_cal_impl.Gantryx2GantryxL_P5 Arizona_all_IO_cal_impl.Gantryx2GantryxL_P6 Arizona_all_IO_cal_impl.Gantryx2GantryxL_P7 Arizona_all_IO_cal_impl.Gantryx2GantryxL_P8 Arizona_all_IO_cal_impl.Gantryx2GantryxL_P9 Arizona_all_IO_cal_impl.Gantryx2enable0Inhibit1Enable_V Arizona_all_IO_cal_impl.GentryX2secundair_P1 Arizona_all_IO_cal_impl.GentryX2secundair_P10 Arizona_all_IO_cal_impl.GentryX2secundair_P11 Arizona_all_IO_cal_impl.GentryX2secundair_P12 Arizona_all_IO_cal_impl.GentryX2secundair_P13 Arizona_all_IO_cal_impl.GentryX2secundair_P14 Arizona_all_IO_cal_impl.GentryX2secundair_P15 Arizona_all_IO_cal_impl.GentryX2secundair_P16 Arizona_all_IO_cal_impl.GentryX2secundair_P17 Arizona_all_IO_cal_impl.GentryX2secundair_P18 Arizona_all_IO_cal_impl.GentryX2secundair_P19 Arizona_all_IO_cal_impl.GentryX2secundair_P2 Arizona_all_IO_cal_impl.GentryX2secundair_P20 Arizona_all_IO_cal_impl.GentryX2secundair_P21 Arizona_all_IO_cal_impl.GentryX2secundair_P22 Arizona_all_IO_cal_impl.GentryX2secundair_P23 Arizona_all_IO_cal_impl.GentryX2secundair_P24 Arizona_all_IO_cal_impl.GentryX2secundair_P3 Arizona_all_IO_cal_impl.GentryX2secundair_P4 Arizona_all_IO_cal_impl.GentryX2secundair_P5 Arizona_all_IO_cal_impl.GentryX2secundair_P6 Arizona_all_IO_cal_impl.GentryX2secundair_P7 Arizona_all_IO_cal_impl.GentryX2secundair_P8 Arizona_all_IO_cal_impl.GentryX2secundair_P9 Arizona_all_IO_cal_impl.Setup2_P1 Arizona_all_IO_cal_impl.Setup2_P10 Arizona_all_IO_cal_impl.Setup2_P11 Arizona_all_IO_cal_impl.Setup2_P12 Arizona_all_IO_cal_impl.Setup2_P13 Arizona_all_IO_cal_impl.Setup2_P14 Arizona_all_IO_cal_impl.Setup2_P15 Arizona_all_IO_cal_impl.Setup2_P16 Arizona_all_IO_cal_impl.Setup2_P17 Arizona_all_IO_cal_impl.Setup2_P18 Arizona_all_IO_cal_impl.Setup2_P19 Arizona_all_IO_cal_impl.Setup2_P2 Arizona_all_IO_cal_impl.Setup2_P20 Arizona_all_IO_cal_impl.Setup2_P21 Arizona_all_IO_cal_impl.Setup2_P22 Arizona_all_IO_cal_impl.Setup2_P23 Arizona_all_IO_cal_impl.Setup2_P24 Arizona_all_IO_cal_impl.Setup2_P25 Arizona_all_IO_cal_impl.Setup2_P26 Arizona_all_IO_cal_impl.Setup2_P27 Arizona_all_IO_cal_impl.Setup2_P28 Arizona_all_IO_cal_impl.Setup2_P29 Arizona_all_IO_cal_impl.Setup2_P3 Arizona_all_IO_cal_impl.Setup2_P30 Arizona_all_IO_cal_impl.Setup2_P31 Arizona_all_IO_cal_impl.Setup2_P32 Arizona_all_IO_cal_impl.Setup2_P33 Arizona_all_IO_cal_impl.Setup2_P34 Arizona_all_IO_cal_impl.Setup2_P35 Arizona_all_IO_cal_impl.Setup2_P36 Arizona_all_IO_cal_impl.Setup2_P37 Arizona_all_IO_cal_impl.Setup2_P4 Arizona_all_IO_cal_impl.Setup2_P5 Arizona_all_IO_cal_impl.Setup2_P6 Arizona_all_IO_cal_impl.Setup2_P7 Arizona_all_IO_cal_impl.Setup2_P8 Arizona_all_IO_cal_impl.Setup2_P9 Arizona_all_IO_cal_impl.SignalGenerator_Amplitude Arizona_all_IO_cal_impl.SignalGenerator_Frequency /end REF_CHARACTERISTIC
 /begin REF_MEASUREMENT Arizona_all_IO_B.Cariagesecundair Arizona_all_IO_B.Carriageenable0Inhibit1Enable Arizona_all_IO_B.Carriageencoder Arizona_all_IO_B.DILimitCarriage Arizona_all_IO_B.DILimitCarriagesecundairwerktni Arizona_all_IO_B.DILimitGantryx1GantryxR Arizona_all_IO_B.DILimitGantryx1secundairGantryx Arizona_all_IO_B.DILimitGantryx2GantryxL Arizona_all_IO_B.DILimitGantryx2secundairGantryx Arizona_all_IO_B.DIblacksoftwarebutton Arizona_all_IO_B.DIcarriageampfaultstatus Arizona_all_IO_B.DIgantryx1faultstatus Arizona_all_IO_B.DIgantryx2faultstatus Arizona_all_IO_B.DIredsoftwarebutton Arizona_all_IO_B.Gain1 Arizona_all_IO_B.Gain2 Arizona_all_IO_B.Gain3 Arizona_all_IO_B.Gain5 Arizona_all_IO_B.GantryX1secundair Arizona_all_IO_B.Gantryx1GantryxR Arizona_all_IO_B.Gantryx1enable0Inhibit1Enable Arizona_all_IO_B.Gantryx2GantryxL Arizona_all_IO_B.Gantryx2enable0Inhibit1Enable Arizona_all_IO_B.GentryX2secundair Arizona_all_IO_B.LogicalOperator Arizona_all_IO_B.SignalGenerator Arizona_all_IO_B.analogvelin Arizona_all_IO_B.encodergantryx_R Arizona_all_IO_B.gantry_input_enabled_L Arizona_all_IO_DW.Analoginput1_PWORK Arizona_all_IO_DW.Analogoutput2_PWORK Arizona_all_IO_DW.Cariagesecundair_PWORK Arizona_all_IO_DW.Carriageencoder_PWORK Arizona_all_IO_DW.DILimitCarriage_PWORK Arizona_all_IO_DW.DILimitCarriagesecundairwerktni Arizona_all_IO_DW.DILimitGantryx1GantryxR_PWORK Arizona_all_IO_DW.DILimitGantryx1secundairGantryx Arizona_all_IO_DW.DILimitGantryx2GantryxL_PWORK Arizona_all_IO_DW.DILimitGantryx2secundairGantryx Arizona_all_IO_DW.DIblacksoftwarebutton_PWORK Arizona_all_IO_DW.DIcarriageampfaultstatus_PWORK Arizona_all_IO_DW.DIgantryx1faultstatus_PWORK Arizona_all_IO_DW.DIgantryx2faultstatus_PWORK Arizona_all_IO_DW.DIredsoftwarebutton_PWORK Arizona_all_IO_DW.DOInhibitCarriage_PWORK Arizona_all_IO_DW.DOInhibitGantryx1GantryxR_PWORK Arizona_all_IO_DW.DOInhibitGantryx2DOGantryxL_PWO Arizona_all_IO_DW.GantryX1secundair_PWORK Arizona_all_IO_DW.Gantryx1GantryxR_PWORK Arizona_all_IO_DW.Gantryx2GantryxL_PWORK Arizona_all_IO_DW.GentryX2secundair_PWORK Arizona_all_IO_DW.Setup_PWORK /end REF_MEASUREMENT
/end GROUP
/end MODULE
/end PROJECT
